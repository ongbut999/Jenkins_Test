AUTOSAR XML (schema 4-0-3)
# Copyright (C) Infineon Technologies (2015)
# All rights reserved.
package /AUTOSAR_Mcu/BswModuleDescriptions
  bsw module description Mcu: category=BSW_MODULE, module-id=101  # MCU Driver
    provided-entrys:
      Mcu_Init
      Mcu_GetVersionInfo
      Mcu_InitClock
      Mcu_InitRamSection
      Mcu_PerformReset
      Mcu_SetMode
      Mcu_ClockFailureNotification
      Mcu_DistributePllClock
      Mcu_GetPllStatus
      Mcu_GetResetRawValue
      Mcu_GetResetReason
      Mcu_InitCheck
      Mcu_GetMode
      Mcu_ChkWkpStdby
      Mcu_ClrWkpStdby
      Mcu_ClearColdResetStatus
      Gtm_Init
      Gtm_InitCheck
      Gtm_IsrTomModule
      Gtm_IsrAtomModule
      Gtm_IsrTimModule
      Gtm_ModifyOutputCtrl
      Gtm_CtrlAruFrame
      Gtm_SetTomHostTrigger
      Gtm_SetAtomHostTrigger
      Gtm_SetTomCounterCn0
      Gtm_SetAtomCounterCn0
      Gtm_GetTomCounterCn0
      Gtm_GetAtomCounterCn0
      Gtm_SetTomCompareValCm0
      Gtm_SetAtomCompareValCm0
      Gtm_GetTomCompareValCm0
      Gtm_GetAtomCompareValCm0
      Gtm_SetTomCompareValCm1
      Gtm_SetAtomCompareValCm1
      Gtm_GetTomCompareValCm1
      Gtm_GetAtomCompareValCm1
      Gtm_SetTomShadowValSr0
      Gtm_SetAtomShadowValSr0
      Gtm_GetTomShadowValSr0
      Gtm_GetAtomShadowValSr0
      Gtm_SetTomShadowValSr1
      Gtm_SetAtomShadowValSr1
      Gtm_GetTomShadowValSr1
      Gtm_GetAtomShadowValSr1
      Gtm_GetTomOutputState
      Gtm_GetAtomOutputState
      Gtm_EnableTomCoherantUpdate
      Gtm_EnableAtomCoherantUpdate
      Gtm_SetTimCounterShadowValCnts
      Gtm_GetTimCounterShadowValCnts
      Gtm_GetTimCounterValCnt
      Gtm_GetTimGeneralPurposeRegGpr0
      Gtm_GetTimGeneralPurposeRegGpr1
      Gtm_SetTimTimeoutVal
      Gtm_EnableTimTimeoutDetection
      Gtm_DisableTimTimeoutDetection
      Gtm_SelectTimTimeoutClock
      Gtm_GetTimCurrentTimeoutVal
      Gtm_EnableTbuChannel
      Gtm_DisableTbuChannel
      Gtm_EnableTomChannel
      Gtm_DisableTomChannel
      Gtm_EnableAtomChannel
      Gtm_DisableAtomChannel
      Gtm_AddFifoEntry
      Gtm_ReadFifoEntry
      Gtm_EnableDpll
      Gtm_DisableDpll
      Gtm_GetTbuChannelStatus
      Gtm_GetTbuTimerValue
      Gtm_TrigActTimebase
      Gtm_SetTimFilterThreshold
      Gtm_GetTimFilterThreshold
      Gtm_FlushFifo
      Gtm_CtrlFifoStream
      Gtm_ClearMcsRam
      Gtm_CtrlMcsTrigger
      Gtm_TrigDpllSwRst
      Gtm_GetDpllStatus
      Gtm_SetDpllRefMode
      Gtm_CtrlSpeModule
      Gtm_GetSpeInputPat
      Gtm_CtrlMapInput
      Gtm_SelectBrcDest
      Gtm_GetFifoStatus
      Gtm_GetMcsRamRstStat
      Gtm_WriteMcsRam
      Gtm_CtrlMcsChannel
      Gtm_InitMcsProgCntr
      Gtm_TrigMcsIntrpt
      Gtm_CtrlMcsIntrpt
      Gtm_TrigMcsReset
      Gtm_GetMcsErrTrigStatus
      Gtm_ResetMcsErrStatus
      Gtm_InitDpllRam
      Gtm_GetTomTimerRegisters
      Gtm_GetAtomTimerRegisters
    bsw module dependency DetDependency: target-module-id=15, required-entrys=Det_ReportError
    bsw module dependency DemDependency: target-module-id=54, required-entrys=Dem_ReportErrorStatus
    bsw module dependency SafeMcalDependency: target-module-id=255, required-entrys=SafeMcal_ReportError
    bsw internal behavior McuBehavior
      static-memorys:
        5 x data:
          Mcu_DriverState: implementation-data-type=uint8, type=uint8
          Mcu_ClockSetting: implementation-data-type=uint8, type=uint8
          Mcu_ResetStatusVal: implementation-data-type=uint32, type=uint32
          Mcu_kConfigPtr: sw-pointer-target-props=Mcu_ConfigType, type=Mcu_ConfigType
          Gtm_ConfigPtr: sw-pointer-target-props=Gtm_ConfigType, type=Gtm_ConfigType
      95 x bsw called entity:
        Mcu_Init: implemented-entry=Mcu_Init
        Mcu_GetVersionInfo: implemented-entry=Mcu_GetVersionInfo
        Mcu_InitClock: implemented-entry=Mcu_InitClock
        Mcu_InitRamSection: implemented-entry=Mcu_InitRamSection
        Mcu_PerformReset: implemented-entry=Mcu_PerformReset
        Mcu_SetMode: implemented-entry=Mcu_SetMode
        Mcu_ClockFailureNotification: implemented-entry=Mcu_ClockFailureNotification
        Mcu_DistributePllClock: implemented-entry=Mcu_DistributePllClock
        Mcu_GetPllStatus: implemented-entry=Mcu_GetPllStatus
        Mcu_GetResetRawValue: implemented-entry=Mcu_GetResetRawValue
        Mcu_GetResetReason: implemented-entry=Mcu_GetResetReason
        Mcu_InitCheck: implemented-entry=Mcu_InitCheck
        Mcu_GetMode: implemented-entry=Mcu_GetMode
        Mcu_ChkWkpStdby: implemented-entry=Mcu_ChkWkpStdby
        Mcu_ClrWkpStdby: implemented-entry=Mcu_ClrWkpStdby
        Mcu_ClearColdResetStatus: implemented-entry=Mcu_ClearColdResetStatus
        Gtm_Init: implemented-entry=Gtm_Init
        Gtm_InitCheck: implemented-entry=Gtm_InitCheck
        Gtm_ModifyOutputCtrl: implemented-entry=Gtm_ModifyOutputCtrl
        Gtm_CtrlAruFrame: implemented-entry=Gtm_CtrlAruFrame
        Gtm_SetTomHostTrigger: implemented-entry=Gtm_SetTomHostTrigger
        Gtm_SetAtomHostTrigger: implemented-entry=Gtm_SetAtomHostTrigger
        Gtm_SetTomCounterCn0: implemented-entry=Gtm_SetTomCounterCn0
        Gtm_SetAtomCounterCn0: implemented-entry=Gtm_SetAtomCounterCn0
        Gtm_GetTomCounterCn0: implemented-entry=Gtm_GetTomCounterCn0
        Gtm_GetAtomCounterCn0: implemented-entry=Gtm_GetAtomCounterCn0
        Gtm_SetTomCompareValCm0: implemented-entry=Gtm_SetTomCompareValCm0
        Gtm_SetAtomCompareValCm0: implemented-entry=Gtm_SetAtomCompareValCm0
        Gtm_GetTomCompareValCm0: implemented-entry=Gtm_GetTomCompareValCm0
        Gtm_GetAtomCompareValCm0: implemented-entry=Gtm_GetAtomCompareValCm0
        Gtm_SetTomCompareValCm1: implemented-entry=Gtm_SetTomCompareValCm1
        Gtm_SetAtomCompareValCm1: implemented-entry=Gtm_SetAtomCompareValCm1
        Gtm_GetTomCompareValCm1: implemented-entry=Gtm_GetTomCompareValCm1
        Gtm_GetAtomCompareValCm1: implemented-entry=Gtm_GetAtomCompareValCm1
        Gtm_SetTomShadowValSr0: implemented-entry=Gtm_SetTomShadowValSr0
        Gtm_SetAtomShadowValSr0: implemented-entry=Gtm_SetAtomShadowValSr0
        Gtm_GetTomShadowValSr0: implemented-entry=Gtm_GetTomShadowValSr0
        Gtm_GetAtomShadowValSr0: implemented-entry=Gtm_GetAtomShadowValSr0
        Gtm_SetTomShadowValSr1: implemented-entry=Gtm_SetTomShadowValSr1
        Gtm_SetAtomShadowValSr1: implemented-entry=Gtm_SetAtomShadowValSr1
        Gtm_GetTomShadowValSr1: implemented-entry=Gtm_GetTomShadowValSr1
        Gtm_GetAtomShadowValSr1: implemented-entry=Gtm_GetAtomShadowValSr1
        Gtm_GetTomOutputState: implemented-entry=Gtm_GetTomOutputState
        Gtm_GetAtomOutputState: implemented-entry=Gtm_GetAtomOutputState
        Gtm_EnableTomCoherantUpdate: implemented-entry=Gtm_EnableTomCoherantUpdate
        Gtm_EnableAtomCoherantUpdate: implemented-entry=Gtm_EnableAtomCoherantUpdate
        Gtm_SetTimCounterShadowValCnts: implemented-entry=Gtm_SetTimCounterShadowValCnts
        Gtm_GetTimCounterShadowValCnts: implemented-entry=Gtm_GetTimCounterShadowValCnts
        Gtm_GetTimCounterValCnt: implemented-entry=Gtm_GetTimCounterValCnt
        Gtm_GetTimGeneralPurposeRegGpr0: implemented-entry=Gtm_GetTimGeneralPurposeRegGpr0
        Gtm_GetTimGeneralPurposeRegGpr1: implemented-entry=Gtm_GetTimGeneralPurposeRegGpr1
        Gtm_SetTimTimeoutVal: implemented-entry=Gtm_SetTimTimeoutVal
        Gtm_EnableTimTimeoutDetection: implemented-entry=Gtm_EnableTimTimeoutDetection
        Gtm_DisableTimTimeoutDetection: implemented-entry=Gtm_DisableTimTimeoutDetection
        Gtm_SelectTimTimeoutClock: implemented-entry=Gtm_SelectTimTimeoutClock
        Gtm_GetTimCurrentTimeoutVal: implemented-entry=Gtm_GetTimCurrentTimeoutVal
        Gtm_EnableTbuChannel: implemented-entry=Gtm_EnableTbuChannel
        Gtm_DisableTbuChannel: implemented-entry=Gtm_DisableTbuChannel
        Gtm_EnableTomChannel: implemented-entry=Gtm_EnableTomChannel
        Gtm_DisableTomChannel: implemented-entry=Gtm_DisableTomChannel
        Gtm_EnableAtomChannel: implemented-entry=Gtm_EnableAtomChannel
        Gtm_DisableAtomChannel: implemented-entry=Gtm_DisableAtomChannel
        Gtm_AddFifoEntry: implemented-entry=Gtm_AddFifoEntry
        Gtm_ReadFifoEntry: implemented-entry=Gtm_ReadFifoEntry
        Gtm_EnableDpll: implemented-entry=Gtm_EnableDpll
        Gtm_DisableDpll: implemented-entry=Gtm_DisableDpll
        Gtm_GetTbuChannelStatus: implemented-entry=Gtm_GetTbuChannelStatus
        Gtm_GetTbuTimerValue: implemented-entry=Gtm_GetTbuTimerValue
        Gtm_TrigActTimebase: implemented-entry=Gtm_TrigActTimebase
        Gtm_SetTimFilterThreshold: implemented-entry=Gtm_SetTimFilterThreshold
        Gtm_GetTimFilterThreshold: implemented-entry=Gtm_GetTimFilterThreshold
        Gtm_FlushFifo: implemented-entry=Gtm_FlushFifo
        Gtm_CtrlFifoStream: implemented-entry=Gtm_CtrlFifoStream
        Gtm_ClearMcsRam: implemented-entry=Gtm_ClearMcsRam
        Gtm_CtrlMcsTrigger: implemented-entry=Gtm_CtrlMcsTrigger
        Gtm_TrigDpllSwRst: implemented-entry=Gtm_TrigDpllSwRst
        Gtm_GetDpllStatus: implemented-entry=Gtm_GetDpllStatus
        Gtm_SetDpllRefMode: implemented-entry=Gtm_SetDpllRefMode
        Gtm_CtrlSpeModule: implemented-entry=Gtm_CtrlSpeModule
        Gtm_GetSpeInputPat: implemented-entry=Gtm_GetSpeInputPat
        Gtm_CtrlMapInput: implemented-entry=Gtm_CtrlMapInput
        Gtm_SelectBrcDest: implemented-entry=Gtm_SelectBrcDest
        Gtm_GetFifoStatus: implemented-entry=Gtm_GetFifoStatus
        Gtm_GetMcsRamRstStat: implemented-entry=Gtm_GetMcsRamRstStat
        Gtm_WriteMcsRam: implemented-entry=Gtm_WriteMcsRam
        Gtm_CtrlMcsChannel: implemented-entry=Gtm_CtrlMcsChannel
        Gtm_InitMcsProgCntr: implemented-entry=Gtm_InitMcsProgCntr
        Gtm_TrigMcsIntrpt: implemented-entry=Gtm_TrigMcsIntrpt
        Gtm_CtrlMcsIntrpt: implemented-entry=Gtm_CtrlMcsIntrpt
        Gtm_TrigMcsReset: implemented-entry=Gtm_TrigMcsReset
        Gtm_GetMcsErrTrigStatus: implemented-entry=Gtm_GetMcsErrTrigStatus
        Gtm_ResetMcsErrStatus: implemented-entry=Gtm_ResetMcsErrStatus
        Gtm_InitDpllRam: implemented-entry=Gtm_InitDpllRam
        Gtm_GetTomTimerRegisters: implemented-entry=Gtm_GetTomTimerRegisters
        Gtm_GetAtomTimerRegisters: implemented-entry=Gtm_GetAtomTimerRegisters
      bsw interrupt entity Gtm_IsrTomModule: implemented-entry=Gtm_IsrTomModule, interrupt-category=CAT-1, interrupt-source=SRC_GTMTOMxy
      bsw interrupt entity Gtm_IsrAtomModule: implemented-entry=Gtm_IsrAtomModule, interrupt-category=CAT-1, interrupt-source=SRC_GTMATOMxy
      bsw interrupt entity Gtm_IsrTimModule: implemented-entry=Gtm_IsrTimModule, interrupt-category=CAT-1, interrupt-source=SRC_GTMTIMxy
package /AUTOSAR_Mcu/BswModuleEntrys
  98 x bsw module entry, all with is-synchronous=true:
    Mcu_Init: service-id=0, is-reentrant=false, call-type=REGULAR, execution-context=TASK, sw-service-impl-policy=STANDARD
      sw service arg ConfigPtr: category=DATA_REFERENCE, sw-pointer-target-props={target-category=TYPE_REFERENCE, implementation-data-type=Mcu_ConfigType}
    Mcu_GetVersionInfo: service-id=9, is-reentrant=false, call-type=REGULAR, execution-context=UNSPECIFIED, sw-service-impl-policy=MACRO
      sw service arg VersionInfoPtr: category=DATA_REFERENCE, sw-pointer-target-props={target-category=TYPE_REFERENCE, implementation-data-type=Std_VersionInfoType}
    Mcu_InitClock: service-id=2, is-reentrant=false, call-type=REGULAR, execution-context=TASK, sw-service-impl-policy=STANDARD
      return type Return: implementation-data-type=Std_ReturnType
      sw service arg ClockSetting: implementation-data-type=Mcu_ClockType
    Mcu_InitRamSection: service-id=1, is-reentrant=false, call-type=REGULAR, execution-context=TASK, sw-service-impl-policy=STANDARD
      return type Return: implementation-data-type=Std_ReturnType
      sw service arg RamSection: implementation-data-type=Mcu_RamSectionType
    Mcu_PerformReset: service-id=7, is-reentrant=false, call-type=REGULAR, execution-context=TASK, sw-service-impl-policy=STANDARD
    Mcu_SetMode: service-id=8, is-reentrant=false, call-type=REGULAR, execution-context=TASK, sw-service-impl-policy=STANDARD
      sw service arg McuMode: implementation-data-type=Mcu_ModeType
    Mcu_ClockFailureNotification: service-id=0, is-reentrant=true, call-type=REGULAR, execution-context=TASK, sw-service-impl-policy=STANDARD
    Mcu_DistributePllClock: service-id=3, is-reentrant=false, call-type=REGULAR, execution-context=TASK, sw-service-impl-policy=STANDARD
    Mcu_GetPllStatus: service-id=4, is-reentrant=true, call-type=REGULAR, execution-context=TASK, sw-service-impl-policy=STANDARD
      return type Return: implementation-data-type=Mcu_PllStatusType
    Mcu_GetResetRawValue: service-id=6, is-reentrant=true, call-type=REGULAR, execution-context=TASK, sw-service-impl-policy=STANDARD
      return type Return: implementation-data-type=Mcu_RawResetType
    Mcu_GetResetReason: service-id=5, is-reentrant=true, call-type=REGULAR, execution-context=TASK, sw-service-impl-policy=STANDARD
      return type Return: implementation-data-type=Mcu_ResetType
    Mcu_InitCheck: service-id=0, is-reentrant=false, call-type=REGULAR, execution-context=TASK, sw-service-impl-policy=STANDARD
      return type Return: implementation-data-type=Std_ReturnType
      sw service arg ConfigPtr: category=DATA_REFERENCE, sw-pointer-target-props={target-category=TYPE_REFERENCE, implementation-data-type=Mcu_ConfigType}
    Mcu_GetMode: service-id=0, is-reentrant=false, call-type=REGULAR, execution-context=TASK, sw-service-impl-policy=STANDARD
      return type Return: implementation-data-type=Mcu_ModeStateType
      sw service arg CoreId: implementation-data-type=uint8
    Mcu_ChkWkpStdby: service-id=0, is-reentrant=false, call-type=REGULAR, execution-context=TASK, sw-service-impl-policy=INLINE
      return type Return: implementation-data-type=uint32
    Mcu_ClrWkpStdby: service-id=0, is-reentrant=false, call-type=REGULAR, execution-context=TASK, sw-service-impl-policy=INLINE
      sw service arg WkpBits: implementation-data-type=uint32
    Mcu_ClearColdResetStatus: service-id=80, is-reentrant=false, call-type=REGULAR, execution-context=TASK, sw-service-impl-policy=STANDARD
      return type Return: implementation-data-type=Std_ReturnType
    Gtm_Init: service-id=0, is-reentrant=false, call-type=REGULAR, execution-context=UNSPECIFIED, sw-service-impl-policy=STANDARD
      return type Return: implementation-data-type=Std_ReturnType
      sw service arg ConfigPtr: category=DATA_REFERENCE, sw-pointer-target-props={target-category=TYPE_REFERENCE, implementation-data-type=Gtm_ConfigType}
    Gtm_InitCheck: service-id=0, is-reentrant=false, call-type=REGULAR, execution-context=TASK, sw-service-impl-policy=STANDARD
      return type Return: implementation-data-type=Std_ReturnType
      sw service arg ConfigPtr: category=DATA_REFERENCE, sw-pointer-target-props={target-category=TYPE_REFERENCE, implementation-data-type=Gtm_ConfigType}
    Gtm_IsrTomModule: service-id=90, is-reentrant=true, call-type=INTERRUPT, execution-context=INTERRUPT-CAT-1, sw-service-impl-policy=STANDARD
      sw service arg ModuleNo: implementation-data-type=uint8
      sw service arg ChannelNumber: implementation-data-type=uint8
    Gtm_IsrAtomModule: service-id=92, is-reentrant=true, call-type=INTERRUPT, execution-context=INTERRUPT-CAT-1, sw-service-impl-policy=STANDARD
      sw service arg ModuleNo: implementation-data-type=uint8
      sw service arg ChannelNumber: implementation-data-type=uint8
    Gtm_IsrTimModule: service-id=91, is-reentrant=true, call-type=INTERRUPT, execution-context=INTERRUPT-CAT-1, sw-service-impl-policy=STANDARD
      sw service arg ModuleNo: implementation-data-type=uint8
      sw service arg ChannelNumber: implementation-data-type=uint8
    Gtm_ModifyOutputCtrl: service-id=0, is-reentrant=true, call-type=REGULAR, execution-context=UNSPECIFIED, sw-service-impl-policy=STANDARD
      4 x sw service arg:
        TimerModule: implementation-data-type=uint8
        ModuleNo: implementation-data-type=uint8
        ChannelNo: implementation-data-type=uint8
        ToEnable: implementation-data-type=boolean
    Gtm_CtrlAruFrame: service-id=0, is-reentrant=true, call-type=REGULAR, execution-context=UNSPECIFIED, sw-service-impl-policy=STANDARD
      return type Return: implementation-data-type=Gtm_AruReqStatusType
      4 x sw service arg:
        AruAddress: implementation-data-type=uint16
        ReqType: implementation-data-type=uint8
        AruFrame: category=DATA_REFERENCE, sw-pointer-target-props={target-category=TYPE_REFERENCE, implementation-data-type=uint32}
        ReadReq: implementation-data-type=uint8
    Gtm_SetTomHostTrigger: service-id=0, is-reentrant=true, call-type=REGULAR, execution-context=UNSPECIFIED, sw-service-impl-policy=INLINE-CONDITIONAL
      sw service arg ModuleNo: implementation-data-type=uint8
      sw service arg TgcNumber: implementation-data-type=uint8
    Gtm_SetAtomHostTrigger: service-id=0, is-reentrant=true, call-type=REGULAR, execution-context=UNSPECIFIED, sw-service-impl-policy=INLINE-CONDITIONAL
      sw service arg ModuleNo: implementation-data-type=uint8
    Gtm_SetTomCounterCn0: service-id=0, is-reentrant=true, call-type=REGULAR, execution-context=UNSPECIFIED, sw-service-impl-policy=INLINE-CONDITIONAL
      sw service arg ModuleNo: implementation-data-type=uint8
      sw service arg ChannelNo: implementation-data-type=uint8
      sw service arg Cn0Value: implementation-data-type=uint16
    Gtm_SetAtomCounterCn0: service-id=0, is-reentrant=true, call-type=REGULAR, execution-context=UNSPECIFIED, sw-service-impl-policy=INLINE-CONDITIONAL
      sw service arg ModuleNo: implementation-data-type=uint8
      sw service arg ChannelNo: implementation-data-type=uint8
      sw service arg Cn0Value: implementation-data-type=uint32
    Gtm_GetTomCounterCn0: service-id=0, is-reentrant=true, call-type=REGULAR, execution-context=UNSPECIFIED, sw-service-impl-policy=INLINE-CONDITIONAL
      return type Return: implementation-data-type=uint16
      sw service arg ModuleNo: implementation-data-type=uint8
      sw service arg ChannelNo: implementation-data-type=uint8
    Gtm_GetAtomCounterCn0: service-id=0, is-reentrant=true, call-type=REGULAR, execution-context=UNSPECIFIED, sw-service-impl-policy=INLINE-CONDITIONAL
      return type Return: implementation-data-type=uint32
      sw service arg ModuleNo: implementation-data-type=uint8
      sw service arg ChannelNo: implementation-data-type=uint8
    Gtm_SetTomCompareValCm0: service-id=0, is-reentrant=true, call-type=REGULAR, execution-context=UNSPECIFIED, sw-service-impl-policy=INLINE-CONDITIONAL
      sw service arg ModuleNo: implementation-data-type=uint8
      sw service arg ChannelNo: implementation-data-type=uint8
      sw service arg Cm0Value: implementation-data-type=uint16
    Gtm_SetAtomCompareValCm0: service-id=0, is-reentrant=true, call-type=REGULAR, execution-context=UNSPECIFIED, sw-service-impl-policy=INLINE-CONDITIONAL
      sw service arg ModuleNo: implementation-data-type=uint8
      sw service arg ChannelNo: implementation-data-type=uint8
      sw service arg Cm0Value: implementation-data-type=uint32
    Gtm_GetTomCompareValCm0: service-id=0, is-reentrant=true, call-type=REGULAR, execution-context=UNSPECIFIED, sw-service-impl-policy=INLINE-CONDITIONAL
      return type Return: implementation-data-type=uint16
      sw service arg ModuleNo: implementation-data-type=uint8
      sw service arg ChannelNo: implementation-data-type=uint8
    Gtm_GetAtomCompareValCm0: service-id=0, is-reentrant=true, call-type=REGULAR, execution-context=UNSPECIFIED, sw-service-impl-policy=INLINE-CONDITIONAL
      return type Return: implementation-data-type=uint32
      sw service arg ModuleNo: implementation-data-type=uint8
      sw service arg ChannelNo: implementation-data-type=uint8
    Gtm_SetTomCompareValCm1: service-id=0, is-reentrant=true, call-type=REGULAR, execution-context=UNSPECIFIED, sw-service-impl-policy=INLINE-CONDITIONAL
      sw service arg ModuleNo: implementation-data-type=uint8
      sw service arg ChannelNo: implementation-data-type=uint8
      sw service arg Cm1Value: implementation-data-type=uint16
    Gtm_SetAtomCompareValCm1: service-id=0, is-reentrant=true, call-type=REGULAR, execution-context=UNSPECIFIED, sw-service-impl-policy=INLINE-CONDITIONAL
      sw service arg ModuleNo: implementation-data-type=uint8
      sw service arg ChannelNo: implementation-data-type=uint8
      sw service arg Cm1Value: implementation-data-type=uint32
    Gtm_GetTomCompareValCm1: service-id=0, is-reentrant=true, call-type=REGULAR, execution-context=UNSPECIFIED, sw-service-impl-policy=INLINE-CONDITIONAL
      return type Return: implementation-data-type=uint16
      sw service arg ModuleNo: implementation-data-type=uint8
      sw service arg ChannelNo: implementation-data-type=uint8
    Gtm_GetAtomCompareValCm1: service-id=0, is-reentrant=true, call-type=REGULAR, execution-context=UNSPECIFIED, sw-service-impl-policy=INLINE-CONDITIONAL
      return type Return: implementation-data-type=uint32
      sw service arg ModuleNo: implementation-data-type=uint8
      sw service arg ChannelNo: implementation-data-type=uint8
    Gtm_SetTomShadowValSr0: service-id=0, is-reentrant=true, call-type=REGULAR, execution-context=UNSPECIFIED, sw-service-impl-policy=INLINE-CONDITIONAL
      sw service arg ModuleNo: implementation-data-type=uint8
      sw service arg ChannelNo: implementation-data-type=uint8
      sw service arg Sr0Value: implementation-data-type=uint16
    Gtm_SetAtomShadowValSr0: service-id=0, is-reentrant=true, call-type=REGULAR, execution-context=UNSPECIFIED, sw-service-impl-policy=INLINE-CONDITIONAL
      sw service arg ModuleNo: implementation-data-type=uint8
      sw service arg ChannelNo: implementation-data-type=uint8
      sw service arg Sr0Value: implementation-data-type=uint32
    Gtm_GetTomShadowValSr0: service-id=0, is-reentrant=true, call-type=REGULAR, execution-context=UNSPECIFIED, sw-service-impl-policy=INLINE-CONDITIONAL
      return type Return: implementation-data-type=uint16
      sw service arg ModuleNo: implementation-data-type=uint8
      sw service arg ChannelNo: implementation-data-type=uint8
    Gtm_GetAtomShadowValSr0: service-id=0, is-reentrant=true, call-type=REGULAR, execution-context=UNSPECIFIED, sw-service-impl-policy=INLINE-CONDITIONAL
      return type Return: implementation-data-type=uint32
      sw service arg ModuleNo: implementation-data-type=uint8
      sw service arg ChannelNo: implementation-data-type=uint8
    Gtm_SetTomShadowValSr1: service-id=0, is-reentrant=true, call-type=REGULAR, execution-context=UNSPECIFIED, sw-service-impl-policy=INLINE-CONDITIONAL
      sw service arg ModuleNo: implementation-data-type=uint8
      sw service arg ChannelNo: implementation-data-type=uint8
      sw service arg Sr1Value: implementation-data-type=uint16
    Gtm_SetAtomShadowValSr1: service-id=0, is-reentrant=true, call-type=REGULAR, execution-context=UNSPECIFIED, sw-service-impl-policy=INLINE-CONDITIONAL
      sw service arg ModuleNo: implementation-data-type=uint8
      sw service arg ChannelNo: implementation-data-type=uint8
      sw service arg Sr1Value: implementation-data-type=uint32
    Gtm_GetTomShadowValSr1: service-id=0, is-reentrant=true, call-type=REGULAR, execution-context=UNSPECIFIED, sw-service-impl-policy=INLINE-CONDITIONAL
      return type Return: implementation-data-type=uint16
      sw service arg ModuleNo: implementation-data-type=uint8
      sw service arg ChannelNo: implementation-data-type=uint8
    Gtm_GetAtomShadowValSr1: service-id=0, is-reentrant=true, call-type=REGULAR, execution-context=UNSPECIFIED, sw-service-impl-policy=INLINE-CONDITIONAL
      return type Return: implementation-data-type=uint32
      sw service arg ModuleNo: implementation-data-type=uint8
      sw service arg ChannelNo: implementation-data-type=uint8
    Gtm_GetTomOutputState: service-id=0, is-reentrant=true, call-type=REGULAR, execution-context=UNSPECIFIED, sw-service-impl-policy=INLINE-CONDITIONAL
      return type Return: implementation-data-type=Gtm_OutputLevelType
      sw service arg ModuleNo: implementation-data-type=uint8
      sw service arg ChannelNo: implementation-data-type=uint8
    Gtm_GetAtomOutputState: service-id=0, is-reentrant=true, call-type=REGULAR, execution-context=UNSPECIFIED, sw-service-impl-policy=INLINE-CONDITIONAL
      return type Return: implementation-data-type=Gtm_OutputLevelType
      sw service arg ModuleNo: implementation-data-type=uint8
      sw service arg ChannelNo: implementation-data-type=uint8
    Gtm_EnableTomCoherantUpdate: service-id=0, is-reentrant=true, call-type=REGULAR, execution-context=UNSPECIFIED, sw-service-impl-policy=INLINE-CONDITIONAL
      sw service arg ModuleNo: implementation-data-type=uint8
      sw service arg ChannelNo: implementation-data-type=uint8
    Gtm_EnableAtomCoherantUpdate: service-id=0, is-reentrant=true, call-type=REGULAR, execution-context=UNSPECIFIED, sw-service-impl-policy=INLINE-CONDITIONAL
      sw service arg ModuleNo: implementation-data-type=uint8
      sw service arg ChannelNo: implementation-data-type=uint8
    Gtm_SetTimCounterShadowValCnts: service-id=0, is-reentrant=true, call-type=REGULAR, execution-context=UNSPECIFIED, sw-service-impl-policy=INLINE-CONDITIONAL
      sw service arg ModuleNo: implementation-data-type=uint8
      sw service arg ChannelNo: implementation-data-type=uint8
      sw service arg CntsValue: implementation-data-type=uint32
    Gtm_GetTimCounterShadowValCnts: service-id=0, is-reentrant=true, call-type=REGULAR, execution-context=UNSPECIFIED, sw-service-impl-policy=INLINE-CONDITIONAL
      return type Return: implementation-data-type=uint32
      sw service arg ModuleNo: implementation-data-type=uint8
      sw service arg ChannelNo: implementation-data-type=uint8
    Gtm_GetTimCounterValCnt: service-id=0, is-reentrant=true, call-type=REGULAR, execution-context=UNSPECIFIED, sw-service-impl-policy=INLINE-CONDITIONAL
      return type Return: implementation-data-type=uint32
      sw service arg ModuleNo: implementation-data-type=uint8
      sw service arg ChannelNo: implementation-data-type=uint8
    Gtm_GetTimGeneralPurposeRegGpr0: service-id=0, is-reentrant=true, call-type=REGULAR, execution-context=UNSPECIFIED, sw-service-impl-policy=INLINE-CONDITIONAL
      return type Return: implementation-data-type=uint32
      sw service arg ModuleNo: implementation-data-type=uint8
      sw service arg ChannelNo: implementation-data-type=uint8
    Gtm_GetTimGeneralPurposeRegGpr1: service-id=0, is-reentrant=true, call-type=REGULAR, execution-context=UNSPECIFIED, sw-service-impl-policy=INLINE-CONDITIONAL
      return type Return: implementation-data-type=uint32
      sw service arg ModuleNo: implementation-data-type=uint8
      sw service arg ChannelNo: implementation-data-type=uint8
    Gtm_SetTimTimeoutVal: service-id=0, is-reentrant=true, call-type=REGULAR, execution-context=UNSPECIFIED, sw-service-impl-policy=INLINE-CONDITIONAL
      sw service arg ModuleNo: implementation-data-type=uint8
      sw service arg ChannelNo: implementation-data-type=uint8
      sw service arg TimeOutDuration: implementation-data-type=uint8
    Gtm_EnableTimTimeoutDetection: service-id=0, is-reentrant=true, call-type=REGULAR, execution-context=UNSPECIFIED, sw-service-impl-policy=INLINE-CONDITIONAL
      sw service arg ModuleNo: implementation-data-type=uint8
      sw service arg ChannelNo: implementation-data-type=uint8
    Gtm_DisableTimTimeoutDetection: service-id=0, is-reentrant=true, call-type=REGULAR, execution-context=UNSPECIFIED, sw-service-impl-policy=INLINE-CONDITIONAL
      sw service arg ModuleNo: implementation-data-type=uint8
      sw service arg ChannelNo: implementation-data-type=uint8
    Gtm_SelectTimTimeoutClock: service-id=0, is-reentrant=true, call-type=REGULAR, execution-context=UNSPECIFIED, sw-service-impl-policy=INLINE-CONDITIONAL
      sw service arg ModuleNo: implementation-data-type=uint8
      sw service arg ChannelNo: implementation-data-type=uint8
      sw service arg ClockSource: implementation-data-type=Gtm_ConfigurableClockType
    Gtm_GetTimCurrentTimeoutVal: service-id=0, is-reentrant=true, call-type=REGULAR, execution-context=UNSPECIFIED, sw-service-impl-policy=INLINE-CONDITIONAL
      return type Return: implementation-data-type=uint8
      sw service arg ModuleNo: implementation-data-type=uint8
      sw service arg ChannelNo: implementation-data-type=uint8
    Gtm_EnableTbuChannel: service-id=0, is-reentrant=true, call-type=REGULAR, execution-context=UNSPECIFIED, sw-service-impl-policy=INLINE-CONDITIONAL
      sw service arg TbuChannelNo: implementation-data-type=uint8
    Gtm_DisableTbuChannel: service-id=0, is-reentrant=true, call-type=REGULAR, execution-context=UNSPECIFIED, sw-service-impl-policy=INLINE-CONDITIONAL
      sw service arg TbuChannelNo: implementation-data-type=uint8
    Gtm_EnableTomChannel: service-id=0, is-reentrant=true, call-type=REGULAR, execution-context=UNSPECIFIED, sw-service-impl-policy=INLINE-CONDITIONAL
      sw service arg ModuleNo: implementation-data-type=uint8
      sw service arg ChannelNo: implementation-data-type=uint8
    Gtm_DisableTomChannel: service-id=0, is-reentrant=true, call-type=REGULAR, execution-context=UNSPECIFIED, sw-service-impl-policy=INLINE-CONDITIONAL
      sw service arg ModuleNo: implementation-data-type=uint8
      sw service arg ChannelNo: implementation-data-type=uint8
    Gtm_EnableAtomChannel: service-id=0, is-reentrant=true, call-type=REGULAR, execution-context=UNSPECIFIED, sw-service-impl-policy=INLINE-CONDITIONAL
      sw service arg ModuleNo: implementation-data-type=uint8
      sw service arg ChannelNo: implementation-data-type=uint8
    Gtm_DisableAtomChannel: service-id=0, is-reentrant=true, call-type=REGULAR, execution-context=UNSPECIFIED, sw-service-impl-policy=INLINE-CONDITIONAL
      sw service arg ModuleNo: implementation-data-type=uint8
      sw service arg ChannelNo: implementation-data-type=uint8
    Gtm_AddFifoEntry: service-id=0, is-reentrant=true, call-type=REGULAR, execution-context=UNSPECIFIED, sw-service-impl-policy=INLINE-CONDITIONAL
      sw service arg FifoChannel: implementation-data-type=uint8
      sw service arg Entry: implementation-data-type=uint32
    Gtm_ReadFifoEntry: service-id=0, is-reentrant=true, call-type=REGULAR, execution-context=UNSPECIFIED, sw-service-impl-policy=INLINE-CONDITIONAL
      sw service arg FifoChannel: implementation-data-type=uint8
    Gtm_EnableDpll: service-id=0, is-reentrant=true, call-type=REGULAR, execution-context=UNSPECIFIED, sw-service-impl-policy=INLINE-CONDITIONAL
    Gtm_DisableDpll: service-id=0, is-reentrant=true, call-type=REGULAR, execution-context=UNSPECIFIED, sw-service-impl-policy=INLINE-CONDITIONAL
    Gtm_GetTbuChannelStatus: service-id=0, is-reentrant=true, call-type=REGULAR, execution-context=UNSPECIFIED, sw-service-impl-policy=INLINE-CONDITIONAL
      return type Return: implementation-data-type=boolean
      sw service arg TbuChannelNo: implementation-data-type=uint8
    Gtm_GetTbuTimerValue: service-id=0, is-reentrant=true, call-type=REGULAR, execution-context=UNSPECIFIED, sw-service-impl-policy=INLINE-CONDITIONAL
      return type Return: implementation-data-type=boolean
      sw service arg TbuChannelNo: implementation-data-type=uint8
    Gtm_TrigActTimebase: service-id=0, is-reentrant=true, call-type=REGULAR, execution-context=UNSPECIFIED, sw-service-impl-policy=INLINE-CONDITIONAL
      sw service arg TimerModule: implementation-data-type=uint8
      sw service arg ModuleNo: implementation-data-type=uint8
      sw service arg GroupNo: implementation-data-type=uint8
    Gtm_SetTimFilterThreshold: service-id=0, is-reentrant=true, call-type=REGULAR, execution-context=UNSPECIFIED, sw-service-impl-policy=INLINE-CONDITIONAL
      4 x sw service arg:
        ModuleNo: implementation-data-type=uint8
        ChannelNo: implementation-data-type=uint8
        FltRisingEdge: implementation-data-type=uint32
        FltFallingEdge: implementation-data-type=uint32
    Gtm_GetTimFilterThreshold: service-id=0, is-reentrant=true, call-type=REGULAR, execution-context=UNSPECIFIED, sw-service-impl-policy=INLINE-CONDITIONAL
      sw service arg ModuleNo: implementation-data-type=uint8
      sw service arg ChannelNo: implementation-data-type=uint8
      sw service arg FltValuePtr: category=DATA_REFERENCE, sw-pointer-target-props={target-category=TYPE_REFERENCE, implementation-data-type=Gtm_TimFilterType}
    Gtm_FlushFifo: service-id=0, is-reentrant=true, call-type=REGULAR, execution-context=UNSPECIFIED, sw-service-impl-policy=INLINE-CONDITIONAL
      sw service arg FifoModuleNo: implementation-data-type=uint8
      sw service arg FifoChannelNo: implementation-data-type=uint8
    Gtm_CtrlFifoStream: service-id=0, is-reentrant=true, call-type=REGULAR, execution-context=UNSPECIFIED, sw-service-impl-policy=INLINE-CONDITIONAL
      sw service arg FifoModuleNo: implementation-data-type=uint8
      sw service arg FifoChannelNo: implementation-data-type=uint8
      sw service arg ToStart: implementation-data-type=boolean
    Gtm_ClearMcsRam: service-id=0, is-reentrant=true, call-type=REGULAR, execution-context=UNSPECIFIED, sw-service-impl-policy=INLINE-CONDITIONAL
      sw service arg McsModule: implementation-data-type=uint8
    Gtm_CtrlMcsTrigger: service-id=0, is-reentrant=true, call-type=REGULAR, execution-context=UNSPECIFIED, sw-service-impl-policy=INLINE-CONDITIONAL
      sw service arg McsModule: implementation-data-type=uint8
      sw service arg TriggerNo: implementation-data-type=uint8
      sw service arg TriggerCtrl: implementation-data-type=boolean
    Gtm_TrigDpllSwRst: service-id=0, is-reentrant=true, call-type=REGULAR, execution-context=UNSPECIFIED, sw-service-impl-policy=INLINE-CONDITIONAL
    Gtm_GetDpllStatus: service-id=0, is-reentrant=true, call-type=REGULAR, execution-context=UNSPECIFIED, sw-service-impl-policy=INLINE-CONDITIONAL
      sw service arg StatusPtr: category=DATA_REFERENCE, sw-pointer-target-props={target-category=TYPE_REFERENCE, implementation-data-type=Gtm_DpllStatType}
    Gtm_SetDpllRefMode: service-id=0, is-reentrant=true, call-type=REGULAR, execution-context=UNSPECIFIED, sw-service-impl-policy=INLINE-CONDITIONAL
      sw service arg RefMode: implementation-data-type=uint8
    Gtm_CtrlSpeModule: service-id=0, is-reentrant=true, call-type=REGULAR, execution-context=UNSPECIFIED, sw-service-impl-policy=INLINE-CONDITIONAL
      sw service arg ModuleNo: implementation-data-type=uint8
      sw service arg ToEnable: implementation-data-type=uint8
    Gtm_GetSpeInputPat: service-id=0, is-reentrant=true, call-type=REGULAR, execution-context=UNSPECIFIED, sw-service-impl-policy=INLINE-CONDITIONAL
      return type Return: implementation-data-type=uint16
      sw service arg ModuleNo: implementation-data-type=uint8
    Gtm_CtrlMapInput: service-id=0, is-reentrant=true, call-type=REGULAR, execution-context=UNSPECIFIED, sw-service-impl-policy=INLINE-CONDITIONAL
      sw service arg MapInput: implementation-data-type=uint32
    Gtm_SelectBrcDest: service-id=0, is-reentrant=true, call-type=REGULAR, execution-context=UNSPECIFIED, sw-service-impl-policy=INLINE-CONDITIONAL
      sw service arg SourceNo: implementation-data-type=uint8
      sw service arg SelDest: implementation-data-type=uint32
    Gtm_GetFifoStatus: service-id=0, is-reentrant=true, call-type=REGULAR, execution-context=UNSPECIFIED, sw-service-impl-policy=INLINE-CONDITIONAL
      return type Return: implementation-data-type=uint8
      sw service arg FifoModuleNo: implementation-data-type=uint8
      sw service arg FifoChannelNo: implementation-data-type=uint8
    Gtm_GetMcsRamRstStat: service-id=0, is-reentrant=true, call-type=REGULAR, execution-context=UNSPECIFIED, sw-service-impl-policy=INLINE-CONDITIONAL
      return type Return: implementation-data-type=boolean
      sw service arg McsModule: implementation-data-type=uint8
    Gtm_WriteMcsRam: service-id=0, is-reentrant=true, call-type=REGULAR, execution-context=UNSPECIFIED, sw-service-impl-policy=INLINE-CONDITIONAL
      sw service arg McsStartAddress: category=DATA_REFERENCE, sw-pointer-target-props={target-category=TYPE_REFERENCE, implementation-data-type=uint32}
      sw service arg const: category=DATA_REFERENCE, sw-pointer-target-props={target-category=TYPE_REFERENCE, implementation-data-type=uint32}
      sw service arg CodeSize: implementation-data-type=uint32
    Gtm_CtrlMcsChannel: service-id=0, is-reentrant=true, call-type=REGULAR, execution-context=UNSPECIFIED, sw-service-impl-policy=INLINE-CONDITIONAL
      return type Return: implementation-data-type=boolean
      sw service arg McsModNo: implementation-data-type=uint8
      sw service arg McsChannel: implementation-data-type=uint8
      sw service arg Activity: implementation-data-type=uint8
    Gtm_InitMcsProgCntr: service-id=0, is-reentrant=true, call-type=REGULAR, execution-context=UNSPECIFIED, sw-service-impl-policy=INLINE-CONDITIONAL
      return type Return: implementation-data-type=boolean
      sw service arg McsModNo: implementation-data-type=uint8
      sw service arg McsChannel: implementation-data-type=uint8
      sw service arg PcValue: implementation-data-type=uint32
    Gtm_TrigMcsIntrpt: service-id=0, is-reentrant=true, call-type=REGULAR, execution-context=UNSPECIFIED, sw-service-impl-policy=INLINE-CONDITIONAL
      sw service arg McsModNo: implementation-data-type=uint8
      sw service arg McsChannel: implementation-data-type=uint8
      sw service arg IntrptToTrig: implementation-data-type=uint32
    Gtm_CtrlMcsIntrpt: service-id=0, is-reentrant=true, call-type=REGULAR, execution-context=UNSPECIFIED, sw-service-impl-policy=INLINE-CONDITIONAL
      4 x sw service arg, all with implementation-data-type=uint8:
        McsModNo
        McsChannel
        IntrptToCtrl
        CtrlType
    Gtm_TrigMcsReset: service-id=0, is-reentrant=true, call-type=REGULAR, execution-context=UNSPECIFIED, sw-service-impl-policy=INLINE-CONDITIONAL
      sw service arg McsModNo: implementation-data-type=uint8
      sw service arg ResetVal: implementation-data-type=uint32
    Gtm_GetMcsErrTrigStatus: service-id=0, is-reentrant=true, call-type=REGULAR, execution-context=UNSPECIFIED, sw-service-impl-policy=INLINE-CONDITIONAL
      return type Return: implementation-data-type=uint32
      sw service arg McsModNo: implementation-data-type=uint8
    Gtm_ResetMcsErrStatus: service-id=0, is-reentrant=true, call-type=REGULAR, execution-context=UNSPECIFIED, sw-service-impl-policy=INLINE-CONDITIONAL
      sw service arg McsModNo: implementation-data-type=uint8
      sw service arg McsChannel: implementation-data-type=uint8
    Gtm_InitDpllRam: service-id=0, is-reentrant=true, call-type=REGULAR, execution-context=UNSPECIFIED, sw-service-impl-policy=INLINE-CONDITIONAL
    Gtm_GetTomTimerRegisters: service-id=0, is-reentrant=true, call-type=REGULAR, execution-context=UNSPECIFIED, sw-service-impl-policy=INLINE-CONDITIONAL
      return type Return: implementation-data-type=uint32
      sw service arg ModuleNo: implementation-data-type=uint8
      sw service arg GroupNo: implementation-data-type=uint8
      sw service arg RegName: implementation-data-type=Gtm_TomTimerRegistersType
    Gtm_GetAtomTimerRegisters: service-id=0, is-reentrant=true, call-type=REGULAR, execution-context=UNSPECIFIED, sw-service-impl-policy=INLINE-CONDITIONAL
      return type Return: implementation-data-type=uint32
      sw service arg ModuleNo: implementation-data-type=uint8
      sw service arg GroupNo: implementation-data-type=uint8
      sw service arg RegName: implementation-data-type=Gtm_AtomTimerRegistersType
package /AUTOSAR_Mcu/Implementations
  bsw implementation Mcu: programming-language=C, sw-version=0.0.0, vendor-id=17, ar-release-version=4.0.3, behavior=McuBehavior, vendor-specific-module-def=Mcu
    code-descriptors:
      code Files
        artifact-descriptors:
          short-label=ssc::src::Mcu.c, category=SWSRC
          short-label=ssc::src::Mcu_Ver.c, category=SWSRC
          short-label=ssc::src::Mcu_Platform.c, category=SWSRC
          short-label=ssc::src::Mcu_Crc.c, category=SWSRC
          short-label=ssc::src::Mcu_Dma.c, category=SWSRC
          short-label=ssc::inc::Mcu_Local.h, category=SWHDR
          short-label=ssc::inc::Mcu.h, category=SWHDR
          short-label=ssc::src::Gtm.c, category=SWSRC
          short-label=ssc::src::Gtm_Platform.c, category=SWSRC
          short-label=ssc::inc::Gtm.h, category=SWHDR
          short-label=ssc::inc::Gtm_Local.h, category=SWHDR
          short-label=::mak::mcu_infineon_tricore::ssc::mak::infineon_gtm_cfg.mak, category=SWMAKE
          short-label=::mak::mcu_infineon_tricore::ssc::mak::infineon_gtm_check.mak, category=SWMAKE
          short-label=::mak::mcu_infineon_tricore::ssc::mak::infineon_gtm_defs.mak, category=SWMAKE
          short-label=::mak::mcu_infineon_tricore::ssc::mak::infineon_gtm_rules.mak, category=SWMAKE
          short-label=::mak::mcu_infineon_tricore::ssc::mak::infineon_mcu_check.mak, category=SWMAKE
          short-label=::mak::mcu_infineon_tricore::ssc::mak::infineon_mcu_defs.mak, category=SWMAKE
          short-label=::mak::mcu_infineon_tricore::ssc::mak::infineon_mcu_rules.mak, category=SWMAKE
          short-label=ssc::src::Gtm_Irq.c, category=SWSRC
    compiler TASKING_COMPILE: name=TASKING, options="-c --core=tc1.6.x -t -Wa-gAHLs --emit-locals=-equ,-symbols -Wa-Ogs -Wa--error-limit=42 --iso=90 --eabi-compliant --integer-enumeration --language=-comments,-gcc,+volatile,-strings --switch=auto --align=0 --default-near-size=0 --default-a0-size=0 --default-a1-size=0 -O2ROPYG --tradeoff=4 -g --source -D_TASKING_C_TRICORE_=1 $(CALLFUNCTION)", vendor=Tasking, version=Tasking
    compiler DIAB_COMPILE: name=DIAB, options="-c -tTC27xAstep16PMG:cross -Xdialect-c89 -Xno-common -Xalign-functions=4 -Xfp-fast -Xsection-split=1 -Xkeep-assembly-file=2 -g3 -ew4084 -ei4177,4550,4549,4068,5388 -XO -D_DIABDATA_C_TRICORE_=1 $(CALLFUNCTION)", vendor=WindRiver, version=WindRiver
    compiler GNU_COMPILE:
      name=GNU
      options="-c -save-temps=obj -std=iso9899:1990 -ansi -fno-asm -ffreestanding -Wundef -Wp,-std=iso9899:1990 -fno-short-enums -fpeel-loops -falign-functions=4 -frecord-gcc-switches -fsection-anchors -funsigned-bitfields -ffunction-sections -fno-ivopts -fno-peephole2 -nostartfiles -O3 -g3 -W -Wall -Wuninitialized -DTRIBOARD_TC27XX -mcpu=tc27xx -D_GNU_C_TRICORE_=1 $(CALLFUNCTION)"
      vendor=Hightec
      version=Hightec
    generated-artifacts:
      9 x dependency on artifact, all with usages=CODEGENERATION:
        Mcu_PBCfg_c: artifact-descriptor={short-label=generate::src::Mcu_PBCfg.c, category=SWSRC}
        Mcu_Cfg_h: artifact-descriptor={short-label=generate::inc::Mcu_Cfg.h, category=SWHDR}
        Mcu_xdm: artifact-descriptor={short-label=config::Mcu.xdm, category=SWTOOL}
        Mcu_ConfigDoc_html: artifact-descriptor={short-label=generate::Mcu_ConfigDoc.html, category=SWTOOL}
        Mcu_bmd: artifact-descriptor={short-label=autosar::Mcu.bmd, category=SWTOOL}
        Gtm_PBCfg_c: artifact-descriptor={short-label=generate::src::Gtm_PBCfg.c, category=SWSRC}
        Gtm_LCfg_c: artifact-descriptor={short-label=generate::src::Gtm_LCfg.c, category=SWSRC}
        Gtm_Cfg_h: artifact-descriptor={short-label=generate::inc::Gtm_Cfg.h, category=SWHDR}
        infineon_mcu_cfg_mak: artifact-descriptor={short-label=generate::mak::infineon_mcu_cfg.mak, category=SWTOOL}
    linker TASKING_LINK: name=TASKING, options="-t -d_mcal_pjt.lsl -D__CPU__=tc27x -Cmpe:vtc -Otxycl --error-limit=42 -M -mcrfiklsmnoduq -lc -lfp -lrt", vendor=Tasking, version=Tasking
    linker DIAB_LINK: name=DIAB, options="-m6 "_mcal_pjt.dld" -lc", vendor=WindRiver, version=WindRiver
    linker GNU_LINK: name=GNU, options="-T"_mcal_pjt.ld" -nostartfiles -Wl,--allow-multiple-definition -Wl,--cref -Wl,--oformat=elf32-tricore -Wl,--mcpu=tc161 -Wl,--mem-holes -Wl,--extmap="a"", vendor=Hightec, version=Hightec
    resource consumption ResourceConsumption
      10 x memory section:
        MCU_CONST_32BIT: alignment=32, size=4, sw-addrmethod=CONST
        MCU_VAR_32BIT: alignment=32, size=4, sw-addrmethod=VAR
        MCU_VAR_8BIT: alignment=8, size=2, sw-addrmethod=VAR
        MCU_VAR_INIT_32BIT: alignment=32, size=8, sw-addrmethod=VAR
        MCU_POSTBUILDCFG: alignment=UNSPECIFIED, size=100, sw-addrmethod=CONFIG_DATA
        MCU_CODE: alignment=32, size=2976, sw-addrmethod=CODE
        MCU_SAFETY_CODE: alignment=32, size=1008, sw-addrmethod=CODE
        GTM_CODE: alignment=32, size=5468, sw-addrmethod=CODE
        GTM_VAR_32BIT: alignment=32, size=4, sw-addrmethod=VAR
        GTM_CONST_UNSPECIFIED: alignment=UNSPECIFIED, size=440, sw-addrmethod=CONFIG_DATA
      section name prefix MCU
      section name prefix GTM
package /AUTOSAR_Mcu/ImplementationDataTypes
  17 x impl type, all with type-emitter=BSW:
    Mcu_ConfigType: category=STRUCTURE
      element Mcu_ClockCfgType
    Mcu_RamSectionType: implementation-data-type=uint32
    Mcu_ClockType: implementation-data-type=uint32
    Mcu_ModeType: implementation-data-type=uint32
    Mcu_PllStatusType: compu {0=MCU_PLL_UNLOCKED, 0=MCU_PLL_LOCKED, 0=MCU_PLL_STATUS_UNDEFINED}, implementation-data-type=uint32
    Mcu_RamStateType: compu {0=MCU_RAMSTATE_INVALID, 0=MCU_RAMSTATE_VALID}, implementation-data-type=uint32
    Mcu_RawResetType: implementation-data-type=uint32
    Mcu_ResetType: compu {0=MCU_ESR0_RESET, 0=MCU_ESR1_RESET, 0=MCU_SMU_RESET, 0=MCU_SW_RESET, 0=MCU_STM0_RESET, 0=MCU_STM1_RESET, 0=MCU_STM2_RESET, 0=MCU_POWER_ON_RESET, 0=MCU_CB0_RESET, 0=MCU_CB1_RESET, 0=MCU_CB3_RESET, 0=MCU_TP_RESET, 0=MCU_EVR13_RESET, 0=MCU_EVR33_RESET, 0=MCU_SUPPLY_WDOG_RESET, 0=MCU_STBYR_RESET, 0=MCU_RESET_MULTIPLE, 0=MCU_RESET_UNDEFINED}, implementation-data-type=uint32
    Mcu_ModeStateType: compu {0=MCU_UNDEFINED_MODE, 0=MCU_NORMAL_RUN_MODE, 0=MCU_CPUIDLE_REQ_MODE, 0=MCU_CPUIDLE_ACK_MODE, 0=MCU_SLEEP_REQ_MODE, 0=MCU_STANDBY_REQ_MODE}, implementation-data-type=uint32
    Gtm_ConfigType: category=STRUCTURE
      element Gtm_ClockSettingType
    Gtm_AruReqStatusType: compu {0=GTM_ARU_WRITE_FAILED, 0=GTM_ARU_WRITE_SUCCESSFUL, 0=GTM_ARU_RD_ISSUED_BUT_NOT_CMPLT, 0=GTM_ARU_RD_ISSUED_AND_COMPLETED, 0=GTM_ARU_READ_NOT_ISSUED, 0=GTM_ARU_READ_FAILED, 0=GTM_ARU_READ_SUCCESSFUL, 0=GTM_INCORRECT_REQUEST}, implementation-data-type=uint32
    Gtm_OutputLevelType: compu {0=GTM_LOW, 0=GTM_HIGH}, implementation-data-type=uint32
    Gtm_ConfigurableClockType: compu {0=GTM_CONFIGURABLE_CLK0, 0=GTM_CONFIGURABLE_CLK1, 0=GTM_CONFIGURABLE_CLK2, 0=GTM_CONFIGURABLE_CLK3, 0=GTM_CONFIGURABLE_CLK4, 0=GTM_CONFIGURABLE_CLK5, 0=GTM_CONFIGURABLE_CLK6, 0=GTM_CONFIGURABLE_CLK7}, implementation-data-type=uint32
    Gtm_TimFilterType: category=STRUCTURE
      element uint32
    Gtm_DpllStatType: category=STRUCTURE
      element uint32
    Gtm_TomTimerRegistersType: compu {0=TOM_GLB_CTRL, 0=TOM_ACT_TB, 0=TOM_FUPD_CTRL, 0=TOM_INT_TRIG, 0=TOM_RESERVED_0, 0=TOM_RESERVED_1, 0=TOM_RESERVED_2, 0=TOM_RESERVED_3, 0=TOM_RESERVED_4, 0=TOM_RESERVED_5, 0=TOM_RESERVED_6, 0=TOM_RESERVED_7, 0=TOM_RESERVED_8, 0=TOM_RESERVED_9, 0=TOM_RESERVED_10, 0=TOM_RESERVED_11, 0=TOM_ENDIS_CTRL, 0=TOM_ENDIS_STAT, 0=TOM_OUTEN_CTRL, 0=TOM_OUTEN_STAT}, implementation-data-type=uint32
    Gtm_AtomTimerRegistersType: compu {0=ATOM_GLB_CTRL, 0=ATOM_ENDIS_CTRL, 0=ATOM_ENDIS_STAT, 0=ATOM_ACT_TB, 0=ATOM_OUTEN_CTRL, 0=ATOM_OUTEN_STAT, 0=ATOM_FUPD_CTRL, 0=ATOM_INT_TRIG}, implementation-data-type=uint32
