AUTOSAR XML (schema 4-2-2)
package /ETAS_Project/EcucModuleConfigurationValuess
  module config EcuC
    EcucHardware
      3 x EcucCoreDefinition:
        EcucCore0: EcucCoreId=0, EcucCoreHwRef=(unset)
        EcucCore1: EcucCoreId=1
        EcucCore2: EcucCoreId=2
