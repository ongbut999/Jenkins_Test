AUTOSAR XML (schema 4-2-2)
package /OsCfg/EcucModuleConfigurationValuess
  ecuc value collection Configuration: ecuc-values=Os
  module config OsCfg: definition=Os
    OsOS:
      OsNumberOfCores = 3
      OsScalabilityClass = SC1
      OsStatus = STANDARD
      OsStackMonitoring = true
      OsCyclesPerSecond = 200000000
      OsTicksPerSecond = 100000000
      OsUseResScheduler = true
      OsUseParameterAccess = false
      OsSuppressVectorGen = false
      OsUseGetServiceId = false
      OsHooks: OsStartupHook=true, OsShutdownHook=true, OsPreTaskHook=false, OsPostTaskHook=false, OsStackFaultHook=true, OsProtectionHook=true, OsErrorHook=true
      meter_execution (Param): Value=true
      meter_elapsed_time (Param): Value=true
    OSDEFAULTAPPMODE (OsAppMode)
    Rte_ScheduleTable (OsScheduleTable): OsSchTblAccessingApplication=OsApplication_Core0
      OsScheduleTableSync: OsScheduleTblSyncStrategy=NONE
      rte_Stimulus_1 (OsScheduleTableExpiryPoint)
        TaskActivation8 (OsScheduleTableTaskActivation): OsScheduleTableActivateTaskRef=OsTask_BSW_1ms
    ECU_StartupTask (OsTask):
      OsTaskPriority = 60
      OsTaskSchedule = FULL
      OsTaskActivation = 1
      OsTaskStackAllocation = 2048,2048
      OsTaskAccessingApplication = OsApplication_Core0
      OsTaskResourceRef = RTE_RESOURCE_OS_APP_OsApplication_Core0
      OsTaskAutostart: OsTaskAppModeRef=OSDEFAULTAPPMODE
    GTMTOM0SR0_ISR (OsIsr): OsIsrCategory=CATEGORY_2, OsIsrPriority=254, OsIsrAddress=SRC_GTMTOM00
    OsApplication_Core1 (OsApplication): OsApplicationCoreRef=EcucCore1
      OsApplicationHooks: OsAppStartupHook=false, OsAppShutdownHook=false, OsAppErrorHook=false
    Core1_OsTask_ASW_10ms (OsTask): OsTaskStackAllocation=1024,1024, OsTaskAccessingApplication=OsApplication_Core0, OsTaskResourceRef=RTE_RESOURCE_OS_APP_OsApplication_Core1
    RTE_RESOURCE_OS_APP_OsApplication_Core0 (OsResource): OsResourceProperty=STANDARD, OsResourceAccessingApplication=OsApplication_Core0
    Rte_EA_BSWImpl5_BSWIMPL_Can_CAN_EXCLUSIVE_AREA_0 (OsResource): OsResourceAccessingApplication=OsApplication_Core0
    Core1_OsTask_BSW_10ms (OsTask): OsTaskStackAllocation=512,512, OsTaskAccessingApplication=OsApplication_Core0, OsTaskResourceRef=RTE_RESOURCE_OS_APP_OsApplication_Core1
    OsTask_ASW_100ms (OsTask): OsTaskStackAllocation=512,512, OsTaskResourceRef=RTE_RESOURCE_OS_APP_OsApplication_Core0
    OsApplication_Core0 (OsApplication):
      OsAppIsrRef = GTMTOM0SR0_ISR
      OsAppScheduleTableRef = Rte_ScheduleTable
      OsAppCounterRef = Rte_TickCounter
      OsAppTaskRef = ECU_StartupTask
      OsAppIsrRef = Millisecond
      OsAppTaskRef = OsTask_Background_1ms
      OsApplicationHooks_0 (OsApplicationHooks): OsAppStartupHook=false, OsAppShutdownHook=false, OsAppErrorHook=false
    Rte_TickCounter (OsCounter): OsSecondsPerTick=0.001
    4 x OsTask, all with OsTaskResourceRef=RTE_RESOURCE_OS_APP_OsApplication_Core0:
      BSW_OsTask_SwcRequest: OsTaskStackAllocation=512,512
      OsTask_ASW_10ms: OsTaskStackAllocation=512,512
      OsTask_BSW_10ms: OsTaskStackAllocation=2048,2048
      OsTask_BSW_1ms: OsTaskStackAllocation=512,512, OsTaskAccessingApplication=OsApplication_Core0
    RTE_RESOURCE_OS_APP_OsApplication_Core1 (OsResource): OsResourceProperty=STANDARD, OsResourceAccessingApplication=OsApplication_Core1
    Millisecond (OsIsr): OsIsrCategory=CATEGORY_2, OsIsrPriority=255, OsIsrAddress=SRC_STM0SR0
    OsApplication_Core2 (OsApplication)
      OsApplicationHooks: OsAppStartupHook=false, OsAppShutdownHook=false, OsAppErrorHook=false
    RTE_RESOURCE_OS_APP_OsApplication_Core2 (OsResource): OsResourceProperty=STANDARD, OsResourceAccessingApplication=OsApplication_Core2
    Core2_OsTask_BSW_10ms (OsTask): OsTaskStackAllocation=512,512, OsTaskResourceRef=RTE_RESOURCE_OS_APP_OsApplication_Core2, OsTaskAccessingApplication=OsApplication_Core0
    Core2_OsTask_ASW_10ms (OsTask): OsTaskStackAllocation=512,512, OsTaskResourceRef=RTE_RESOURCE_OS_APP_OsApplication_Core2, OsTaskAccessingApplication=OsApplication_Core0
    OsRTATarget: OsRTATargetName=TriCoreHighTec, OsRTATargetVersion=5.0.22, OsRTATargetVariant=TC27xD
    OsTask_Background_1ms (OsTask): OsTaskPriority=5, OsTaskSchedule=NON, OsTaskActivation=1, OsTaskResourceRef=RTE_RESOURCE_OS_APP_OsApplication_Core0
