// T32 Sat Apr 21 06:44:40 2018

 B::
 
 TOOLBAR ON
 STATUSBAR ON
 FramePOS 52.375,3.2143,,,Maximized
 WinPAGE.RESet
 
 WinPAGE.Create P000
 WinCLEAR
 
 WinPOS 52.75 51.0 54. 14. 0. 1. W002
 WinTABS 26. 26.
 sYmbol.Browse.Function
 
 WinPOS 0.625 51.357 47. 14. 13. 1. W005
 WinTABS 13. 0. 0. 0. 0. 0. 0. 0.
 Break.List
 
 WinPOS 110.38 0.0 62. 46. 0. 0. W003
 PER
 
 WinPOS 177.0 0.0 58. 44. 0. 0. W006
 Var.Watch

 WinPOS 177.5 50.214 58. 16. 5. 0. W001
 Frame /Locals /Caller
 
 WinPOS 111.88 50.429 61. 14. 0. 1. W004
 WinTABS 26. 26.
 sYmbol.Browse.Var
 
 WinPOS 0.0 0.0 106. 45. 13. 1. W000
 WinTABS 10. 10. 25. 62.
 Data.List
 
 WinPOS 1.875 1.0714 32. 3. 0. 0. W007
 CORE.SHOWACTIVE
 
 WinPOS 30.0 17.143 144. 21. 16. 2. W008


 WinPAGE.select P000
 
 ENDDO
