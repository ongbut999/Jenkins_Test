/*
* This is a template file.
*/ ASAP2_VERSION 1 61
/begin PROJECT EntryPlatform_XCP "XCP on CAN in EntryPlatform"
/begin HEADER "" VERSION "0.0.0.0" PROJECT_NO EntryPlatform /end HEADER
/begin MODULE template_A2L ""
/* A2ML - Language definitions */
/begin MOD_COMMON "" DEPOSIT ABSOLUTE BYTE_ORDER MSB_LAST /* big endian */ /end MOD_COMMON
/begin MOD_PAR "" VERSION "Entry_XCP_2" CUSTOMER_NO "" USER "" PHONE_NO "" ECU "MCU" CPU_TYPE "Power Architecture"
 /begin MEMORY_SEGMENT Cal_Data_Seg1 "Application calibration" DATA FLASH INTERN <Address_of_segment: PFLASH0_CALIB> /*WARNING! __calpage_start found in elf file */ /* __calpage_start */ <Size_of_segment: PFLASH0_CALIB> /*WARNING! __calpage_size found in elf file */ /* must equal to size of block used for calibration */ -1 -1 -1 -1 -1
  /begin IF_DATA XCPplus 0x0102
   /begin SEGMENT 0x01 /* segment logical number starts from 0 */ 0x02 /* number of pages */ 0x00 /* address extension */ 0x00 /* compression method */ 0x00 /* encryption method */ /begin CHECKSUM XCP_ADD_14 MAX_BLOCK_SIZE 0x400 /end CHECKSUM
    /begin PAGE 0x00 /* page number - reference page */ ECU_ACCESS_WITH_XCP_ONLY XCP_READ_ACCESS_WITH_ECU_ONLY XCP_WRITE_ACCESS_NOT_ALLOWED INIT_SEGMENT 1 /end PAGE
    /begin PAGE 0x01 /* page number - working page */ ECU_ACCESS_WITH_XCP_ONLY XCP_READ_ACCESS_WITH_ECU_ONLY XCP_WRITE_ACCESS_WITH_ECU_ONLY INIT_SEGMENT 1 /end PAGE
   /end SEGMENT
  /end IF_DATA
 /end MEMORY_SEGMENT
 /begin MEMORY_SEGMENT AppCode "Application code" CODE FLASH INTERN <Address_of_segment: PFLASH0_CPU0_PRIVATE> <Size_of_segment: PFLASH0_CPU0_PRIVATE> /*TODO: use linker value since this varies depending on processor*/ -1 -1 -1 -1 -1
  /begin IF_DATA XCPplus 0x0102
   /begin SEGMENT 0x00 /* segment logical number */ 0x01 /* number of pages */ 0x00 /* address extension */ 0x00 /* compression method */ 0x00 /* encryption method */
    /begin CHECKSUM XCP_ADD_14 /* checksum: add bytes to 32bit result */ MAX_BLOCK_SIZE 0x400 /end CHECKSUM
    /begin PAGE 0x00 /* page number */ ECU_ACCESS_WITH_XCP_ONLY XCP_READ_ACCESS_WITH_ECU_ONLY /*means "tool" page is the same as "ECU" page*/ XCP_WRITE_ACCESS_NOT_ALLOWED INIT_SEGMENT 0 /end PAGE
   /end SEGMENT
  /end IF_DATA
 /end MEMORY_SEGMENT
 /* ******************** end Block Memory Segment ******************** */ /end MOD_PAR
/begin IF_DATA XCPplus 0x0102 /* Include of the generated TL/PL-information */
 /begin XCP_ON_CAN /************************ start of CAN *********************/ 0x0102 /* XCP on CAN version */ CAN_ID_MASTER 0x333 /* CMD/STIM CAN-ID */ /* master -> slave */ CAN_ID_SLAVE 0x777 /* RES/ERR/EV/SERV/DAQ CAN-ID */ /* slave -> master */ /* Bit31= 1: extended identifier */ BAUDRATE 500000 /* BAUDRATE [Hz] */ SAMPLE_POINT 62 /* sample point */ /* [% complete bit time] */ BTL_CYCLES 8 /* BTL_CYCLES */ /* [slots per bit time] */ SJW 1 /* length synchr. segment */ /* [BTL_CYCLES] */ MAX_BUS_LOAD 100 /begin EVENT_CAN_ID_LIST 0 /* reference to EVENT_NUMBER: 10ms */ FIXED 0x778 /end EVENT_CAN_ID_LIST /begin EVENT_CAN_ID_LIST 1 /* reference to EVENT_NUMBER: 100ms */ FIXED 0x77A /end EVENT_CAN_ID_LIST /begin EVENT_CAN_ID_LIST 2 /* reference to EVENT_NUMBER: 50ms */ FIXED 0x779 /end EVENT_CAN_ID_LIST /************************* end of CAN **********************/ /*************** start of PROTOCOL_LAYER *******************/
  /begin PROTOCOL_LAYER /* At MODULE */ 0x0102 /* XCP protocol layer version */ 2000 /* T1 [ms] */ 2000 /* T2 [ms] */ 0 /* T3 [ms] */ 0 /* T4 [ms] */ 0 /* T5 [ms] */ 0 /* T6 [ms] */ 2000 /* T7 [ms] */ 8 /* MAX_CTO */ 8 /* MAX_DTO default for DAQ and STIM */ BYTE_ORDER_MSB_LAST /* BYTE_ORDER: MOTOROLA */ ADDRESS_GRANULARITY_BYTE /* ADDRESS_GRANULARITY */ OPTIONAL_CMD GET_SEED OPTIONAL_CMD UNLOCK OPTIONAL_CMD SET_MTA OPTIONAL_CMD UPLOAD OPTIONAL_CMD SHORT_UPLOAD OPTIONAL_CMD BUILD_CHECKSUM OPTIONAL_CMD DOWNLOAD OPTIONAL_CMD DOWNLOAD_NEXT OPTIONAL_CMD DOWNLOAD_MAX OPTIONAL_CMD SET_CAL_PAGE OPTIONAL_CMD GET_CAL_PAGE OPTIONAL_CMD COPY_CAL_PAGE OPTIONAL_CMD CLEAR_DAQ_LIST OPTIONAL_CMD SET_DAQ_PTR OPTIONAL_CMD WRITE_DAQ OPTIONAL_CMD SET_DAQ_LIST_MODE OPTIONAL_CMD START_STOP_DAQ_LIST OPTIONAL_CMD START_STOP_SYNCH OPTIONAL_CMD GET_DAQ_CLOCK OPTIONAL_CMD READ_DAQ OPTIONAL_CMD GET_DAQ_PROCESSOR_INFO OPTIONAL_CMD GET_DAQ_RESOLUTION_INFO OPTIONAL_CMD GET_DAQ_EVENT_INFO OPTIONAL_CMD FREE_DAQ OPTIONAL_CMD ALLOC_DAQ OPTIONAL_CMD ALLOC_ODT OPTIONAL_CMD ALLOC_ODT_ENTRY COMMUNICATION_MODE_SUPPORTED /* optional modes supported */ BLOCK SLAVE /* Slave Block Mode supported */ MASTER /* Master Block Mode supported */ 255 /* MAX_BS */ 0 /* MIN_ST */ SEED_AND_KEY_EXTERNAL_FUNCTION "XcpSeedNKey.dll" /* Name of the SeedAndKey function */ /* including file extension */ /* without path */ /end PROTOCOL_LAYER
  /***************** end of PROTOCOL_LAYER *******************/ /********************* start of DAQ ************************/
  /begin DAQ /* DAQ supported, at MODULE*/ DYNAMIC /* DAQ_CONFIG_TYPE */ 65535 /* MAX_DAQ */ 3 /* MAX_EVENT_CHANNEL */ 0 /* MIN_DAQ */ OPTIMISATION_TYPE_DEFAULT /* OPTIMISATION_TYPE */ ADDRESS_EXTENSION_FREE /* ADDRESS_EXTENSION */ IDENTIFICATION_FIELD_TYPE_ABSOLUTE /* IDENTIFICATION_FIELD */ GRANULARITY_ODT_ENTRY_SIZE_DAQ_BYTE /* GRANULARITY_ODT_ENTRY_SIZE_DAQ */ 255 /* MAX_ODT_ENTRY_SIZE_DAQ */ OVERLOAD_INDICATION_EVENT /* OVERLOAD_INDICATION */ PRESCALER_SUPPORTED
   /begin TIMESTAMP_SUPPORTED 1 /* TIMESTAMP_TICKS */ SIZE_WORD /* TIMESTAMP_SIZE */ UNIT_1MS /* RESOLUTION OF TIMESTAMP */ /end TIMESTAMP_SUPPORTED
   /begin DAQ_MEMORY_CONSUMPTION 1019 /* DAQ_MEMORY_LIMIT: in Elements[AG] */ 46 /* DAQ_SIZE: number of elements[AG] per DAQ list */ 6 /* ODT_SIZE: number of elements[AG] per ODT */ 5 /* ODT_ENTRY_SIZE: number of elements[AG] per ODT_entry */ 2 /* ODT_DAQ_BUFFER_ELEMENT_SIZE: number of */ /* payload elements[AG]*factor = sizeof(send buffer)[AG] */ 0 /* ODT_STIM_BUFFER_ELEMENT_SIZE: number of */ /* payload elements[AG]*factor = sizeof(receive buffer)[AG] */ /end DAQ_MEMORY_CONSUMPTION
   /******************* start of EVENT ************************/
   /begin EVENT "10msRStr" "10ms" 0 DAQ 1 1 7 /* EVENT_CHANNEL_TIME_UNIT: UNIT_10MS */ 8 /end EVENT
   /begin EVENT "100msRStr" "100ms" 1 DAQ 1 1 8 /* EVENT_CHANNEL_TIME_UNIT: UNIT_100MS */ 10 /end EVENT
   /begin EVENT "50msRStr" "50ms" 2 DAQ 1 5 7 /* EVENT_CHANNEL_TIME_UNIT: UNIT_10MS */ 9 /end EVENT
   /********************* end of EVENT ************************/ /end DAQ
  /********************* end of DAQ **************************/ TRANSPORT_LAYER_INSTANCE "CAN_0_PL0" /end XCP_ON_CAN
/end IF_DATA
/* base address is "Measured_Var" */
/begin MEASUREMENT Measured_Var1 "unsigned integer 32bit" ULONG NO_COMPU_METHOD 0 0 0 ‭4294967295‬ ECU_ADDRESS 0x7000aacc /end MEASUREMENT
/begin MEASUREMENT Measured_Var2 "unsigned integer 32bit" ULONG NO_COMPU_METHOD 0 0 0 ‭4294967295‬ ECU_ADDRESS 0x7000aad0 /end MEASUREMENT
/begin MEASUREMENT Measured_Var3 "unsigned integer 32bit" ULONG NO_COMPU_METHOD 0 0 0 ‭4294967295‬ ECU_ADDRESS 0x7000aad4 /end MEASUREMENT
/begin MEASUREMENT Measured_Var4 "unsigned integer 32bit" ULONG NO_COMPU_METHOD 0 0 0 ‭4294967295‬ ECU_ADDRESS 0x7000aad8 /end MEASUREMENT
/begin MEASUREMENT Measured_Var5 "unsigned integer 32bit" ULONG NO_COMPU_METHOD 0 0 0 ‭4294967295‬ ECU_ADDRESS 0x7000aadc /end MEASUREMENT
/begin MEASUREMENT Measured_Var6 "unsigned integer 32bit" ULONG NO_COMPU_METHOD 0 0 0 ‭4294967295‬ ECU_ADDRESS 0x7000aae0 /end MEASUREMENT
/begin MEASUREMENT Measured_Var7 "unsigned integer 32bit" ULONG NO_COMPU_METHOD 0 0 0 ‭4294967295‬ ECU_ADDRESS 0x7000aae4 /end MEASUREMENT
/begin MEASUREMENT Measured_Var8 "unsigned integer 32bit" ULONG NO_COMPU_METHOD 0 0 0 ‭4294967295‬ ECU_ADDRESS 0x7000aae8 /end MEASUREMENT
/begin MEASUREMENT Measured_Var9 "unsigned integer 32bit" ULONG NO_COMPU_METHOD 0 0 0 ‭4294967295‬ ECU_ADDRESS 0x7000aaec /end MEASUREMENT
/begin MEASUREMENT Measured_Var10 "unsigned integer 32bit" ULONG NO_COMPU_METHOD 0 0 0 ‭4294967295‬ ECU_ADDRESS 0x7000aaf0 /end MEASUREMENT
/begin MEASUREMENT Measured_Var11 "unsigned integer 32bit" ULONG NO_COMPU_METHOD 0 0 0 ‭4294967295‬ ECU_ADDRESS 0x7000aaf4 /end MEASUREMENT
/begin MEASUREMENT Measured_Var12 "unsigned integer 32bit" ULONG NO_COMPU_METHOD 0 0 0 ‭4294967295‬ ECU_ADDRESS 0x7000aaf8 /end MEASUREMENT
/begin MEASUREMENT Measured_Var13 "unsigned integer 32bit" ULONG NO_COMPU_METHOD 0 0 0 ‭4294967295‬ ECU_ADDRESS 0x7000aafc /end MEASUREMENT
/begin MEASUREMENT Measured_Var14 "unsigned integer 32bit" ULONG NO_COMPU_METHOD 0 0 0 ‭4294967295‬ ECU_ADDRESS 0x7000ab00 /end MEASUREMENT
/begin MEASUREMENT Measured_Var15 "unsigned integer 32bit" ULONG NO_COMPU_METHOD 0 0 0 ‭4294967295‬ ECU_ADDRESS 0x7000ab04 /end MEASUREMENT
/begin MEASUREMENT Measured_Var16 "unsigned integer 32bit" ULONG NO_COMPU_METHOD 0 0 0 ‭4294967295‬ ECU_ADDRESS 0x7000ab08 /end MEASUREMENT
/begin MEASUREMENT Measured_Var17 "unsigned integer 32bit" ULONG NO_COMPU_METHOD 0 0 0 ‭4294967295‬ ECU_ADDRESS 0x7000ab0c /end MEASUREMENT
/begin MEASUREMENT Measured_Var18 "unsigned integer 32bit" ULONG NO_COMPU_METHOD 0 0 0 ‭4294967295‬ ECU_ADDRESS 0x7000ab10 /end MEASUREMENT
/begin MEASUREMENT Measured_Var19 "unsigned integer 32bit" ULONG NO_COMPU_METHOD 0 0 0 ‭4294967295‬ ECU_ADDRESS 0x7000ab14 /end MEASUREMENT
/begin MEASUREMENT Measured_Var20 "unsigned integer 32bit" ULONG NO_COMPU_METHOD 0 0 0 ‭4294967295‬ ECU_ADDRESS 0x7000ab18 /end MEASUREMENT
/begin CHARACTERISTIC test_calib1 "unsigned integer 32bit" VALUE 0x801c0000 STANDARD_VALUE_U32 0.0 NO_COMPU_METHOD 0.0 10000.0 /end CHARACTERISTIC
/begin CHARACTERISTIC test_calib2 "unsigned integer 32bit" VALUE 0x801c0004 STANDARD_VALUE_U32 0.0 NO_COMPU_METHOD 0.0 10000.0 /end CHARACTERISTIC
/begin RECORD_LAYOUT STANDARD_VALUE_U32 FNC_VALUES /* description of function value: */ 1 /* position in memory */ ULONG /* data type of the constant */ COLUMN_DIR /* deposited in columns (don't care) */ DIRECT /* direct addressing */ /end RECORD_LAYOUT
/end MODULE
/end PROJECT
