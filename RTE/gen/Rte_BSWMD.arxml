AUTOSAR XML (schema 4-2-2)
standard types defined: Std_ReturnType, uint8, sint16, boolean
package /AUTOSAR_Rte/BswModuleDescriptions
  bsw module description Rte: outgoing-callbacks=[Rte_StartHook_Return, Rte_StartHook_Start, Rte_StopHook_Return, Rte_StopHook_Start, Rte_Task_Activate]
    provided-entrys:
      Rte_ActivateRE
      Rte_Call_ASW_BASE_RPort_BootTarget_GetBootTarget
      Rte_Call_ASW_BASE_RPort_BootTarget_SelectBootTarget
      Rte_Call_ASW_BASE_RPort_SelectShutdownTarget_GetLastShutdownTarget
      Rte_Call_ASW_BASE_RPort_SelectShutdownTarget_GetShutdownCause
      Rte_Call_ASW_BASE_RPort_SelectShutdownTarget_GetShutdownTarget
      Rte_Call_ASW_BASE_RPort_SelectShutdownTarget_SelectShutdownCause
      Rte_Call_ASW_BASE_RPort_SelectShutdownTarget_SelectShutdownTarget
      Rte_Call_ASW_Dem_Event_DemEventParameter_C110117_ClearPrestoredFreezeFrame
      Rte_Call_ASW_Dem_Event_DemEventParameter_C110117_PrestoreFreezeFrame
      Rte_Call_ASW_Dem_Event_DemEventParameter_C110117_ResetEventDebounceStatus
      Rte_Call_ASW_Dem_Event_DemEventParameter_C110117_ResetEventStatus
      Rte_Call_ASW_Dem_Event_DemEventParameter_C110117_SetEventStatus
      Rte_Call_ASW_Dem_Event_DemEventParameter_C110216_ClearPrestoredFreezeFrame
      Rte_Call_ASW_Dem_Event_DemEventParameter_C110216_PrestoreFreezeFrame
      Rte_Call_ASW_Dem_Event_DemEventParameter_C110216_ResetEventDebounceStatus
      Rte_Call_ASW_Dem_Event_DemEventParameter_C110216_ResetEventStatus
      Rte_Call_ASW_Dem_Event_DemEventParameter_C110216_SetEventStatus
      Rte_Call_ASW_Dem_RPort_OpCycle_DemOperationCycle_0_GetOperationCycleState
      Rte_Call_ASW_Dem_RPort_OpCycle_DemOperationCycle_0_SetOperationCycleState
      Rte_Call_ASW_NM_RP_ComM_UserRequest_CAN0_GetCurrentComMode
      Rte_Call_ASW_NM_RP_ComM_UserRequest_CAN0_GetMaxComMode
      Rte_Call_ASW_NM_RP_ComM_UserRequest_CAN0_GetRequestedComMode
      Rte_Call_ASW_NM_RP_ComM_UserRequest_CAN0_RequestComMode
      Rte_Call_ASW_NM_RPort_EcuModeLimitation_LimitECUToNoComMode
      Rte_Call_ASW_NM_RPort_EcuModeLimitation_ReadInhibitCounter
      Rte_Call_ASW_NM_RPort_EcuModeLimitation_ResetInhibitCounter
      Rte_Call_ASW_NM_RPort_EcuModeLimitation_SetECUGroupClassification
      Rte_Call_ASW_NVM_RPort_ASW_NVM_BlockNative_1024_1_EraseBlock
      Rte_Call_ASW_NVM_RPort_ASW_NVM_BlockNative_1024_1_GetDataIndex
      Rte_Call_ASW_NVM_RPort_ASW_NVM_BlockNative_1024_1_GetErrorStatus
      Rte_Call_ASW_NVM_RPort_ASW_NVM_BlockNative_1024_1_InvalidateNvBlock
      Rte_Call_ASW_NVM_RPort_ASW_NVM_BlockNative_1024_1_ReadBlock
      Rte_Call_ASW_NVM_RPort_ASW_NVM_BlockNative_1024_1_RestoreBlockDefaults
      Rte_Call_ASW_NVM_RPort_ASW_NVM_BlockNative_1024_1_SetDataIndex
      Rte_Call_ASW_NVM_RPort_ASW_NVM_BlockNative_1024_1_SetRamBlockStatus
      Rte_Call_ASW_NVM_RPort_ASW_NVM_BlockNative_1024_1_WriteBlock
      Rte_Call_ASW_NVM_RPort_ASW_NVM_BlockNative_1024_2_EraseBlock
      Rte_Call_ASW_NVM_RPort_ASW_NVM_BlockNative_1024_2_GetDataIndex
      Rte_Call_ASW_NVM_RPort_ASW_NVM_BlockNative_1024_2_GetErrorStatus
      Rte_Call_ASW_NVM_RPort_ASW_NVM_BlockNative_1024_2_InvalidateNvBlock
      Rte_Call_ASW_NVM_RPort_ASW_NVM_BlockNative_1024_2_ReadBlock
      Rte_Call_ASW_NVM_RPort_ASW_NVM_BlockNative_1024_2_RestoreBlockDefaults
      Rte_Call_ASW_NVM_RPort_ASW_NVM_BlockNative_1024_2_SetDataIndex
      Rte_Call_ASW_NVM_RPort_ASW_NVM_BlockNative_1024_2_SetRamBlockStatus
      Rte_Call_ASW_NVM_RPort_ASW_NVM_BlockNative_1024_2_WriteBlock
      Rte_Call_ASW_WDG_RPort_Alive_Supervision_Entity1_CheckpointReached
      Rte_Call_Dcm_DataServices_DcmDspData_VacuumPumpPressure_1100_FreezeCurrentState
      Rte_Call_Dcm_DataServices_DcmDspData_VacuumPumpPressure_1100_ReadData
      Rte_Call_Dcm_DataServices_DcmDspData_VacuumPumpPressure_1100_ResetToDefault
      Rte_Call_Dcm_DataServices_DcmDspData_VacuumPumpPressure_1100_ReturnControlToECU
      Rte_Call_Dcm_DataServices_DcmDspData_VacuumPumpPressure_1100_ShortTermAdjustment
      Rte_Call_Dcm_RoutineServices_DcmDspRoutine_DriveVacuumPump_RequestResults
      Rte_Call_Dcm_RoutineServices_DcmDspRoutine_DriveVacuumPump_Start
      Rte_Call_Dcm_RoutineServices_DcmDspRoutine_DriveVacuumPump_Stop
      Rte_Call_Dem_CBStatusComp_DemComponent_Busoff_ComponentStatusChanged
      Rte_Call_Dem_CBStatusComp_DemComponent_C110117_ComponentStatusChanged
      Rte_Call_Dem_CBStatusComp_DemComponent_C110216_ComponentStatusChanged
      Rte_Call_Dem_CBStatusComp_DemComponent_C153364_ComponentStatusChanged
      Rte_Call_Dem_DataServices_DemDataElementClass_SystemFaultRank_ReadData
      Rte_Call_Dem_DataServices_DemDataElementClass_VehicleSpeed_ReadData
      Rte_DecrementWaitingCount
      Rte_GetCurrentTaskIndex
      Rte_MSACbk_SW_11
      Rte_MSACbk_SW_12
      Rte_MainFunction
      Rte_Mode_ASW_BASE_RPort_CurrentMode_CAN0_currentMode
      Rte_ReadQueue
      Rte_Read_ASW_COM_RPort_HCU01_Shift_HCU01_Shift
      Rte_Read_ASW_COM_RPort_HCU01_TqCmd_HCU01_Tq_Cmd
      Rte_Read_ASW_COM_RPort_HCU02_Poweroff_HCU02_Poweroff
      Rte_Read_ASW_COM_RPort_HCU04_Poweroff_HCU04_Poweroff
      Rte_Read_ASW_COM_RPort_HCU05_Poweroff_HCU05_Poweroff
      Rte_Read_ASW_COM_RPott_HCU03_Poweroff_HCU03_Poweroff
      Rte_Read_ASW_Diag_RPort_DataServices_DcmDspData_SystemFaultRank_Write_Data
      Rte_Read_ASW_Diag_RPort_DataServices_DcmDspData_VehicleSpeed_Write_Data
      Rte_Read_BswM_RP_BswMArbitration_BswMSwcModeRequest_AppMode
      Rte_Read_BswM_RP_BswMArbitration_BswM_MRP_SWC_Network_uint8
      Rte_Read_Dcm_R_DataServices_DcmDspData_SystemFaultRank_Data
      Rte_Read_Dcm_R_DataServices_DcmDspData_VehicleSpeed_Data
      Rte_SetEvent
      Rte_Start
      Rte_Stop
      Rte_SwitchAck_WdgM_globalMode_currentMode
      Rte_SwitchAck_WdgM_mode_WdgMSupervisedEntity_Alive_Supervision_Entity1_currentMode
      Rte_Switch_ComM_UM_ComMUser_Can_Network_Channel_currentMode
      Rte_Switch_ComM_UM_ComMUser_Can_Network_XCP_Channel_currentMode
      Rte_Switch_Dcm_Pp_DcmCommunicationControl_ComMChannel_Can_Network_Channel_MDGP_DcmCommunicationControl_ComMChannel_Can_Network_Channel
      Rte_Switch_Dcm_Pp_DcmControlDTCSetting_MDGP_DcmControlDTCSetting
      Rte_Switch_Dcm_Pp_DcmDiagnosticSessionControl_MDGP_DcmDiagnosticSessionControl
      Rte_Switch_Dcm_Pp_DcmEcuReset_MDGP_DcmEcuReset
      Rte_Switch_WdgM_globalMode_currentMode
      Rte_Switch_WdgM_mode_WdgMSupervisedEntity_Alive_Supervision_Entity1_currentMode
      Rte_WaitWithTimeout
      Rte_WriteQueue
      Rte_Write_ASW_BASE_PPort_SwcModeRequest_AppMode
      Rte_Write_ASW_COM_PPort_MCU01_EmergShutDown_MCU01_EmergShutDown
      Rte_Write_ASW_COM_PPort_MCU02_MaxTor_MCU02_MaxTor
      Rte_Write_ASW_COM_PPort_MCU03_NRF_IdcSamp_MCU03_NRF_IdcSamp
      Rte_Write_ASW_COM_PPort_MCU04_Test_MCU04_Test
      Rte_Write_ASW_Diag_P_DataServices_DcmDspData_SystemFaultRank_Read_Data
      Rte_Write_ASW_Diag_P_DataServices_DcmDspData_VehicleSpeed_Read_Data
      Rte_Write_ASW_NM_PP_BswMArbitration_BswM_MRP_Network_uint8
      Rte_Write_ASW_NM_PP_BswMArbitration_BswM_MRP_NmState_uint8
      Rte_Write_Dcm_P_DataServices_DcmDspData_SystemFaultRank_Data
      Rte_Write_Dcm_P_DataServices_DcmDspData_VehicleSpeed_Data
      Rte_memcpy
      SchM_Deinit
      SchM_IModeInit
      SchM_Init
      SchM_Mode_BswM_MDGR_BswM_MRP_BswM_MDG
      SchM_Mode_BswM_MDGR_BswM_MRP_DCM_DiagnosticSessionControl
      SchM_Mode_BswM_MDGR_BswM_MRP_DCM_ModeNotification_EcuReset
      SchM_Mode_Dcm_R_DcmCommunicationControl_ComMChannel_Can_Network_Channel
      SchM_Mode_WdgM_Current_WdgMSupervisionCycle
      SchM_Switch_BswM_MDGP_AUTOSAR_BswM_ModeDeclarationGroups_MDG_ECUM_STATE
      SchM_Switch_Dcm_DcmCommunicationControl_ComMChannel_Can_Network_Channel
      SchM_Switch_Dcm_DcmDiagnosticSessionControl
      SchM_Switch_Dcm_DcmEcuReset
    bsw module dependency AUTOSAR_Os: target-module-id=1
      required-entrys:
        ActivateTask
        GetResource
        ReleaseResource
        ResumeOSInterrupts
        Rte_ResumeOSInterrupts
        Rte_SuspendOSInterrupts
        SuspendOSInterrupts
        TerminateTask
    bsw module dependency AUTOSAR_Com: target-module-id=50, required-entrys=[Com_ReceiveSignal, Com_SendSignal]
      expected-callbacks:
        Rte_COMCbkTOut_HCU01_Shift
        Rte_COMCbkTOut_HCU01_TqCmd
        Rte_COMCbkTOut_HCU{02..05}_Poweroff
        Rte_COMCbk_HCU01_Shift
        Rte_COMCbk_HCU01_TqCmd
        Rte_COMCbk_HCU{02..05}_Poweroff
    bsw internal behavior RteInternalBehavior
      constant-memorys:
        37 x parameter data prototype:
          Rte_Inst_ASW_BASE: type=Rte_CDS_ASW_BASE
          Rte_Inst_ASW_COM: type=Rte_CDS_ASW_COM
          Rte_Inst_ASW_CORE1: type=Rte_CDS_ASW_CORE1
          Rte_Inst_ASW_CORE2: type=Rte_CDS_ASW_CORE2
          Rte_Inst_ASW_Dem: type=Rte_CDS_ASW_Dem
          Rte_Inst_ASW_Diag: type=Rte_CDS_ASW_Diag
          Rte_Inst_ASW_NM: type=Rte_CDS_ASW_NM
          Rte_Inst_ASW_NVM: type=Rte_CDS_ASW_NVM
          Rte_Inst_ASW_WDG: type=Rte_CDS_ASW_WDG
          Rte_Inst_ASW_XCP: type=Rte_CDS_ASW_XCP
          Rte_Inst_BswM: type=Rte_CDS_BswM
          Rte_Inst_ComM: type=Rte_CDS_ComM
          Rte_Inst_Dcm: type=Rte_CDS_Dcm
          Rte_Inst_Dem: type=Rte_CDS_Dem
          Rte_Inst_Det: type=Rte_CDS_Det
          Rte_Inst_EcuM: type=Rte_CDS_EcuM
          Rte_Inst_NvM: type=Rte_CDS_NvM
          Rte_Inst_WdgM: type=Rte_CDS_WdgM
          Rte_Self_CPT_ASW_BASE: type=Rte_SelfType_ASW_BASE
          Rte_Self_CPT_ASW_COM: type=Rte_SelfType_ASW_COM
          Rte_Self_CPT_ASW_CORE1: type=Rte_SelfType_ASW_CORE1
          Rte_Self_CPT_ASW_CORE2: type=Rte_SelfType_ASW_CORE2
          Rte_Self_CPT_ASW_NM: type=Rte_SelfType_ASW_NM
          Rte_Self_CPT_ASW_NVM: type=Rte_SelfType_ASW_NVM
          Rte_Self_CPT_ASW_WDG: type=Rte_SelfType_ASW_WDG
          Rte_Self_CPT_BswM: type=Rte_SelfType_BswM
          Rte_Self_CPT_ComM: type=Rte_SelfType_ComM
          Rte_Self_CPT_Dcm: type=Rte_SelfType_Dcm
          Rte_Self_CPT_Dem: type=Rte_SelfType_Dem
          Rte_Self_CPT_Dem_SWC: type=Rte_SelfType_ASW_Dem
          Rte_Self_CPT_Det: type=Rte_SelfType_Det
          Rte_Self_CPT_Diag: type=Rte_SelfType_ASW_Diag
          Rte_Self_CPT_EcuM: type=Rte_SelfType_EcuM
          Rte_Self_CPT_NvM: type=Rte_SelfType_NvM
          Rte_Self_CPT_Wdg: type=Rte_SelfType_WdgM
          Rte_Self_CPT_XCP: type=Rte_SelfType_ASW_XCP
          Rte_Tasks: type=Rte_TaskInfo
      static-memorys:
        41 x data:
          Rte_ActCount_CPT_BswM_DRE_BswM_Cfg_DfrdSwcReqst_BswMSwcModeRequest: type=Rte_REActCounterType
          Rte_ActCount_CPT_BswM_DRE_BswM_Cfg_DfrdSwcReqst_BswM_MRP_SWC_Network: type=Rte_REActCounterType
          Rte_CPim_ASW_NVM_ASW_NVM_BlockNative_1024_1: type=Rte_PimType_ASW_NVM_ASW_NVM_BlockNative_1024_Type
          Rte_CPim_ASW_NVM_ASW_NVM_BlockNative_1024_2: type=Rte_PimType_ASW_NVM_ASW_NVM_BlockRedundant_1024_Type
          Rte_FbVar_CPT_Wdg_globalMode_currentMode: type=Std_ReturnType
          Rte_FbVar_CPT_Wdg_mode_WdgMSupervisedEntity_Alive_Supervision_Entity1_currentMode: type=Std_ReturnType
          Rte_ModeCurrent_0: type=uint8
          Rte_ModeCurrent_1: type=uint8
          Rte_ModeCurrent_{10..12}: type=uint8
          Rte_ModeCurrent_{2..9}: type=uint8
          Rte_ModeSchMNext_0: type=uint8
          Rte_ModeSchMNext_4: type=uint8
          Rte_ModeSchMNext_5: type=uint8
          Rte_RECount_OsTask_ASW_10ms_divby5_0: type=uint8
          Rte_Rx_000000: type=uint8
          Rte_Rx_000000_status: type=Std_ReturnType
          Rte_Rx_000001: type=sint16
          Rte_Rx_000001_status: type=Std_ReturnType
          Rte_Rx_000002: type=boolean
          Rte_Rx_000002_status: type=Std_ReturnType
          Rte_Rx_000003: type=boolean
          Rte_Rx_000003_status: type=Std_ReturnType
          Rte_Rx_000004: type=boolean
          Rte_Rx_000004_status: type=Std_ReturnType
          Rte_Rx_000005: type=boolean
          Rte_Rx_000005_status: type=Std_ReturnType
          Rte_Rx_000006: type=uint8
          Rte_Rx_000007: type=uint8
          Rte_Rx_000008: type=Dcm_DataArrayTypeUint8_DcmDspData_SystemFaultRankType
          Rte_Rx_000009: type=Dcm_DataArrayTypeUint8_DcmDspData_VehicleSpeedType
          Rte_Rx_000010: type=Dcm_DataArrayTypeUint8_DcmDspData_SystemFaultRankType
          Rte_Rx_000011: type=Dcm_DataArrayTypeUint8_DcmDspData_VehicleSpeedType
      131 x bsw called entity, all with sw-addr-method=CODE:
        Rte_ActivateRE: implemented-entry=Rte_ActivateRE
        Rte_COMCbkTOut_HCU01_Shift: implemented-entry=Rte_COMCbkTOut_HCU01_Shift
        Rte_COMCbkTOut_HCU01_TqCmd: implemented-entry=Rte_COMCbkTOut_HCU01_TqCmd
        Rte_COMCbkTOut_HCU{02..05}_Poweroff: implemented-entry=Rte_COMCbkTOut_HCU{02..05}_Poweroff
        Rte_COMCbk_HCU01_Shift: implemented-entry=Rte_COMCbk_HCU01_Shift
        Rte_COMCbk_HCU01_TqCmd: implemented-entry=Rte_COMCbk_HCU01_TqCmd
        Rte_COMCbk_HCU{02..05}_Poweroff: implemented-entry=Rte_COMCbk_HCU{02..05}_Poweroff
        Rte_Call_ASW_BASE_RPort_BootTarget_GetBootTarget: implemented-entry=Rte_Call_ASW_BASE_RPort_BootTarget_GetBootTarget
        Rte_Call_ASW_BASE_RPort_BootTarget_SelectBootTarget: implemented-entry=Rte_Call_ASW_BASE_RPort_BootTarget_SelectBootTarget
        Rte_Call_ASW_BASE_RPort_SelectShutdownTarget_GetLastShutdownTarget: implemented-entry=Rte_Call_ASW_BASE_RPort_SelectShutdownTarget_GetLastShutdownTarget
        Rte_Call_ASW_BASE_RPort_SelectShutdownTarget_GetShutdownCause: implemented-entry=Rte_Call_ASW_BASE_RPort_SelectShutdownTarget_GetShutdownCause
        Rte_Call_ASW_BASE_RPort_SelectShutdownTarget_GetShutdownTarget: implemented-entry=Rte_Call_ASW_BASE_RPort_SelectShutdownTarget_GetShutdownTarget
        Rte_Call_ASW_BASE_RPort_SelectShutdownTarget_SelectShutdownCause: implemented-entry=Rte_Call_ASW_BASE_RPort_SelectShutdownTarget_SelectShutdownCause
        Rte_Call_ASW_BASE_RPort_SelectShutdownTarget_SelectShutdownTarget: implemented-entry=Rte_Call_ASW_BASE_RPort_SelectShutdownTarget_SelectShutdownTarget
        Rte_Call_ASW_Dem_Event_DemEventParameter_C110117_ClearPrestoredFreezeFrame: implemented-entry=Rte_Call_ASW_Dem_Event_DemEventParameter_C110117_ClearPrestoredFreezeFrame
        Rte_Call_ASW_Dem_Event_DemEventParameter_C110117_PrestoreFreezeFrame: implemented-entry=Rte_Call_ASW_Dem_Event_DemEventParameter_C110117_PrestoreFreezeFrame
        Rte_Call_ASW_Dem_Event_DemEventParameter_C110117_ResetEventDebounceStatus: implemented-entry=Rte_Call_ASW_Dem_Event_DemEventParameter_C110117_ResetEventDebounceStatus
        Rte_Call_ASW_Dem_Event_DemEventParameter_C110117_ResetEventStatus: implemented-entry=Rte_Call_ASW_Dem_Event_DemEventParameter_C110117_ResetEventStatus
        Rte_Call_ASW_Dem_Event_DemEventParameter_C110117_SetEventStatus: implemented-entry=Rte_Call_ASW_Dem_Event_DemEventParameter_C110117_SetEventStatus
        Rte_Call_ASW_Dem_Event_DemEventParameter_C110216_ClearPrestoredFreezeFrame: implemented-entry=Rte_Call_ASW_Dem_Event_DemEventParameter_C110216_ClearPrestoredFreezeFrame
        Rte_Call_ASW_Dem_Event_DemEventParameter_C110216_PrestoreFreezeFrame: implemented-entry=Rte_Call_ASW_Dem_Event_DemEventParameter_C110216_PrestoreFreezeFrame
        Rte_Call_ASW_Dem_Event_DemEventParameter_C110216_ResetEventDebounceStatus: implemented-entry=Rte_Call_ASW_Dem_Event_DemEventParameter_C110216_ResetEventDebounceStatus
        Rte_Call_ASW_Dem_Event_DemEventParameter_C110216_ResetEventStatus: implemented-entry=Rte_Call_ASW_Dem_Event_DemEventParameter_C110216_ResetEventStatus
        Rte_Call_ASW_Dem_Event_DemEventParameter_C110216_SetEventStatus: implemented-entry=Rte_Call_ASW_Dem_Event_DemEventParameter_C110216_SetEventStatus
        Rte_Call_ASW_Dem_RPort_OpCycle_DemOperationCycle_0_GetOperationCycleState: implemented-entry=Rte_Call_ASW_Dem_RPort_OpCycle_DemOperationCycle_0_GetOperationCycleState
        Rte_Call_ASW_Dem_RPort_OpCycle_DemOperationCycle_0_SetOperationCycleState: implemented-entry=Rte_Call_ASW_Dem_RPort_OpCycle_DemOperationCycle_0_SetOperationCycleState
        Rte_Call_ASW_NM_RP_ComM_UserRequest_CAN0_GetCurrentComMode: implemented-entry=Rte_Call_ASW_NM_RP_ComM_UserRequest_CAN0_GetCurrentComMode
        Rte_Call_ASW_NM_RP_ComM_UserRequest_CAN0_GetMaxComMode: implemented-entry=Rte_Call_ASW_NM_RP_ComM_UserRequest_CAN0_GetMaxComMode
        Rte_Call_ASW_NM_RP_ComM_UserRequest_CAN0_GetRequestedComMode: implemented-entry=Rte_Call_ASW_NM_RP_ComM_UserRequest_CAN0_GetRequestedComMode
        Rte_Call_ASW_NM_RP_ComM_UserRequest_CAN0_RequestComMode: implemented-entry=Rte_Call_ASW_NM_RP_ComM_UserRequest_CAN0_RequestComMode
        Rte_Call_ASW_NM_RPort_EcuModeLimitation_LimitECUToNoComMode: implemented-entry=Rte_Call_ASW_NM_RPort_EcuModeLimitation_LimitECUToNoComMode
        Rte_Call_ASW_NM_RPort_EcuModeLimitation_ReadInhibitCounter: implemented-entry=Rte_Call_ASW_NM_RPort_EcuModeLimitation_ReadInhibitCounter
        Rte_Call_ASW_NM_RPort_EcuModeLimitation_ResetInhibitCounter: implemented-entry=Rte_Call_ASW_NM_RPort_EcuModeLimitation_ResetInhibitCounter
        Rte_Call_ASW_NM_RPort_EcuModeLimitation_SetECUGroupClassification: implemented-entry=Rte_Call_ASW_NM_RPort_EcuModeLimitation_SetECUGroupClassification
        Rte_Call_ASW_NVM_RPort_ASW_NVM_BlockNative_1024_1_EraseBlock: implemented-entry=Rte_Call_ASW_NVM_RPort_ASW_NVM_BlockNative_1024_1_EraseBlock
        Rte_Call_ASW_NVM_RPort_ASW_NVM_BlockNative_1024_1_GetDataIndex: implemented-entry=Rte_Call_ASW_NVM_RPort_ASW_NVM_BlockNative_1024_1_GetDataIndex
        Rte_Call_ASW_NVM_RPort_ASW_NVM_BlockNative_1024_1_GetErrorStatus: implemented-entry=Rte_Call_ASW_NVM_RPort_ASW_NVM_BlockNative_1024_1_GetErrorStatus
        Rte_Call_ASW_NVM_RPort_ASW_NVM_BlockNative_1024_1_InvalidateNvBlock: implemented-entry=Rte_Call_ASW_NVM_RPort_ASW_NVM_BlockNative_1024_1_InvalidateNvBlock
        Rte_Call_ASW_NVM_RPort_ASW_NVM_BlockNative_1024_1_ReadBlock: implemented-entry=Rte_Call_ASW_NVM_RPort_ASW_NVM_BlockNative_1024_1_ReadBlock
        Rte_Call_ASW_NVM_RPort_ASW_NVM_BlockNative_1024_1_RestoreBlockDefaults: implemented-entry=Rte_Call_ASW_NVM_RPort_ASW_NVM_BlockNative_1024_1_RestoreBlockDefaults
        Rte_Call_ASW_NVM_RPort_ASW_NVM_BlockNative_1024_1_SetDataIndex: implemented-entry=Rte_Call_ASW_NVM_RPort_ASW_NVM_BlockNative_1024_1_SetDataIndex
        Rte_Call_ASW_NVM_RPort_ASW_NVM_BlockNative_1024_1_SetRamBlockStatus: implemented-entry=Rte_Call_ASW_NVM_RPort_ASW_NVM_BlockNative_1024_1_SetRamBlockStatus
        Rte_Call_ASW_NVM_RPort_ASW_NVM_BlockNative_1024_1_WriteBlock: implemented-entry=Rte_Call_ASW_NVM_RPort_ASW_NVM_BlockNative_1024_1_WriteBlock
        Rte_Call_ASW_NVM_RPort_ASW_NVM_BlockNative_1024_2_EraseBlock: implemented-entry=Rte_Call_ASW_NVM_RPort_ASW_NVM_BlockNative_1024_2_EraseBlock
        Rte_Call_ASW_NVM_RPort_ASW_NVM_BlockNative_1024_2_GetDataIndex: implemented-entry=Rte_Call_ASW_NVM_RPort_ASW_NVM_BlockNative_1024_2_GetDataIndex
        Rte_Call_ASW_NVM_RPort_ASW_NVM_BlockNative_1024_2_GetErrorStatus: implemented-entry=Rte_Call_ASW_NVM_RPort_ASW_NVM_BlockNative_1024_2_GetErrorStatus
        Rte_Call_ASW_NVM_RPort_ASW_NVM_BlockNative_1024_2_InvalidateNvBlock: implemented-entry=Rte_Call_ASW_NVM_RPort_ASW_NVM_BlockNative_1024_2_InvalidateNvBlock
        Rte_Call_ASW_NVM_RPort_ASW_NVM_BlockNative_1024_2_ReadBlock: implemented-entry=Rte_Call_ASW_NVM_RPort_ASW_NVM_BlockNative_1024_2_ReadBlock
        Rte_Call_ASW_NVM_RPort_ASW_NVM_BlockNative_1024_2_RestoreBlockDefaults: implemented-entry=Rte_Call_ASW_NVM_RPort_ASW_NVM_BlockNative_1024_2_RestoreBlockDefaults
        Rte_Call_ASW_NVM_RPort_ASW_NVM_BlockNative_1024_2_SetDataIndex: implemented-entry=Rte_Call_ASW_NVM_RPort_ASW_NVM_BlockNative_1024_2_SetDataIndex
        Rte_Call_ASW_NVM_RPort_ASW_NVM_BlockNative_1024_2_SetRamBlockStatus: implemented-entry=Rte_Call_ASW_NVM_RPort_ASW_NVM_BlockNative_1024_2_SetRamBlockStatus
        Rte_Call_ASW_NVM_RPort_ASW_NVM_BlockNative_1024_2_WriteBlock: implemented-entry=Rte_Call_ASW_NVM_RPort_ASW_NVM_BlockNative_1024_2_WriteBlock
        Rte_Call_ASW_WDG_RPort_Alive_Supervision_Entity1_CheckpointReached: implemented-entry=Rte_Call_ASW_WDG_RPort_Alive_Supervision_Entity1_CheckpointReached
        Rte_Call_Dcm_DataServices_DcmDspData_VacuumPumpPressure_1100_FreezeCurrentState: implemented-entry=Rte_Call_Dcm_DataServices_DcmDspData_VacuumPumpPressure_1100_FreezeCurrentState
        Rte_Call_Dcm_DataServices_DcmDspData_VacuumPumpPressure_1100_ReadData: implemented-entry=Rte_Call_Dcm_DataServices_DcmDspData_VacuumPumpPressure_1100_ReadData
        Rte_Call_Dcm_DataServices_DcmDspData_VacuumPumpPressure_1100_ResetToDefault: implemented-entry=Rte_Call_Dcm_DataServices_DcmDspData_VacuumPumpPressure_1100_ResetToDefault
        Rte_Call_Dcm_DataServices_DcmDspData_VacuumPumpPressure_1100_ReturnControlToECU: implemented-entry=Rte_Call_Dcm_DataServices_DcmDspData_VacuumPumpPressure_1100_ReturnControlToECU
        Rte_Call_Dcm_DataServices_DcmDspData_VacuumPumpPressure_1100_ShortTermAdjustment: implemented-entry=Rte_Call_Dcm_DataServices_DcmDspData_VacuumPumpPressure_1100_ShortTermAdjustment
        Rte_Call_Dcm_RoutineServices_DcmDspRoutine_DriveVacuumPump_RequestResults: implemented-entry=Rte_Call_Dcm_RoutineServices_DcmDspRoutine_DriveVacuumPump_RequestResults
        Rte_Call_Dcm_RoutineServices_DcmDspRoutine_DriveVacuumPump_Start: implemented-entry=Rte_Call_Dcm_RoutineServices_DcmDspRoutine_DriveVacuumPump_Start
        Rte_Call_Dcm_RoutineServices_DcmDspRoutine_DriveVacuumPump_Stop: implemented-entry=Rte_Call_Dcm_RoutineServices_DcmDspRoutine_DriveVacuumPump_Stop
        Rte_Call_Dem_CBStatusComp_DemComponent_Busoff_ComponentStatusChanged: implemented-entry=Rte_Call_Dem_CBStatusComp_DemComponent_Busoff_ComponentStatusChanged
        Rte_Call_Dem_CBStatusComp_DemComponent_C110117_ComponentStatusChanged: implemented-entry=Rte_Call_Dem_CBStatusComp_DemComponent_C110117_ComponentStatusChanged
        Rte_Call_Dem_CBStatusComp_DemComponent_C110216_ComponentStatusChanged: implemented-entry=Rte_Call_Dem_CBStatusComp_DemComponent_C110216_ComponentStatusChanged
        Rte_Call_Dem_CBStatusComp_DemComponent_C153364_ComponentStatusChanged: implemented-entry=Rte_Call_Dem_CBStatusComp_DemComponent_C153364_ComponentStatusChanged
        Rte_Call_Dem_DataServices_DemDataElementClass_SystemFaultRank_ReadData: implemented-entry=Rte_Call_Dem_DataServices_DemDataElementClass_SystemFaultRank_ReadData
        Rte_Call_Dem_DataServices_DemDataElementClass_VehicleSpeed_ReadData: implemented-entry=Rte_Call_Dem_DataServices_DemDataElementClass_VehicleSpeed_ReadData
        Rte_DecrementWaitingCount: implemented-entry=Rte_DecrementWaitingCount
        Rte_GetCurrentTaskIndex: implemented-entry=Rte_GetCurrentTaskIndex
        Rte_MSACbk_SW_11: implemented-entry=Rte_MSACbk_SW_11
        Rte_MSACbk_SW_12: implemented-entry=Rte_MSACbk_SW_12
        Rte_MainFunction: implemented-entry=Rte_MainFunction
        Rte_Mode_ASW_BASE_RPort_CurrentMode_CAN0_currentMode: implemented-entry=Rte_Mode_ASW_BASE_RPort_CurrentMode_CAN0_currentMode
        Rte_ReadQueue: implemented-entry=Rte_ReadQueue
        Rte_Read_ASW_COM_RPort_HCU01_Shift_HCU01_Shift: implemented-entry=Rte_Read_ASW_COM_RPort_HCU01_Shift_HCU01_Shift
        Rte_Read_ASW_COM_RPort_HCU01_TqCmd_HCU01_Tq_Cmd: implemented-entry=Rte_Read_ASW_COM_RPort_HCU01_TqCmd_HCU01_Tq_Cmd
        Rte_Read_ASW_COM_RPort_HCU02_Poweroff_HCU02_Poweroff: implemented-entry=Rte_Read_ASW_COM_RPort_HCU02_Poweroff_HCU02_Poweroff
        Rte_Read_ASW_COM_RPort_HCU04_Poweroff_HCU04_Poweroff: implemented-entry=Rte_Read_ASW_COM_RPort_HCU04_Poweroff_HCU04_Poweroff
        Rte_Read_ASW_COM_RPort_HCU05_Poweroff_HCU05_Poweroff: implemented-entry=Rte_Read_ASW_COM_RPort_HCU05_Poweroff_HCU05_Poweroff
        Rte_Read_ASW_COM_RPott_HCU03_Poweroff_HCU03_Poweroff: implemented-entry=Rte_Read_ASW_COM_RPott_HCU03_Poweroff_HCU03_Poweroff
        Rte_Read_ASW_Diag_RPort_DataServices_DcmDspData_SystemFaultRank_Write_Data: implemented-entry=Rte_Read_ASW_Diag_RPort_DataServices_DcmDspData_SystemFaultRank_Write_Data
        Rte_Read_ASW_Diag_RPort_DataServices_DcmDspData_VehicleSpeed_Write_Data: implemented-entry=Rte_Read_ASW_Diag_RPort_DataServices_DcmDspData_VehicleSpeed_Write_Data
        Rte_Read_BswM_RP_BswMArbitration_BswMSwcModeRequest_AppMode: implemented-entry=Rte_Read_BswM_RP_BswMArbitration_BswMSwcModeRequest_AppMode
        Rte_Read_BswM_RP_BswMArbitration_BswM_MRP_SWC_Network_uint8: implemented-entry=Rte_Read_BswM_RP_BswMArbitration_BswM_MRP_SWC_Network_uint8
        Rte_Read_Dcm_R_DataServices_DcmDspData_SystemFaultRank_Data: implemented-entry=Rte_Read_Dcm_R_DataServices_DcmDspData_SystemFaultRank_Data
        Rte_Read_Dcm_R_DataServices_DcmDspData_VehicleSpeed_Data: implemented-entry=Rte_Read_Dcm_R_DataServices_DcmDspData_VehicleSpeed_Data
        Rte_SetEvent: implemented-entry=Rte_SetEvent
        Rte_Start: implemented-entry=Rte_Start
        Rte_Stop: implemented-entry=Rte_Stop
        Rte_SwitchAck_WdgM_globalMode_currentMode: implemented-entry=Rte_SwitchAck_WdgM_globalMode_currentMode
        Rte_SwitchAck_WdgM_mode_WdgMSupervisedEntity_Alive_Supervision_Entity1_currentMode: implemented-entry=Rte_SwitchAck_WdgM_mode_WdgMSupervisedEntity_Alive_Supervision_Entity1_currentMode
        Rte_Switch_ComM_UM_ComMUser_Can_Network_Channel_currentMode: implemented-entry=Rte_Switch_ComM_UM_ComMUser_Can_Network_Channel_currentMode
        Rte_Switch_ComM_UM_ComMUser_Can_Network_XCP_Channel_currentMode: implemented-entry=Rte_Switch_ComM_UM_ComMUser_Can_Network_XCP_Channel_currentMode
        Rte_Switch_Dcm_Pp_DcmCommunicationControl_ComMChannel_Can_Network_Channel_MDGP_DcmCommunicationControl_ComMChannel_Can_Network_Channel: implemented-entry=Rte_Switch_Dcm_Pp_DcmCommunicationControl_ComMChannel_Can_Network_Channel_MDGP_DcmCommunicationControl_ComMChannel_Can_Network_Channel
        Rte_Switch_Dcm_Pp_DcmControlDTCSetting_MDGP_DcmControlDTCSetting: implemented-entry=Rte_Switch_Dcm_Pp_DcmControlDTCSetting_MDGP_DcmControlDTCSetting
        Rte_Switch_Dcm_Pp_DcmDiagnosticSessionControl_MDGP_DcmDiagnosticSessionControl: implemented-entry=Rte_Switch_Dcm_Pp_DcmDiagnosticSessionControl_MDGP_DcmDiagnosticSessionControl
        Rte_Switch_Dcm_Pp_DcmEcuReset_MDGP_DcmEcuReset: implemented-entry=Rte_Switch_Dcm_Pp_DcmEcuReset_MDGP_DcmEcuReset
        Rte_Switch_WdgM_globalMode_currentMode: implemented-entry=Rte_Switch_WdgM_globalMode_currentMode
        Rte_Switch_WdgM_mode_WdgMSupervisedEntity_Alive_Supervision_Entity1_currentMode: implemented-entry=Rte_Switch_WdgM_mode_WdgMSupervisedEntity_Alive_Supervision_Entity1_currentMode
        Rte_WaitWithTimeout: implemented-entry=Rte_WaitWithTimeout
        Rte_WriteQueue: implemented-entry=Rte_WriteQueue
        Rte_Write_ASW_BASE_PPort_SwcModeRequest_AppMode: implemented-entry=Rte_Write_ASW_BASE_PPort_SwcModeRequest_AppMode
        Rte_Write_ASW_COM_PPort_MCU01_EmergShutDown_MCU01_EmergShutDown: implemented-entry=Rte_Write_ASW_COM_PPort_MCU01_EmergShutDown_MCU01_EmergShutDown
        Rte_Write_ASW_COM_PPort_MCU02_MaxTor_MCU02_MaxTor: implemented-entry=Rte_Write_ASW_COM_PPort_MCU02_MaxTor_MCU02_MaxTor
        Rte_Write_ASW_COM_PPort_MCU03_NRF_IdcSamp_MCU03_NRF_IdcSamp: implemented-entry=Rte_Write_ASW_COM_PPort_MCU03_NRF_IdcSamp_MCU03_NRF_IdcSamp
        Rte_Write_ASW_COM_PPort_MCU04_Test_MCU04_Test: implemented-entry=Rte_Write_ASW_COM_PPort_MCU04_Test_MCU04_Test
        Rte_Write_ASW_Diag_P_DataServices_DcmDspData_SystemFaultRank_Read_Data: implemented-entry=Rte_Write_ASW_Diag_P_DataServices_DcmDspData_SystemFaultRank_Read_Data
        Rte_Write_ASW_Diag_P_DataServices_DcmDspData_VehicleSpeed_Read_Data: implemented-entry=Rte_Write_ASW_Diag_P_DataServices_DcmDspData_VehicleSpeed_Read_Data
        Rte_Write_ASW_NM_PP_BswMArbitration_BswM_MRP_Network_uint8: implemented-entry=Rte_Write_ASW_NM_PP_BswMArbitration_BswM_MRP_Network_uint8
        Rte_Write_ASW_NM_PP_BswMArbitration_BswM_MRP_NmState_uint8: implemented-entry=Rte_Write_ASW_NM_PP_BswMArbitration_BswM_MRP_NmState_uint8
        Rte_Write_Dcm_P_DataServices_DcmDspData_SystemFaultRank_Data: implemented-entry=Rte_Write_Dcm_P_DataServices_DcmDspData_SystemFaultRank_Data
        Rte_Write_Dcm_P_DataServices_DcmDspData_VehicleSpeed_Data: implemented-entry=Rte_Write_Dcm_P_DataServices_DcmDspData_VehicleSpeed_Data
        Rte_memcpy: implemented-entry=Rte_memcpy
        SchM_Deinit: implemented-entry=SchM_Deinit
        SchM_IModeInit: implemented-entry=SchM_IModeInit
        SchM_Init: implemented-entry=SchM_Init
        SchM_Mode_BswM_MDGR_BswM_MRP_BswM_MDG: implemented-entry=SchM_Mode_BswM_MDGR_BswM_MRP_BswM_MDG
        SchM_Mode_BswM_MDGR_BswM_MRP_DCM_DiagnosticSessionControl: implemented-entry=SchM_Mode_BswM_MDGR_BswM_MRP_DCM_DiagnosticSessionControl
        SchM_Mode_BswM_MDGR_BswM_MRP_DCM_ModeNotification_EcuReset: implemented-entry=SchM_Mode_BswM_MDGR_BswM_MRP_DCM_ModeNotification_EcuReset
        SchM_Mode_Dcm_R_DcmCommunicationControl_ComMChannel_Can_Network_Channel: implemented-entry=SchM_Mode_Dcm_R_DcmCommunicationControl_ComMChannel_Can_Network_Channel
        SchM_Mode_WdgM_Current_WdgMSupervisionCycle: implemented-entry=SchM_Mode_WdgM_Current_WdgMSupervisionCycle
        SchM_Switch_BswM_MDGP_AUTOSAR_BswM_ModeDeclarationGroups_MDG_ECUM_STATE: implemented-entry=SchM_Switch_BswM_MDGP_AUTOSAR_BswM_ModeDeclarationGroups_MDG_ECUM_STATE
        SchM_Switch_Dcm_DcmCommunicationControl_ComMChannel_Can_Network_Channel: implemented-entry=SchM_Switch_Dcm_DcmCommunicationControl_ComMChannel_Can_Network_Channel
        SchM_Switch_Dcm_DcmDiagnosticSessionControl: implemented-entry=SchM_Switch_Dcm_DcmDiagnosticSessionControl
        SchM_Switch_Dcm_DcmEcuReset: implemented-entry=SchM_Switch_Dcm_DcmEcuReset
package /AUTOSAR_Rte/BswModuleEntrys
  124 x bsw module entry:
    Rte_ActivateRE: call-type=REGULAR
    Rte_Call_ASW_BASE_RPort_BootTarget_GetBootTarget: call-type=REGULAR
    Rte_Call_ASW_BASE_RPort_BootTarget_SelectBootTarget: call-type=REGULAR
    Rte_Call_ASW_BASE_RPort_SelectShutdownTarget_GetLastShutdownTarget: call-type=REGULAR
    Rte_Call_ASW_BASE_RPort_SelectShutdownTarget_GetShutdownCause: call-type=REGULAR
    Rte_Call_ASW_BASE_RPort_SelectShutdownTarget_GetShutdownTarget: call-type=REGULAR
    Rte_Call_ASW_BASE_RPort_SelectShutdownTarget_SelectShutdownCause: call-type=REGULAR
    Rte_Call_ASW_BASE_RPort_SelectShutdownTarget_SelectShutdownTarget: call-type=REGULAR
    Rte_Call_ASW_Dem_Event_DemEventParameter_C110117_ClearPrestoredFreezeFrame: call-type=REGULAR
    Rte_Call_ASW_Dem_Event_DemEventParameter_C110117_PrestoreFreezeFrame: call-type=REGULAR
    Rte_Call_ASW_Dem_Event_DemEventParameter_C110117_ResetEventDebounceStatus: call-type=REGULAR
    Rte_Call_ASW_Dem_Event_DemEventParameter_C110117_ResetEventStatus: call-type=REGULAR
    Rte_Call_ASW_Dem_Event_DemEventParameter_C110117_SetEventStatus: call-type=REGULAR
    Rte_Call_ASW_Dem_Event_DemEventParameter_C110216_ClearPrestoredFreezeFrame: call-type=REGULAR
    Rte_Call_ASW_Dem_Event_DemEventParameter_C110216_PrestoreFreezeFrame: call-type=REGULAR
    Rte_Call_ASW_Dem_Event_DemEventParameter_C110216_ResetEventDebounceStatus: call-type=REGULAR
    Rte_Call_ASW_Dem_Event_DemEventParameter_C110216_ResetEventStatus: call-type=REGULAR
    Rte_Call_ASW_Dem_Event_DemEventParameter_C110216_SetEventStatus: call-type=REGULAR
    Rte_Call_ASW_Dem_RPort_OpCycle_DemOperationCycle_0_GetOperationCycleState: call-type=REGULAR
    Rte_Call_ASW_Dem_RPort_OpCycle_DemOperationCycle_0_SetOperationCycleState: call-type=REGULAR
    Rte_Call_ASW_NM_RP_ComM_UserRequest_CAN0_GetCurrentComMode: call-type=REGULAR
    Rte_Call_ASW_NM_RP_ComM_UserRequest_CAN0_GetMaxComMode: call-type=REGULAR
    Rte_Call_ASW_NM_RP_ComM_UserRequest_CAN0_GetRequestedComMode: call-type=REGULAR
    Rte_Call_ASW_NM_RP_ComM_UserRequest_CAN0_RequestComMode: call-type=REGULAR
    Rte_Call_ASW_NM_RPort_EcuModeLimitation_LimitECUToNoComMode: call-type=REGULAR
    Rte_Call_ASW_NM_RPort_EcuModeLimitation_ReadInhibitCounter: call-type=REGULAR
    Rte_Call_ASW_NM_RPort_EcuModeLimitation_ResetInhibitCounter: call-type=REGULAR
    Rte_Call_ASW_NM_RPort_EcuModeLimitation_SetECUGroupClassification: call-type=REGULAR
    Rte_Call_ASW_NVM_RPort_ASW_NVM_BlockNative_1024_1_EraseBlock: call-type=REGULAR
    Rte_Call_ASW_NVM_RPort_ASW_NVM_BlockNative_1024_1_GetDataIndex: call-type=REGULAR
    Rte_Call_ASW_NVM_RPort_ASW_NVM_BlockNative_1024_1_GetErrorStatus: call-type=REGULAR
    Rte_Call_ASW_NVM_RPort_ASW_NVM_BlockNative_1024_1_InvalidateNvBlock: call-type=REGULAR
    Rte_Call_ASW_NVM_RPort_ASW_NVM_BlockNative_1024_1_ReadBlock: call-type=REGULAR
    Rte_Call_ASW_NVM_RPort_ASW_NVM_BlockNative_1024_1_RestoreBlockDefaults: call-type=REGULAR
    Rte_Call_ASW_NVM_RPort_ASW_NVM_BlockNative_1024_1_SetDataIndex: call-type=REGULAR
    Rte_Call_ASW_NVM_RPort_ASW_NVM_BlockNative_1024_1_SetRamBlockStatus: call-type=REGULAR
    Rte_Call_ASW_NVM_RPort_ASW_NVM_BlockNative_1024_1_WriteBlock: call-type=REGULAR
    Rte_Call_ASW_NVM_RPort_ASW_NVM_BlockNative_1024_2_EraseBlock: call-type=REGULAR
    Rte_Call_ASW_NVM_RPort_ASW_NVM_BlockNative_1024_2_GetDataIndex: call-type=REGULAR
    Rte_Call_ASW_NVM_RPort_ASW_NVM_BlockNative_1024_2_GetErrorStatus: call-type=REGULAR
    Rte_Call_ASW_NVM_RPort_ASW_NVM_BlockNative_1024_2_InvalidateNvBlock: call-type=REGULAR
    Rte_Call_ASW_NVM_RPort_ASW_NVM_BlockNative_1024_2_ReadBlock: call-type=REGULAR
    Rte_Call_ASW_NVM_RPort_ASW_NVM_BlockNative_1024_2_RestoreBlockDefaults: call-type=REGULAR
    Rte_Call_ASW_NVM_RPort_ASW_NVM_BlockNative_1024_2_SetDataIndex: call-type=REGULAR
    Rte_Call_ASW_NVM_RPort_ASW_NVM_BlockNative_1024_2_SetRamBlockStatus: call-type=REGULAR
    Rte_Call_ASW_NVM_RPort_ASW_NVM_BlockNative_1024_2_WriteBlock: call-type=REGULAR
    Rte_Call_ASW_WDG_RPort_Alive_Supervision_Entity1_CheckpointReached: call-type=REGULAR
    Rte_Call_Dcm_DataServices_DcmDspData_VacuumPumpPressure_1100_FreezeCurrentState: call-type=REGULAR
    Rte_Call_Dcm_DataServices_DcmDspData_VacuumPumpPressure_1100_ReadData: call-type=REGULAR
    Rte_Call_Dcm_DataServices_DcmDspData_VacuumPumpPressure_1100_ResetToDefault: call-type=REGULAR
    Rte_Call_Dcm_DataServices_DcmDspData_VacuumPumpPressure_1100_ReturnControlToECU: call-type=REGULAR
    Rte_Call_Dcm_DataServices_DcmDspData_VacuumPumpPressure_1100_ShortTermAdjustment: call-type=REGULAR
    Rte_Call_Dcm_RoutineServices_DcmDspRoutine_DriveVacuumPump_RequestResults: call-type=REGULAR
    Rte_Call_Dcm_RoutineServices_DcmDspRoutine_DriveVacuumPump_Start: call-type=REGULAR
    Rte_Call_Dcm_RoutineServices_DcmDspRoutine_DriveVacuumPump_Stop: call-type=REGULAR
    Rte_Call_Dem_CBStatusComp_DemComponent_Busoff_ComponentStatusChanged: call-type=REGULAR
    Rte_Call_Dem_CBStatusComp_DemComponent_C110117_ComponentStatusChanged: call-type=REGULAR
    Rte_Call_Dem_CBStatusComp_DemComponent_C110216_ComponentStatusChanged: call-type=REGULAR
    Rte_Call_Dem_CBStatusComp_DemComponent_C153364_ComponentStatusChanged: call-type=REGULAR
    Rte_Call_Dem_DataServices_DemDataElementClass_SystemFaultRank_ReadData: call-type=REGULAR
    Rte_Call_Dem_DataServices_DemDataElementClass_VehicleSpeed_ReadData: call-type=REGULAR
    Rte_DecrementWaitingCount: call-type=REGULAR
    Rte_GetCurrentTaskIndex: call-type=REGULAR
    Rte_MSACbk_SW_11: call-type=REGULAR
    Rte_MSACbk_SW_12: call-type=REGULAR
    Rte_MainFunction: call-type=REGULAR
    Rte_Mode_ASW_BASE_RPort_CurrentMode_CAN0_currentMode: call-type=REGULAR
    Rte_ReadQueue: call-type=REGULAR
    Rte_Read_ASW_COM_RPort_HCU01_Shift_HCU01_Shift: call-type=REGULAR
    Rte_Read_ASW_COM_RPort_HCU01_TqCmd_HCU01_Tq_Cmd: call-type=REGULAR
    Rte_Read_ASW_COM_RPort_HCU02_Poweroff_HCU02_Poweroff: call-type=REGULAR
    Rte_Read_ASW_COM_RPort_HCU04_Poweroff_HCU04_Poweroff: call-type=REGULAR
    Rte_Read_ASW_COM_RPort_HCU05_Poweroff_HCU05_Poweroff: call-type=REGULAR
    Rte_Read_ASW_COM_RPott_HCU03_Poweroff_HCU03_Poweroff: call-type=REGULAR
    Rte_Read_ASW_Diag_RPort_DataServices_DcmDspData_SystemFaultRank_Write_Data: call-type=REGULAR
    Rte_Read_ASW_Diag_RPort_DataServices_DcmDspData_VehicleSpeed_Write_Data: call-type=REGULAR
    Rte_Read_BswM_RP_BswMArbitration_BswMSwcModeRequest_AppMode: call-type=REGULAR
    Rte_Read_BswM_RP_BswMArbitration_BswM_MRP_SWC_Network_uint8: call-type=REGULAR
    Rte_Read_Dcm_R_DataServices_DcmDspData_SystemFaultRank_Data: call-type=REGULAR
    Rte_Read_Dcm_R_DataServices_DcmDspData_VehicleSpeed_Data: call-type=REGULAR
    Rte_SetEvent: call-type=REGULAR
    Rte_Start: call-type=REGULAR
    Rte_StartHook_Return: call-type=CALLBACK
    Rte_StartHook_Start: call-type=CALLBACK
    Rte_Stop: call-type=REGULAR
    Rte_StopHook_Return: call-type=CALLBACK
    Rte_StopHook_Start: call-type=CALLBACK
    Rte_SwitchAck_WdgM_globalMode_currentMode: call-type=REGULAR
    Rte_SwitchAck_WdgM_mode_WdgMSupervisedEntity_Alive_Supervision_Entity1_currentMode: call-type=REGULAR
    Rte_Switch_ComM_UM_ComMUser_Can_Network_Channel_currentMode: call-type=REGULAR
    Rte_Switch_ComM_UM_ComMUser_Can_Network_XCP_Channel_currentMode: call-type=REGULAR
    Rte_Switch_Dcm_Pp_DcmCommunicationControl_ComMChannel_Can_Network_Channel_MDGP_DcmCommunicationControl_ComMChannel_Can_Network_Channel: call-type=REGULAR
    Rte_Switch_Dcm_Pp_DcmControlDTCSetting_MDGP_DcmControlDTCSetting: call-type=REGULAR
    Rte_Switch_Dcm_Pp_DcmDiagnosticSessionControl_MDGP_DcmDiagnosticSessionControl: call-type=REGULAR
    Rte_Switch_Dcm_Pp_DcmEcuReset_MDGP_DcmEcuReset: call-type=REGULAR
    Rte_Switch_WdgM_globalMode_currentMode: call-type=REGULAR
    Rte_Switch_WdgM_mode_WdgMSupervisedEntity_Alive_Supervision_Entity1_currentMode: call-type=REGULAR
    Rte_Task_Activate: call-type=CALLBACK
    Rte_WaitWithTimeout: call-type=REGULAR
    Rte_WriteQueue: call-type=REGULAR
    Rte_Write_ASW_BASE_PPort_SwcModeRequest_AppMode: call-type=REGULAR
    Rte_Write_ASW_COM_PPort_MCU01_EmergShutDown_MCU01_EmergShutDown: call-type=REGULAR
    Rte_Write_ASW_COM_PPort_MCU02_MaxTor_MCU02_MaxTor: call-type=REGULAR
    Rte_Write_ASW_COM_PPort_MCU03_NRF_IdcSamp_MCU03_NRF_IdcSamp: call-type=REGULAR
    Rte_Write_ASW_COM_PPort_MCU04_Test_MCU04_Test: call-type=REGULAR
    Rte_Write_ASW_Diag_P_DataServices_DcmDspData_SystemFaultRank_Read_Data: call-type=REGULAR
    Rte_Write_ASW_Diag_P_DataServices_DcmDspData_VehicleSpeed_Read_Data: call-type=REGULAR
    Rte_Write_ASW_NM_PP_BswMArbitration_BswM_MRP_Network_uint8: call-type=REGULAR
    Rte_Write_ASW_NM_PP_BswMArbitration_BswM_MRP_NmState_uint8: call-type=REGULAR
    Rte_Write_Dcm_P_DataServices_DcmDspData_SystemFaultRank_Data: call-type=REGULAR
    Rte_Write_Dcm_P_DataServices_DcmDspData_VehicleSpeed_Data: call-type=REGULAR
    Rte_memcpy: call-type=REGULAR
    SchM_Deinit: call-type=REGULAR
    SchM_IModeInit: call-type=REGULAR
    SchM_Init: call-type=REGULAR
    SchM_Mode_BswM_MDGR_BswM_MRP_BswM_MDG: call-type=REGULAR
    SchM_Mode_BswM_MDGR_BswM_MRP_DCM_DiagnosticSessionControl: call-type=REGULAR
    SchM_Mode_BswM_MDGR_BswM_MRP_DCM_ModeNotification_EcuReset: call-type=REGULAR
    SchM_Mode_Dcm_R_DcmCommunicationControl_ComMChannel_Can_Network_Channel: call-type=REGULAR
    SchM_Mode_WdgM_Current_WdgMSupervisionCycle: call-type=REGULAR
    SchM_Switch_BswM_MDGP_AUTOSAR_BswM_ModeDeclarationGroups_MDG_ECUM_STATE: call-type=REGULAR
    SchM_Switch_Dcm_DcmCommunicationControl_ComMChannel_Can_Network_Channel: call-type=REGULAR
    SchM_Switch_Dcm_DcmDiagnosticSessionControl: call-type=REGULAR
    SchM_Switch_Dcm_DcmEcuReset: call-type=REGULAR
package /AUTOSAR_Rte/BswImplementations
  bsw implementation Rte: programming-language=C, sw-version=0.0.0, used-code-generator=ETAS RTEGen, ar-release-version=4.0.0, behavior=RteInternalBehavior
    generated-artifacts:
      116 x dependency on artifact:
        ASW_BASE_MemMap_h: artifact-descriptor={short-label=ASW_BASE_MemMap_h, category=SWHDR, domain=AUTOSAR}
        ASW_COM_MemMap_h: artifact-descriptor={short-label=ASW_COM_MemMap_h, category=SWHDR, domain=AUTOSAR}
        ASW_CORE1_MemMap_h: artifact-descriptor={short-label=ASW_CORE1_MemMap_h, category=SWHDR, domain=AUTOSAR}
        ASW_CORE2_MemMap_h: artifact-descriptor={short-label=ASW_CORE2_MemMap_h, category=SWHDR, domain=AUTOSAR}
        ASW_Dem_MemMap_h: artifact-descriptor={short-label=ASW_Dem_MemMap_h, category=SWHDR, domain=AUTOSAR}
        ASW_Diag_MemMap_h: artifact-descriptor={short-label=ASW_Diag_MemMap_h, category=SWHDR, domain=AUTOSAR}
        ASW_NM_MemMap_h: artifact-descriptor={short-label=ASW_NM_MemMap_h, category=SWHDR, domain=AUTOSAR}
        ASW_NVM_MemMap_h: artifact-descriptor={short-label=ASW_NVM_MemMap_h, category=SWHDR, domain=AUTOSAR}
        ASW_WDG_MemMap_h: artifact-descriptor={short-label=ASW_WDG_MemMap_h, category=SWHDR, domain=AUTOSAR}
        ASW_XCP_MemMap_h: artifact-descriptor={short-label=ASW_XCP_MemMap_h, category=SWHDR, domain=AUTOSAR}
        BSW_OsTask_SwcRequest_c: artifact-descriptor={short-label=BSW_OsTask_SwcRequest_c, category=SWSRC, domain=AUTOSAR}
        BSW_OsTask_SwcRequest_h: artifact-descriptor={short-label=BSW_OsTask_SwcRequest_h, category=SWHDR, domain=AUTOSAR}
        BswM_MemMap_h: artifact-descriptor={short-label=BswM_MemMap_h, category=SWHDR, domain=AUTOSAR}
        Com_h: artifact-descriptor={short-label=Com_h, category=SWHDR, domain=AUTOSAR}
        ComM_MemMap_h: artifact-descriptor={short-label=ComM_MemMap_h, category=SWHDR, domain=AUTOSAR}
        Core1_OsTask_ASW_10ms_c: artifact-descriptor={short-label=Core1_OsTask_ASW_10ms_c, category=SWSRC, domain=AUTOSAR}
        Core1_OsTask_ASW_10ms_h: artifact-descriptor={short-label=Core1_OsTask_ASW_10ms_h, category=SWHDR, domain=AUTOSAR}
        Core1_OsTask_BSW_10ms_c: artifact-descriptor={short-label=Core1_OsTask_BSW_10ms_c, category=SWSRC, domain=AUTOSAR}
        Core1_OsTask_BSW_10ms_h: artifact-descriptor={short-label=Core1_OsTask_BSW_10ms_h, category=SWHDR, domain=AUTOSAR}
        Core2_OsTask_ASW_10ms_c: artifact-descriptor={short-label=Core2_OsTask_ASW_10ms_c, category=SWSRC, domain=AUTOSAR}
        Core2_OsTask_ASW_10ms_h: artifact-descriptor={short-label=Core2_OsTask_ASW_10ms_h, category=SWHDR, domain=AUTOSAR}
        Core2_OsTask_BSW_10ms_c: artifact-descriptor={short-label=Core2_OsTask_BSW_10ms_c, category=SWSRC, domain=AUTOSAR}
        Core2_OsTask_BSW_10ms_h: artifact-descriptor={short-label=Core2_OsTask_BSW_10ms_h, category=SWHDR, domain=AUTOSAR}
        Dcm_MemMap_h: artifact-descriptor={short-label=Dcm_MemMap_h, category=SWHDR, domain=AUTOSAR}
        Dem_MemMap_h: artifact-descriptor={short-label=Dem_MemMap_h, category=SWHDR, domain=AUTOSAR}
        Det_MemMap_h: artifact-descriptor={short-label=Det_MemMap_h, category=SWHDR, domain=AUTOSAR}
        EcuM_MemMap_h: artifact-descriptor={short-label=EcuM_MemMap_h, category=SWHDR, domain=AUTOSAR}
        Ioc_h: artifact-descriptor={short-label=Ioc_h, category=SWHDR, domain=AUTOSAR}
        NvM_h: artifact-descriptor={short-label=NvM_h, category=SWHDR, domain=AUTOSAR}
        NvM_MemMap_h: artifact-descriptor={short-label=NvM_MemMap_h, category=SWHDR, domain=AUTOSAR}
        Os_h: artifact-descriptor={short-label=Os_h, category=SWHDR, domain=AUTOSAR}
        OsTask_ASW_100ms_c: artifact-descriptor={short-label=OsTask_ASW_100ms_c, category=SWSRC, domain=AUTOSAR}
        OsTask_ASW_100ms_h: artifact-descriptor={short-label=OsTask_ASW_100ms_h, category=SWHDR, domain=AUTOSAR}
        OsTask_ASW_10ms_c: artifact-descriptor={short-label=OsTask_ASW_10ms_c, category=SWSRC, domain=AUTOSAR}
        OsTask_ASW_10ms_h: artifact-descriptor={short-label=OsTask_ASW_10ms_h, category=SWHDR, domain=AUTOSAR}
        OsTask_BSW_10ms_c: artifact-descriptor={short-label=OsTask_BSW_10ms_c, category=SWSRC, domain=AUTOSAR}
        OsTask_BSW_10ms_h: artifact-descriptor={short-label=OsTask_BSW_10ms_h, category=SWHDR, domain=AUTOSAR}
        OsTask_BSW_1ms_c: artifact-descriptor={short-label=OsTask_BSW_1ms_c, category=SWSRC, domain=AUTOSAR}
        OsTask_BSW_1ms_h: artifact-descriptor={short-label=OsTask_BSW_1ms_h, category=SWHDR, domain=AUTOSAR}
        Rte_c: artifact-descriptor={short-label=Rte_c, category=SWSRC, domain=AUTOSAR}
        Rte_h: artifact-descriptor={short-label=Rte_h, category=SWHDR, domain=AUTOSAR}
        Rte_ASW_BASE_h: artifact-descriptor={short-label=Rte_ASW_BASE_h, category=SWHDR, domain=AUTOSAR}
        Rte_ASW_BASE_Type_h: artifact-descriptor={short-label=Rte_ASW_BASE_Type_h, category=SWHDR, domain=AUTOSAR}
        Rte_ASW_COM_h: artifact-descriptor={short-label=Rte_ASW_COM_h, category=SWHDR, domain=AUTOSAR}
        Rte_ASW_COM_Type_h: artifact-descriptor={short-label=Rte_ASW_COM_Type_h, category=SWHDR, domain=AUTOSAR}
        Rte_ASW_CORE1_h: artifact-descriptor={short-label=Rte_ASW_CORE1_h, category=SWHDR, domain=AUTOSAR}
        Rte_ASW_CORE1_Type_h: artifact-descriptor={short-label=Rte_ASW_CORE1_Type_h, category=SWHDR, domain=AUTOSAR}
        Rte_ASW_CORE2_h: artifact-descriptor={short-label=Rte_ASW_CORE2_h, category=SWHDR, domain=AUTOSAR}
        Rte_ASW_CORE2_Type_h: artifact-descriptor={short-label=Rte_ASW_CORE2_Type_h, category=SWHDR, domain=AUTOSAR}
        Rte_ASW_Dem_h: artifact-descriptor={short-label=Rte_ASW_Dem_h, category=SWHDR, domain=AUTOSAR}
        Rte_ASW_Dem_Type_h: artifact-descriptor={short-label=Rte_ASW_Dem_Type_h, category=SWHDR, domain=AUTOSAR}
        Rte_ASW_Diag_h: artifact-descriptor={short-label=Rte_ASW_Diag_h, category=SWHDR, domain=AUTOSAR}
        Rte_ASW_Diag_Type_h: artifact-descriptor={short-label=Rte_ASW_Diag_Type_h, category=SWHDR, domain=AUTOSAR}
        Rte_ASW_NM_h: artifact-descriptor={short-label=Rte_ASW_NM_h, category=SWHDR, domain=AUTOSAR}
        Rte_ASW_NM_Type_h: artifact-descriptor={short-label=Rte_ASW_NM_Type_h, category=SWHDR, domain=AUTOSAR}
        Rte_ASW_NVM_h: artifact-descriptor={short-label=Rte_ASW_NVM_h, category=SWHDR, domain=AUTOSAR}
        Rte_ASW_NVM_Type_h: artifact-descriptor={short-label=Rte_ASW_NVM_Type_h, category=SWHDR, domain=AUTOSAR}
        Rte_ASW_WDG_h: artifact-descriptor={short-label=Rte_ASW_WDG_h, category=SWHDR, domain=AUTOSAR}
        Rte_ASW_WDG_Type_h: artifact-descriptor={short-label=Rte_ASW_WDG_Type_h, category=SWHDR, domain=AUTOSAR}
        Rte_ASW_XCP_h: artifact-descriptor={short-label=Rte_ASW_XCP_h, category=SWHDR, domain=AUTOSAR}
        Rte_ASW_XCP_Type_h: artifact-descriptor={short-label=Rte_ASW_XCP_Type_h, category=SWHDR, domain=AUTOSAR}
        Rte_BswM_h: artifact-descriptor={short-label=Rte_BswM_h, category=SWHDR, domain=AUTOSAR}
        Rte_BswM_Type_h: artifact-descriptor={short-label=Rte_BswM_Type_h, category=SWHDR, domain=AUTOSAR}
        Rte_Cbk_h: artifact-descriptor={short-label=Rte_Cbk_h, category=SWHDR, domain=AUTOSAR}
        Rte_Cfg_h: artifact-descriptor={short-label=Rte_Cfg_h, category=SWHDR, domain=AUTOSAR}
        Rte_ComM_h: artifact-descriptor={short-label=Rte_ComM_h, category=SWHDR, domain=AUTOSAR}
        Rte_ComM_Type_h: artifact-descriptor={short-label=Rte_ComM_Type_h, category=SWHDR, domain=AUTOSAR}
        Rte_Const_h: artifact-descriptor={short-label=Rte_Const_h, category=SWHDR, domain=AUTOSAR}
        Rte_DataHandleType_h: artifact-descriptor={short-label=Rte_DataHandleType_h, category=SWHDR, domain=AUTOSAR}
        Rte_Dcm_h: artifact-descriptor={short-label=Rte_Dcm_h, category=SWHDR, domain=AUTOSAR}
        Rte_Dcm_Type_h: artifact-descriptor={short-label=Rte_Dcm_Type_h, category=SWHDR, domain=AUTOSAR}
        Rte_Dem_h: artifact-descriptor={short-label=Rte_Dem_h, category=SWHDR, domain=AUTOSAR}
        Rte_Dem_Type_h: artifact-descriptor={short-label=Rte_Dem_Type_h, category=SWHDR, domain=AUTOSAR}
        Rte_Det_h: artifact-descriptor={short-label=Rte_Det_h, category=SWHDR, domain=AUTOSAR}
        Rte_Det_Type_h: artifact-descriptor={short-label=Rte_Det_Type_h, category=SWHDR, domain=AUTOSAR}
        Rte_EcuM_h: artifact-descriptor={short-label=Rte_EcuM_h, category=SWHDR, domain=AUTOSAR}
        Rte_EcuM_Type_h: artifact-descriptor={short-label=Rte_EcuM_Type_h, category=SWHDR, domain=AUTOSAR}
        Rte_Hook_h: artifact-descriptor={short-label=Rte_Hook_h, category=SWHDR, domain=AUTOSAR}
        Rte_Intl_h: artifact-descriptor={short-label=Rte_Intl_h, category=SWHDR, domain=AUTOSAR}
        Rte_Lib_c: artifact-descriptor={short-label=Rte_Lib_c, category=SWSRC, domain=AUTOSAR}
        Rte_Main_h: artifact-descriptor={short-label=Rte_Main_h, category=SWHDR, domain=AUTOSAR}
        Rte_MemMap_h: artifact-descriptor={short-label=Rte_MemMap_h, category=SWHDR, domain=AUTOSAR}
        Rte_NvM_h: artifact-descriptor={short-label=Rte_NvM_h, category=SWHDR, domain=AUTOSAR}
        Rte_NvM_Type_h: artifact-descriptor={short-label=Rte_NvM_Type_h, category=SWHDR, domain=AUTOSAR}
        Rte_Type_h: artifact-descriptor={short-label=Rte_Type_h, category=SWHDR, domain=AUTOSAR}
        Rte_WdgM_h: artifact-descriptor={short-label=Rte_WdgM_h, category=SWHDR, domain=AUTOSAR}
        Rte_WdgM_Type_h: artifact-descriptor={short-label=Rte_WdgM_Type_h, category=SWHDR, domain=AUTOSAR}
        SchM_BswM_h: artifact-descriptor={short-label=SchM_BswM_h, category=SWHDR, domain=AUTOSAR}
        SchM_BswM_Type_h: artifact-descriptor={short-label=SchM_BswM_Type_h, category=SWHDR, domain=AUTOSAR}
        SchM_Can_h: artifact-descriptor={short-label=SchM_Can_h, category=SWHDR, domain=AUTOSAR}
        SchM_CanNm_h: artifact-descriptor={short-label=SchM_CanNm_h, category=SWHDR, domain=AUTOSAR}
        SchM_CanNm_Type_h: artifact-descriptor={short-label=SchM_CanNm_Type_h, category=SWHDR, domain=AUTOSAR}
        SchM_CanSM_h: artifact-descriptor={short-label=SchM_CanSM_h, category=SWHDR, domain=AUTOSAR}
        SchM_CanSM_Type_h: artifact-descriptor={short-label=SchM_CanSM_Type_h, category=SWHDR, domain=AUTOSAR}
        SchM_CanTp_h: artifact-descriptor={short-label=SchM_CanTp_h, category=SWHDR, domain=AUTOSAR}
        SchM_CanTp_Type_h: artifact-descriptor={short-label=SchM_CanTp_Type_h, category=SWHDR, domain=AUTOSAR}
        SchM_Can_Type_h: artifact-descriptor={short-label=SchM_Can_Type_h, category=SWHDR, domain=AUTOSAR}
        SchM_Com_h: artifact-descriptor={short-label=SchM_Com_h, category=SWHDR, domain=AUTOSAR}
        SchM_ComM_h: artifact-descriptor={short-label=SchM_ComM_h, category=SWHDR, domain=AUTOSAR}
        SchM_ComM_Type_h: artifact-descriptor={short-label=SchM_ComM_Type_h, category=SWHDR, domain=AUTOSAR}
        SchM_Com_Type_h: artifact-descriptor={short-label=SchM_Com_Type_h, category=SWHDR, domain=AUTOSAR}
        SchM_Dcm_h: artifact-descriptor={short-label=SchM_Dcm_h, category=SWHDR, domain=AUTOSAR}
        SchM_Dcm_Type_h: artifact-descriptor={short-label=SchM_Dcm_Type_h, category=SWHDR, domain=AUTOSAR}
        SchM_Dem_h: artifact-descriptor={short-label=SchM_Dem_h, category=SWHDR, domain=AUTOSAR}
        SchM_Dem_Type_h: artifact-descriptor={short-label=SchM_Dem_Type_h, category=SWHDR, domain=AUTOSAR}
        SchM_EcuM_h: artifact-descriptor={short-label=SchM_EcuM_h, category=SWHDR, domain=AUTOSAR}
        SchM_EcuM_Type_h: artifact-descriptor={short-label=SchM_EcuM_Type_h, category=SWHDR, domain=AUTOSAR}
        SchM_NvM_h: artifact-descriptor={short-label=SchM_NvM_h, category=SWHDR, domain=AUTOSAR}
        SchM_NvM_Type_h: artifact-descriptor={short-label=SchM_NvM_Type_h, category=SWHDR, domain=AUTOSAR}
        SchM_PduR_h: artifact-descriptor={short-label=SchM_PduR_h, category=SWHDR, domain=AUTOSAR}
        SchM_PduR_Type_h: artifact-descriptor={short-label=SchM_PduR_Type_h, category=SWHDR, domain=AUTOSAR}
        SchM_WdgM_h: artifact-descriptor={short-label=SchM_WdgM_h, category=SWHDR, domain=AUTOSAR}
        SchM_WdgM_Type_h: artifact-descriptor={short-label=SchM_WdgM_Type_h, category=SWHDR, domain=AUTOSAR}
        SchM_Xcp_h: artifact-descriptor={short-label=SchM_Xcp_h, category=SWHDR, domain=AUTOSAR}
        SchM_Xcp_Type_h: artifact-descriptor={short-label=SchM_Xcp_Type_h, category=SWHDR, domain=AUTOSAR}
        WdgM_MemMap_h: artifact-descriptor={short-label=WdgM_MemMap_h, category=SWHDR, domain=AUTOSAR}
    resource consumption ResConsumption
      51 x memory section:
        RTE_ASW_BASE_CODE:
          executable-entity=[Rte_Call_ASW_BASE_RPort_BootTarget_GetBootTarget, Rte_Call_ASW_BASE_RPort_BootTarget_SelectBootTarget, Rte_Call_ASW_BASE_RPort_SelectShutdownTarget_GetLastShutdownTarget, Rte_Call_ASW_BASE_RPort_SelectShutdownTarget_GetShutdownCause, Rte_Call_ASW_BASE_RPort_SelectShutdownTarget_GetShutdownTarget, Rte_Call_ASW_BASE_RPort_SelectShutdownTarget_SelectShutdownCause, Rte_Call_ASW_BASE_RPort_SelectShutdownTarget_SelectShutdownTarget, Rte_Mode_ASW_BASE_RPort_CurrentMode_CAN0_currentMode, Rte_Write_ASW_BASE_PPort_SwcModeRequest_AppMode]
          prefix=RTE_ASW_BASE
          sw-addrmethod=CODE
          symbol=CODE
        RTE_ASW_COM_CODE:
          executable-entity=[Rte_Read_ASW_COM_RPort_HCU01_Shift_HCU01_Shift, Rte_Read_ASW_COM_RPort_HCU01_TqCmd_HCU01_Tq_Cmd, Rte_Read_ASW_COM_RPort_HCU02_Poweroff_HCU02_Poweroff, Rte_Read_ASW_COM_RPort_HCU04_Poweroff_HCU04_Poweroff, Rte_Read_ASW_COM_RPort_HCU05_Poweroff_HCU05_Poweroff, Rte_Read_ASW_COM_RPott_HCU03_Poweroff_HCU03_Poweroff, Rte_Write_ASW_COM_PPort_MCU01_EmergShutDown_MCU01_EmergShutDown, Rte_Write_ASW_COM_PPort_MCU02_MaxTor_MCU02_MaxTor, Rte_Write_ASW_COM_PPort_MCU03_NRF_IdcSamp_MCU03_NRF_IdcSamp, Rte_Write_ASW_COM_PPort_MCU04_Test_MCU04_Test]
          prefix=RTE_ASW_COM
          sw-addrmethod=CODE
          symbol=CODE
        RTE_ASW_DEM_CODE:
          executable-entity=[Rte_Call_ASW_Dem_Event_DemEventParameter_C110117_ClearPrestoredFreezeFrame, Rte_Call_ASW_Dem_Event_DemEventParameter_C110117_PrestoreFreezeFrame, Rte_Call_ASW_Dem_Event_DemEventParameter_C110117_ResetEventDebounceStatus, Rte_Call_ASW_Dem_Event_DemEventParameter_C110117_ResetEventStatus, Rte_Call_ASW_Dem_Event_DemEventParameter_C110117_SetEventStatus, Rte_Call_ASW_Dem_Event_DemEventParameter_C110216_ClearPrestoredFreezeFrame, Rte_Call_ASW_Dem_Event_DemEventParameter_C110216_PrestoreFreezeFrame, Rte_Call_ASW_Dem_Event_DemEventParameter_C110216_ResetEventDebounceStatus, Rte_Call_ASW_Dem_Event_DemEventParameter_C110216_ResetEventStatus, Rte_Call_ASW_Dem_Event_DemEventParameter_C110216_SetEventStatus, Rte_Call_ASW_Dem_RPort_OpCycle_DemOperationCycle_0_GetOperationCycleState, Rte_Call_ASW_Dem_RPort_OpCycle_DemOperationCycle_0_SetOperationCycleState]
          prefix=RTE_ASW_DEM
          sw-addrmethod=CODE
          symbol=CODE
        RTE_ASW_DIAG_CODE: executable-entity=[Rte_Read_ASW_Diag_RPort_DataServices_DcmDspData_SystemFaultRank_Write_Data, Rte_Read_ASW_Diag_RPort_DataServices_DcmDspData_VehicleSpeed_Write_Data, Rte_Write_ASW_Diag_P_DataServices_DcmDspData_SystemFaultRank_Read_Data, Rte_Write_ASW_Diag_P_DataServices_DcmDspData_VehicleSpeed_Read_Data], prefix=RTE_ASW_DIAG, sw-addrmethod=CODE, symbol=CODE
        RTE_ASW_NM_CODE:
          executable-entity=[Rte_Call_ASW_NM_RP_ComM_UserRequest_CAN0_GetCurrentComMode, Rte_Call_ASW_NM_RP_ComM_UserRequest_CAN0_GetMaxComMode, Rte_Call_ASW_NM_RP_ComM_UserRequest_CAN0_GetRequestedComMode, Rte_Call_ASW_NM_RP_ComM_UserRequest_CAN0_RequestComMode, Rte_Call_ASW_NM_RPort_EcuModeLimitation_LimitECUToNoComMode, Rte_Call_ASW_NM_RPort_EcuModeLimitation_ReadInhibitCounter, Rte_Call_ASW_NM_RPort_EcuModeLimitation_ResetInhibitCounter, Rte_Call_ASW_NM_RPort_EcuModeLimitation_SetECUGroupClassification, Rte_Write_ASW_NM_PP_BswMArbitration_BswM_MRP_Network_uint8, Rte_Write_ASW_NM_PP_BswMArbitration_BswM_MRP_NmState_uint8]
          prefix=RTE_ASW_NM
          sw-addrmethod=CODE
          symbol=CODE
        RTE_ASW_NVM_CODE:
          executable-entity=[Rte_Call_ASW_NVM_RPort_ASW_NVM_BlockNative_1024_1_EraseBlock, Rte_Call_ASW_NVM_RPort_ASW_NVM_BlockNative_1024_1_GetDataIndex, Rte_Call_ASW_NVM_RPort_ASW_NVM_BlockNative_1024_1_GetErrorStatus, Rte_Call_ASW_NVM_RPort_ASW_NVM_BlockNative_1024_1_InvalidateNvBlock, Rte_Call_ASW_NVM_RPort_ASW_NVM_BlockNative_1024_1_ReadBlock, Rte_Call_ASW_NVM_RPort_ASW_NVM_BlockNative_1024_1_RestoreBlockDefaults, Rte_Call_ASW_NVM_RPort_ASW_NVM_BlockNative_1024_1_SetDataIndex, Rte_Call_ASW_NVM_RPort_ASW_NVM_BlockNative_1024_1_SetRamBlockStatus, Rte_Call_ASW_NVM_RPort_ASW_NVM_BlockNative_1024_1_WriteBlock, Rte_Call_ASW_NVM_RPort_ASW_NVM_BlockNative_1024_2_EraseBlock, Rte_Call_ASW_NVM_RPort_ASW_NVM_BlockNative_1024_2_GetDataIndex, Rte_Call_ASW_NVM_RPort_ASW_NVM_BlockNative_1024_2_GetErrorStatus, Rte_Call_ASW_NVM_RPort_ASW_NVM_BlockNative_1024_2_InvalidateNvBlock, Rte_Call_ASW_NVM_RPort_ASW_NVM_BlockNative_1024_2_ReadBlock, Rte_Call_ASW_NVM_RPort_ASW_NVM_BlockNative_1024_2_RestoreBlockDefaults, Rte_Call_ASW_NVM_RPort_ASW_NVM_BlockNative_1024_2_SetDataIndex, Rte_Call_ASW_NVM_RPort_ASW_NVM_BlockNative_1024_2_SetRamBlockStatus, Rte_Call_ASW_NVM_RPort_ASW_NVM_BlockNative_1024_2_WriteBlock]
          prefix=RTE_ASW_NVM
          sw-addrmethod=CODE
          symbol=CODE
        RTE_ASW_WDG_CODE: executable-entity=Rte_Call_ASW_WDG_RPort_Alive_Supervision_Entity1_CheckpointReached, prefix=RTE_ASW_WDG, sw-addrmethod=CODE, symbol=CODE
        RTE_BSW_OSTASK_SWCREQUEST_CODE: prefix=RTE_BSW_OSTASK_SWCREQUEST, sw-addrmethod=CODE, symbol=CODE
        RTE_BSWM_CODE:
          executable-entity=[Rte_Read_BswM_RP_BswMArbitration_BswMSwcModeRequest_AppMode, Rte_Read_BswM_RP_BswMArbitration_BswM_MRP_SWC_Network_uint8, SchM_Mode_BswM_MDGR_BswM_MRP_BswM_MDG, SchM_Mode_BswM_MDGR_BswM_MRP_DCM_DiagnosticSessionControl, SchM_Mode_BswM_MDGR_BswM_MRP_DCM_ModeNotification_EcuReset, SchM_Switch_BswM_MDGP_AUTOSAR_BswM_ModeDeclarationGroups_MDG_ECUM_STATE]
          prefix=RTE_BSWM
          sw-addrmethod=CODE
          symbol=CODE
        RTE_COMM_CODE: executable-entity=[Rte_Switch_ComM_UM_ComMUser_Can_Network_Channel_currentMode, Rte_Switch_ComM_UM_ComMUser_Can_Network_XCP_Channel_currentMode], prefix=RTE_COMM, sw-addrmethod=CODE, symbol=CODE
        RTE_CORE1_OSTASK_ASW_10MS_CODE: prefix=RTE_CORE1_OSTASK_ASW_10MS, sw-addrmethod=CODE, symbol=CODE
        RTE_CORE1_OSTASK_BSW_10MS_CODE: prefix=RTE_CORE1_OSTASK_BSW_10MS, sw-addrmethod=CODE, symbol=CODE
        RTE_CORE2_OSTASK_ASW_10MS_CODE: prefix=RTE_CORE2_OSTASK_ASW_10MS, sw-addrmethod=CODE, symbol=CODE
        RTE_CORE2_OSTASK_BSW_10MS_CODE: prefix=RTE_CORE2_OSTASK_BSW_10MS, sw-addrmethod=CODE, symbol=CODE
        RTE_DCM_CODE:
          executable-entity=[Rte_Call_Dcm_DataServices_DcmDspData_VacuumPumpPressure_1100_FreezeCurrentState, Rte_Call_Dcm_DataServices_DcmDspData_VacuumPumpPressure_1100_ReadData, Rte_Call_Dcm_DataServices_DcmDspData_VacuumPumpPressure_1100_ResetToDefault, Rte_Call_Dcm_DataServices_DcmDspData_VacuumPumpPressure_1100_ReturnControlToECU, Rte_Call_Dcm_DataServices_DcmDspData_VacuumPumpPressure_1100_ShortTermAdjustment, Rte_Call_Dcm_RoutineServices_DcmDspRoutine_DriveVacuumPump_RequestResults, Rte_Call_Dcm_RoutineServices_DcmDspRoutine_DriveVacuumPump_Start, Rte_Call_Dcm_RoutineServices_DcmDspRoutine_DriveVacuumPump_Stop, Rte_Read_Dcm_R_DataServices_DcmDspData_SystemFaultRank_Data, Rte_Read_Dcm_R_DataServices_DcmDspData_VehicleSpeed_Data, Rte_Switch_Dcm_Pp_DcmCommunicationControl_ComMChannel_Can_Network_Channel_MDGP_DcmCommunicationControl_ComMChannel_Can_Network_Channel, Rte_Switch_Dcm_Pp_DcmControlDTCSetting_MDGP_DcmControlDTCSetting, Rte_Switch_Dcm_Pp_DcmDiagnosticSessionControl_MDGP_DcmDiagnosticSessionControl, Rte_Switch_Dcm_Pp_DcmEcuReset_MDGP_DcmEcuReset, Rte_Write_Dcm_P_DataServices_DcmDspData_SystemFaultRank_Data, Rte_Write_Dcm_P_DataServices_DcmDspData_VehicleSpeed_Data, SchM_Mode_Dcm_R_DcmCommunicationControl_ComMChannel_Can_Network_Channel, SchM_Switch_Dcm_DcmCommunicationControl_ComMChannel_Can_Network_Channel, SchM_Switch_Dcm_DcmDiagnosticSessionControl, SchM_Switch_Dcm_DcmEcuReset]
          prefix=RTE_DCM
          sw-addrmethod=CODE
          symbol=CODE
        RTE_DEM_CODE:
          executable-entity=[Rte_Call_Dem_CBStatusComp_DemComponent_Busoff_ComponentStatusChanged, Rte_Call_Dem_CBStatusComp_DemComponent_C110117_ComponentStatusChanged, Rte_Call_Dem_CBStatusComp_DemComponent_C110216_ComponentStatusChanged, Rte_Call_Dem_CBStatusComp_DemComponent_C153364_ComponentStatusChanged, Rte_Call_Dem_DataServices_DemDataElementClass_SystemFaultRank_ReadData, Rte_Call_Dem_DataServices_DemDataElementClass_VehicleSpeed_ReadData]
          prefix=RTE_DEM
          sw-addrmethod=CODE
          symbol=CODE
        RTE_EXT_CODE: executable-entity=[Rte_ActivateRE, Rte_MSACbk_SW_11, Rte_MSACbk_SW_12, Rte_SetEvent, Rte_WriteQueue], prefix=RTE_EXT, sw-addrmethod=CODE, symbol=CODE
        RTE_LIB_CODE: executable-entity=[Rte_GetCurrentTaskIndex, Rte_memcpy], prefix=RTE_LIB, sw-addrmethod=CODE, symbol=CODE
        RTE_MAIN_CODE: executable-entity=[Rte_MainFunction, Rte_Start, Rte_Stop, SchM_Deinit, SchM_Init], prefix=RTE_MAIN, sw-addrmethod=CODE, symbol=CODE
        RTE_OSTASK_ASW_100MS_CODE: prefix=RTE_OSTASK_ASW_100MS, sw-addrmethod=CODE, symbol=CODE
        RTE_OSTASK_ASW_10MS_CODE: prefix=RTE_OSTASK_ASW_10MS, sw-addrmethod=CODE, symbol=CODE
        RTE_OSTASK_BSW_10MS_CODE: prefix=RTE_OSTASK_BSW_10MS, sw-addrmethod=CODE, symbol=CODE
        RTE_OSTASK_BSW_1MS_CODE: prefix=RTE_OSTASK_BSW_1MS, sw-addrmethod=CODE, symbol=CODE
        RTE_SIG_HCU01_SHIFT_CODE: executable-entity=[Rte_COMCbkTOut_HCU01_Shift, Rte_COMCbk_HCU01_Shift], prefix=RTE_SIG_HCU01_SHIFT, sw-addrmethod=CODE, symbol=CODE
        RTE_SIG_HCU01_TQCMD_CODE: executable-entity=[Rte_COMCbkTOut_HCU01_TqCmd, Rte_COMCbk_HCU01_TqCmd], prefix=RTE_SIG_HCU01_TQCMD, sw-addrmethod=CODE, symbol=CODE
        RTE_SIG_HCU{02..05}_POWEROFF_CODE: executable-entity=[Rte_COMCbkTOut_HCU{02..05}_Poweroff, Rte_COMCbk_HCU{02..05}_Poweroff], prefix=RTE_SIG_HCU{02..05}_POWEROFF, sw-addrmethod=CODE, symbol=CODE
        RTE_SYS_CODE: executable-entity=[Rte_DecrementWaitingCount, Rte_ReadQueue, Rte_WaitWithTimeout, SchM_IModeInit], prefix=RTE_SYS, sw-addrmethod=CODE, symbol=CODE
        RTE_WDGM_CODE: executable-entity=[Rte_SwitchAck_WdgM_globalMode_currentMode, Rte_SwitchAck_WdgM_mode_WdgMSupervisedEntity_Alive_Supervision_Entity1_currentMode, Rte_Switch_WdgM_globalMode_currentMode, Rte_Switch_WdgM_mode_WdgMSupervisedEntity_Alive_Supervision_Entity1_currentMode, SchM_Mode_WdgM_Current_WdgMSupervisionCycle], prefix=RTE_WDGM, sw-addrmethod=CODE, symbol=CODE
        CONST_UNSPECIFIED: alignment=UNSPECIFIED, sw-addrmethod=CONST
        EcucPartition_Core0_CONST_UNSPECIFIED: alignment=UNSPECIFIED, sw-addrmethod=EcucPartition_Core0_CONST
        EcucPartition_Core0_VAR_CLEARED_16: alignment=16, sw-addrmethod=EcucPartition_Core0_VAR_CLEARED
        EcucPartition_Core0_VAR_CLEARED_8: alignment=8, sw-addrmethod=EcucPartition_Core0_VAR_CLEARED
        EcucPartition_Core0_VAR_CLEARED_BOOLEAN: alignment=BOOLEAN, sw-addrmethod=EcucPartition_Core0_VAR_CLEARED
        EcucPartition_Core0_VAR_CLEARED_UNSPECIFIED: alignment=UNSPECIFIED, sw-addrmethod=EcucPartition_Core0_VAR_CLEARED
        EcucPartition_Core1_CONST_UNSPECIFIED: alignment=UNSPECIFIED, sw-addrmethod=EcucPartition_Core1_CONST
        EcucPartition_Core2_CONST_UNSPECIFIED: alignment=UNSPECIFIED, sw-addrmethod=EcucPartition_Core2_CONST
        VAR_CLEARED_16: alignment=16, sw-addrmethod=VAR_CLEARED
        RTE_OSAPPLICATION_CORE{0..2}_VAR_CLEARED_16: alignment=16, prefix=RTE_OSAPPLICATION_CORE{0..2}, sw-addrmethod=VAR_CLEARED, symbol=VAR_CLEARED_16
        RTE_SYS_VAR_CLEARED_32: alignment=32, prefix=RTE_SYS, sw-addrmethod=VAR_CLEARED, symbol=VAR_CLEARED_32
        VAR_CLEARED_8: alignment=8, sw-addrmethod=VAR_CLEARED
        RTE_ECUCPARTITION_CORE0_VAR_CLEARED_8: alignment=8, prefix=RTE_ECUCPARTITION_CORE0, sw-addrmethod=VAR_CLEARED, symbol=VAR_CLEARED_8
        RTE_OSTASK_ASW_10MS_VAR_CLEARED_8: alignment=8, prefix=RTE_OSTASK_ASW_10MS, sw-addrmethod=VAR_CLEARED, symbol=VAR_CLEARED_8
        VAR_CLEARED_BOOLEAN: alignment=BOOLEAN, sw-addrmethod=VAR_CLEARED
        VAR_INIT_8: alignment=8, sw-addrmethod=VAR_INIT
        RTE_ECUCPARTITION_CORE0_VAR_INIT_8: alignment=8, prefix=RTE_ECUCPARTITION_CORE0, sw-addrmethod=VAR_INIT, symbol=VAR_INIT_8
        VAR_INIT_UNSPECIFIED: alignment=UNSPECIFIED, sw-addrmethod=VAR_INIT
      35 x section name prefix:
        RTE_ASW_BASE
        RTE_ASW_COM
        RTE_ASW_DEM
        RTE_ASW_DIAG
        RTE_ASW_NM
        RTE_ASW_NVM
        RTE_ASW_WDG
        RTE_BSWM
        RTE_BSW_OSTASK_SWCREQUEST
        RTE_COMM
        RTE_CORE1_OSTASK_ASW_10MS
        RTE_CORE1_OSTASK_BSW_10MS
        RTE_CORE2_OSTASK_ASW_10MS
        RTE_CORE2_OSTASK_BSW_10MS
        RTE_DCM
        RTE_DEM
        RTE_ECUCPARTITION_CORE0
        RTE_EXT
        RTE_LIB
        RTE_MAIN
        RTE_OSAPPLICATION_CORE{0..2}
        RTE_OSTASK_ASW_100MS
        RTE_OSTASK_ASW_10MS
        RTE_OSTASK_BSW_10MS
        RTE_OSTASK_BSW_1MS
        RTE_SIG_HCU01_SHIFT
        RTE_SIG_HCU01_TQCMD
        RTE_SIG_HCU{02..05}_POWEROFF
        RTE_SYS
        RTE_WDGM
package /AUTOSAR_Rte/CompuMethods
  compu method AUTOSAR_Platform_CompuMethods_boolean: 0=FALSE, 1=TRUE
package /AUTOSAR_Rte/ImplementationDataTypes
  46 x impl type:
    Rte_REActCounterType: category=VALUE  # This is an external type, i.e. it is declared in the Rte Library and not in the XML. RTEGen does not have any information about this type apart from its name.
    Rte_PimType_ASW_NVM_ASW_NVM_BlockNative_1024_Type: category=TYPE_REFERENCE
    Rte_PimType_ASW_NVM_ASW_NVM_BlockRedundant_1024_Type: category=TYPE_REFERENCE
    Rte_CDS_ASW_BASE: category=STRUCTURE
      element Rte_Dummy: implementation-data-type=uint8
    Rte_CDS_ASW_COM: category=STRUCTURE
      element Rte_Dummy: implementation-data-type=uint8
    Rte_CDS_ASW_CORE1: category=STRUCTURE
      element Rte_Dummy: implementation-data-type=uint8
    Rte_CDS_ASW_CORE2: category=STRUCTURE
      element Rte_Dummy: implementation-data-type=uint8
    Rte_CDS_ASW_Dem: category=STRUCTURE
      element Rte_Dummy: implementation-data-type=uint8
    Rte_CDS_ASW_Diag: category=STRUCTURE
      element Rte_Dummy: implementation-data-type=uint8
    Rte_CDS_ASW_NM: category=STRUCTURE
      element Rte_Dummy: implementation-data-type=uint8
    Rte_CDS_ASW_NVM: category=STRUCTURE
      element Pim_ASW_NVM_BlockNative_1024_1: implementation-data-type=Rte_PimType_ASW_NVM_ASW_NVM_BlockNative_1024_Type
      element Pim_ASW_NVM_BlockNative_1024_2: implementation-data-type=Rte_PimType_ASW_NVM_ASW_NVM_BlockRedundant_1024_Type
    Rte_CDS_ASW_WDG: category=STRUCTURE
      element Rte_Dummy: implementation-data-type=uint8
    Rte_CDS_ASW_XCP: category=STRUCTURE
      element Rte_Dummy: implementation-data-type=uint8
    Rte_CDS_BswM: category=STRUCTURE
      element Rte_Dummy: implementation-data-type=uint8
    Rte_CDS_ComM: category=STRUCTURE
      element Rte_Dummy: implementation-data-type=uint8
    Rte_CDS_Dcm: category=STRUCTURE
      element Rte_Dummy: implementation-data-type=uint8
    Rte_CDS_Dem: category=STRUCTURE
      element Rte_Dummy: implementation-data-type=uint8
    Rte_CDS_Det: category=STRUCTURE
      element Rte_Dummy: implementation-data-type=uint8
    Rte_CDS_EcuM: category=STRUCTURE
      element Rte_Dummy: implementation-data-type=uint8
    Rte_CDS_NvM: category=STRUCTURE
      element Rte_Dummy: implementation-data-type=uint8
    Rte_SwitchAckFP_WdgM_WdgM_IndividualMode_currentMode: category=FUNCTION_REFERENCE
    Rte_SwitchFP_WdgM_WdgM_IndividualMode_currentMode: category=FUNCTION_REFERENCE
    Rte_PDS_WdgM_WdgM_IndividualMode_P: category=STRUCTURE
      element SwitchAck_currentMode: implementation-data-type=Rte_SwitchAckFP_WdgM_WdgM_IndividualMode_currentMode
      element Switch_currentMode: implementation-data-type=Rte_SwitchFP_WdgM_WdgM_IndividualMode_currentMode
    Rte_PDS_WdgM_WdgM_IndividualMode_PA: category=ARRAY
      element Rte_PDS_WdgM_WdgM_IndividualMode_PAElement: array-size=1, array-size-semantics=FIXED-SIZE, implementation-data-type=Rte_PDS_WdgM_WdgM_IndividualMode_P
    Rte_CDS_WdgM: category=STRUCTURE
      element mode_WdgMSupervisedEntity_Alive_Supervision_Entity1: implementation-data-type=Rte_PDS_WdgM_WdgM_IndividualMode_PA
    Dcm_DataArrayTypeUint8_DcmDspData_SystemFaultRankType: implementation-data-type=uint8
    Dcm_DataArrayTypeUint8_DcmDspData_VehicleSpeedType: implementation-data-type=uint8
    Rte_SelfType_ASW_BASE: implementation-data-type=Rte_CDS_ASW_BASE
    Rte_SelfType_ASW_COM: implementation-data-type=Rte_CDS_ASW_COM
    Rte_SelfType_ASW_CORE1: implementation-data-type=Rte_CDS_ASW_CORE1
    Rte_SelfType_ASW_CORE2: implementation-data-type=Rte_CDS_ASW_CORE2
    Rte_SelfType_ASW_NM: implementation-data-type=Rte_CDS_ASW_NM
    Rte_SelfType_ASW_NVM: implementation-data-type=Rte_CDS_ASW_NVM
    Rte_SelfType_ASW_WDG: implementation-data-type=Rte_CDS_ASW_WDG
    Rte_SelfType_BswM: implementation-data-type=Rte_CDS_BswM
    Rte_SelfType_ComM: implementation-data-type=Rte_CDS_ComM
    Rte_SelfType_Dcm: implementation-data-type=Rte_CDS_Dcm
    Rte_SelfType_Dem: implementation-data-type=Rte_CDS_Dem
    Rte_SelfType_ASW_Dem: implementation-data-type=Rte_CDS_ASW_Dem
    Rte_SelfType_Det: implementation-data-type=Rte_CDS_Det
    Rte_SelfType_ASW_Diag: implementation-data-type=Rte_CDS_ASW_Diag
    Rte_SelfType_EcuM: implementation-data-type=Rte_CDS_EcuM
    Rte_SelfType_NvM: implementation-data-type=Rte_CDS_NvM
    Rte_SelfType_WdgM: implementation-data-type=Rte_CDS_WdgM
    Rte_SelfType_ASW_XCP: implementation-data-type=Rte_CDS_ASW_XCP
    Rte_TaskInfo: category=VALUE  # This is an external type, i.e. it is declared in the Rte Library and not in the XML. RTEGen does not have any information about this type apart from its name.
package /AUTOSAR_Rte/SwAddrMethods
  8 x sw addr method:
    CODE: memory-allocation-keyword-policy=ADDR-METHOD-SHORT-NAME, section-type=CODE
    CONST: memory-allocation-keyword-policy=ADDR-METHOD-SHORT-NAME-AND-ALIGNMENT, section-type=CONST
    EcucPartition_Core0_CONST: memory-allocation-keyword-policy=ADDR-METHOD-SHORT-NAME-AND-ALIGNMENT, section-type=CONST
    EcucPartition_Core0_VAR_CLEARED: memory-allocation-keyword-policy=ADDR-METHOD-SHORT-NAME-AND-ALIGNMENT, section-initialization-policy=CLEARED, section-type=VAR
    EcucPartition_Core1_CONST: memory-allocation-keyword-policy=ADDR-METHOD-SHORT-NAME-AND-ALIGNMENT, section-type=CONST
    EcucPartition_Core2_CONST: memory-allocation-keyword-policy=ADDR-METHOD-SHORT-NAME-AND-ALIGNMENT, section-type=CONST
    VAR_CLEARED: memory-allocation-keyword-policy=ADDR-METHOD-SHORT-NAME-AND-ALIGNMENT, section-initialization-policy=CLEARED, section-type=VAR
    VAR_INIT: memory-allocation-keyword-policy=ADDR-METHOD-SHORT-NAME-AND-ALIGNMENT, section-initialization-policy=INIT, section-type=VAR
package /AUTOSAR_Rte/SwBaseTypes
  4 x base type, all with category=FIXED_LENGTH:
    AUTOSAR_Platform_BaseTypes_uint8: base-type-size=8, base-type-encoding=NONE, mem-alignment=8  # unsigned integer 8bit | This standard AUTOSAR type shall be of 8 bit unsigned.
    AUTOSAR_Platform_BaseTypes_sint16: base-type-size=16, base-type-encoding=2C, mem-alignment=16  # signed integer 16bit | This standard AUTOSAR type shall be 16 bit signed.
    AUTOSAR_Platform_BaseTypes_boolean: base-type-size=8, base-type-encoding=BOOLEAN  # Boolean | The boolean type shall always be mapped to a platform specific type where pointers can be applied to enable a passing of parameters via API. There are specific BIT types of some HW platforms which are very efficient but where no pointers can point to. This standard AUTOSAR type shall only be used together with the definitions TRUE and FALSE. See PLATFORM027 for implementation and usage.
    AUTOSAR_PlatformTypes_SwBaseTypes_uint8: base-type-size=8, base-type-encoding=NONE, mem-alignment=8  # unsigned integer 8bit | This standard AUTOSAR type shall be of 8 bit unsigned.
