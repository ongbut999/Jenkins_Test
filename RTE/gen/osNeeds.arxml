AUTOSAR XML (schema 4-0-3)
package /OsCfg
  module config OsCfg: definition=Os
    Rte_EA_BSWImpl5_BSWIMPL_Can_CAN_EXCLUSIVE_AREA_0 (OsResource): OsResourceProperty=STANDARD
    9 x OsTask, all with OsTaskSchedule=FULL:
      OsTask_ASW_100ms: OsTaskActivation=1, OsTaskPriority=6
      Core2_OsTask_ASW_10ms: OsTaskActivation=1, OsTaskPriority=7
      Core1_OsTask_ASW_10ms: OsTaskActivation=1, OsTaskPriority=8
      OsTask_ASW_10ms: OsTaskActivation=1, OsTaskPriority=9
      Core2_OsTask_BSW_10ms: OsTaskActivation=1, OsTaskPriority=10
      Core1_OsTask_BSW_10ms: OsTaskActivation=1, OsTaskPriority=11
      OsTask_BSW_10ms: OsTaskActivation=1, OsTaskPriority=12, OsTaskResourceRef=Rte_EA_BSWImpl5_BSWIMPL_Can_CAN_EXCLUSIVE_AREA_0
      OsTask_BSW_1ms: OsTaskActivation=1, OsTaskPriority=13
      BSW_OsTask_SwcRequest: OsTaskActivation=2, OsTaskPriority=14
    Rte_TickCounter (OsCounter): OsCounterMaxAllowedValue=65535, OsCounterMinCycle=1, OsCounterTicksPerBase=1, OsCounterType=SOFTWARE
    Rte_ScheduleTable (OsScheduleTable): OsScheduleTableRepeating=true, OsScheduleTableDuration=100, OsScheduleTableCounterRef=Rte_TickCounter
      100 x OsScheduleTableExpiryPoint:
        rte_Stimulus_1: OsScheduleTblExpPointOffset=0
          8 x OsScheduleTableTaskActivation:
            TaskActivation1: OsScheduleTableActivateTaskRef=Core1_OsTask_ASW_10ms
            TaskActivation2: OsScheduleTableActivateTaskRef=Core1_OsTask_BSW_10ms
            TaskActivation3: OsScheduleTableActivateTaskRef=Core2_OsTask_ASW_10ms
            TaskActivation4: OsScheduleTableActivateTaskRef=Core2_OsTask_BSW_10ms
            TaskActivation5: OsScheduleTableActivateTaskRef=OsTask_ASW_100ms
            TaskActivation6: OsScheduleTableActivateTaskRef=OsTask_ASW_10ms
            TaskActivation7: OsScheduleTableActivateTaskRef=OsTask_BSW_10ms
            TaskActivation8: OsScheduleTableActivateTaskRef=OsTask_BSW_1ms
        rte_Stimulus_2: OsScheduleTblExpPointOffset=1
          TaskActivation1 (OsScheduleTableTaskActivation): OsScheduleTableActivateTaskRef=OsTask_BSW_1ms
        rte_Stimulus_3: OsScheduleTblExpPointOffset=2
          TaskActivation1 (OsScheduleTableTaskActivation): OsScheduleTableActivateTaskRef=OsTask_BSW_1ms
        rte_Stimulus_4: OsScheduleTblExpPointOffset=3
          TaskActivation1 (OsScheduleTableTaskActivation): OsScheduleTableActivateTaskRef=OsTask_BSW_1ms
        rte_Stimulus_5: OsScheduleTblExpPointOffset=4
          TaskActivation1 (OsScheduleTableTaskActivation): OsScheduleTableActivateTaskRef=OsTask_BSW_1ms
        rte_Stimulus_6: OsScheduleTblExpPointOffset=5
          TaskActivation1 (OsScheduleTableTaskActivation): OsScheduleTableActivateTaskRef=OsTask_BSW_1ms
        rte_Stimulus_7: OsScheduleTblExpPointOffset=6
          TaskActivation1 (OsScheduleTableTaskActivation): OsScheduleTableActivateTaskRef=OsTask_BSW_1ms
        rte_Stimulus_8: OsScheduleTblExpPointOffset=7
          TaskActivation1 (OsScheduleTableTaskActivation): OsScheduleTableActivateTaskRef=OsTask_BSW_1ms
        rte_Stimulus_9: OsScheduleTblExpPointOffset=8
          TaskActivation1 (OsScheduleTableTaskActivation): OsScheduleTableActivateTaskRef=OsTask_BSW_1ms
        rte_Stimulus_10: OsScheduleTblExpPointOffset=9
          TaskActivation1 (OsScheduleTableTaskActivation): OsScheduleTableActivateTaskRef=OsTask_BSW_1ms
        rte_Stimulus_11: OsScheduleTblExpPointOffset=10
          7 x OsScheduleTableTaskActivation:
            TaskActivation1: OsScheduleTableActivateTaskRef=Core1_OsTask_ASW_10ms
            TaskActivation2: OsScheduleTableActivateTaskRef=Core1_OsTask_BSW_10ms
            TaskActivation3: OsScheduleTableActivateTaskRef=Core2_OsTask_ASW_10ms
            TaskActivation4: OsScheduleTableActivateTaskRef=Core2_OsTask_BSW_10ms
            TaskActivation5: OsScheduleTableActivateTaskRef=OsTask_ASW_10ms
            TaskActivation6: OsScheduleTableActivateTaskRef=OsTask_BSW_10ms
            TaskActivation7: OsScheduleTableActivateTaskRef=OsTask_BSW_1ms
        rte_Stimulus_12: OsScheduleTblExpPointOffset=11
          TaskActivation1 (OsScheduleTableTaskActivation): OsScheduleTableActivateTaskRef=OsTask_BSW_1ms
        rte_Stimulus_13: OsScheduleTblExpPointOffset=12
          TaskActivation1 (OsScheduleTableTaskActivation): OsScheduleTableActivateTaskRef=OsTask_BSW_1ms
        rte_Stimulus_14: OsScheduleTblExpPointOffset=13
          TaskActivation1 (OsScheduleTableTaskActivation): OsScheduleTableActivateTaskRef=OsTask_BSW_1ms
        rte_Stimulus_15: OsScheduleTblExpPointOffset=14
          TaskActivation1 (OsScheduleTableTaskActivation): OsScheduleTableActivateTaskRef=OsTask_BSW_1ms
        rte_Stimulus_16: OsScheduleTblExpPointOffset=15
          TaskActivation1 (OsScheduleTableTaskActivation): OsScheduleTableActivateTaskRef=OsTask_BSW_1ms
        rte_Stimulus_17: OsScheduleTblExpPointOffset=16
          TaskActivation1 (OsScheduleTableTaskActivation): OsScheduleTableActivateTaskRef=OsTask_BSW_1ms
        rte_Stimulus_18: OsScheduleTblExpPointOffset=17
          TaskActivation1 (OsScheduleTableTaskActivation): OsScheduleTableActivateTaskRef=OsTask_BSW_1ms
        rte_Stimulus_19: OsScheduleTblExpPointOffset=18
          TaskActivation1 (OsScheduleTableTaskActivation): OsScheduleTableActivateTaskRef=OsTask_BSW_1ms
        rte_Stimulus_20: OsScheduleTblExpPointOffset=19
          TaskActivation1 (OsScheduleTableTaskActivation): OsScheduleTableActivateTaskRef=OsTask_BSW_1ms
        rte_Stimulus_21: OsScheduleTblExpPointOffset=20
          7 x OsScheduleTableTaskActivation:
            TaskActivation1: OsScheduleTableActivateTaskRef=Core1_OsTask_ASW_10ms
            TaskActivation2: OsScheduleTableActivateTaskRef=Core1_OsTask_BSW_10ms
            TaskActivation3: OsScheduleTableActivateTaskRef=Core2_OsTask_ASW_10ms
            TaskActivation4: OsScheduleTableActivateTaskRef=Core2_OsTask_BSW_10ms
            TaskActivation5: OsScheduleTableActivateTaskRef=OsTask_ASW_10ms
            TaskActivation6: OsScheduleTableActivateTaskRef=OsTask_BSW_10ms
            TaskActivation7: OsScheduleTableActivateTaskRef=OsTask_BSW_1ms
        rte_Stimulus_22: OsScheduleTblExpPointOffset=21
          TaskActivation1 (OsScheduleTableTaskActivation): OsScheduleTableActivateTaskRef=OsTask_BSW_1ms
        rte_Stimulus_23: OsScheduleTblExpPointOffset=22
          TaskActivation1 (OsScheduleTableTaskActivation): OsScheduleTableActivateTaskRef=OsTask_BSW_1ms
        rte_Stimulus_24: OsScheduleTblExpPointOffset=23
          TaskActivation1 (OsScheduleTableTaskActivation): OsScheduleTableActivateTaskRef=OsTask_BSW_1ms
        rte_Stimulus_25: OsScheduleTblExpPointOffset=24
          TaskActivation1 (OsScheduleTableTaskActivation): OsScheduleTableActivateTaskRef=OsTask_BSW_1ms
        rte_Stimulus_26: OsScheduleTblExpPointOffset=25
          TaskActivation1 (OsScheduleTableTaskActivation): OsScheduleTableActivateTaskRef=OsTask_BSW_1ms
        rte_Stimulus_27: OsScheduleTblExpPointOffset=26
          TaskActivation1 (OsScheduleTableTaskActivation): OsScheduleTableActivateTaskRef=OsTask_BSW_1ms
        rte_Stimulus_28: OsScheduleTblExpPointOffset=27
          TaskActivation1 (OsScheduleTableTaskActivation): OsScheduleTableActivateTaskRef=OsTask_BSW_1ms
        rte_Stimulus_29: OsScheduleTblExpPointOffset=28
          TaskActivation1 (OsScheduleTableTaskActivation): OsScheduleTableActivateTaskRef=OsTask_BSW_1ms
        rte_Stimulus_30: OsScheduleTblExpPointOffset=29
          TaskActivation1 (OsScheduleTableTaskActivation): OsScheduleTableActivateTaskRef=OsTask_BSW_1ms
        rte_Stimulus_31: OsScheduleTblExpPointOffset=30
          7 x OsScheduleTableTaskActivation:
            TaskActivation1: OsScheduleTableActivateTaskRef=Core1_OsTask_ASW_10ms
            TaskActivation2: OsScheduleTableActivateTaskRef=Core1_OsTask_BSW_10ms
            TaskActivation3: OsScheduleTableActivateTaskRef=Core2_OsTask_ASW_10ms
            TaskActivation4: OsScheduleTableActivateTaskRef=Core2_OsTask_BSW_10ms
            TaskActivation5: OsScheduleTableActivateTaskRef=OsTask_ASW_10ms
            TaskActivation6: OsScheduleTableActivateTaskRef=OsTask_BSW_10ms
            TaskActivation7: OsScheduleTableActivateTaskRef=OsTask_BSW_1ms
        rte_Stimulus_32: OsScheduleTblExpPointOffset=31
          TaskActivation1 (OsScheduleTableTaskActivation): OsScheduleTableActivateTaskRef=OsTask_BSW_1ms
        rte_Stimulus_33: OsScheduleTblExpPointOffset=32
          TaskActivation1 (OsScheduleTableTaskActivation): OsScheduleTableActivateTaskRef=OsTask_BSW_1ms
        rte_Stimulus_34: OsScheduleTblExpPointOffset=33
          TaskActivation1 (OsScheduleTableTaskActivation): OsScheduleTableActivateTaskRef=OsTask_BSW_1ms
        rte_Stimulus_35: OsScheduleTblExpPointOffset=34
          TaskActivation1 (OsScheduleTableTaskActivation): OsScheduleTableActivateTaskRef=OsTask_BSW_1ms
        rte_Stimulus_36: OsScheduleTblExpPointOffset=35
          TaskActivation1 (OsScheduleTableTaskActivation): OsScheduleTableActivateTaskRef=OsTask_BSW_1ms
        rte_Stimulus_37: OsScheduleTblExpPointOffset=36
          TaskActivation1 (OsScheduleTableTaskActivation): OsScheduleTableActivateTaskRef=OsTask_BSW_1ms
        rte_Stimulus_38: OsScheduleTblExpPointOffset=37
          TaskActivation1 (OsScheduleTableTaskActivation): OsScheduleTableActivateTaskRef=OsTask_BSW_1ms
        rte_Stimulus_39: OsScheduleTblExpPointOffset=38
          TaskActivation1 (OsScheduleTableTaskActivation): OsScheduleTableActivateTaskRef=OsTask_BSW_1ms
        rte_Stimulus_40: OsScheduleTblExpPointOffset=39
          TaskActivation1 (OsScheduleTableTaskActivation): OsScheduleTableActivateTaskRef=OsTask_BSW_1ms
        rte_Stimulus_41: OsScheduleTblExpPointOffset=40
          7 x OsScheduleTableTaskActivation:
            TaskActivation1: OsScheduleTableActivateTaskRef=Core1_OsTask_ASW_10ms
            TaskActivation2: OsScheduleTableActivateTaskRef=Core1_OsTask_BSW_10ms
            TaskActivation3: OsScheduleTableActivateTaskRef=Core2_OsTask_ASW_10ms
            TaskActivation4: OsScheduleTableActivateTaskRef=Core2_OsTask_BSW_10ms
            TaskActivation5: OsScheduleTableActivateTaskRef=OsTask_ASW_10ms
            TaskActivation6: OsScheduleTableActivateTaskRef=OsTask_BSW_10ms
            TaskActivation7: OsScheduleTableActivateTaskRef=OsTask_BSW_1ms
        rte_Stimulus_42: OsScheduleTblExpPointOffset=41
          TaskActivation1 (OsScheduleTableTaskActivation): OsScheduleTableActivateTaskRef=OsTask_BSW_1ms
        rte_Stimulus_43: OsScheduleTblExpPointOffset=42
          TaskActivation1 (OsScheduleTableTaskActivation): OsScheduleTableActivateTaskRef=OsTask_BSW_1ms
        rte_Stimulus_44: OsScheduleTblExpPointOffset=43
          TaskActivation1 (OsScheduleTableTaskActivation): OsScheduleTableActivateTaskRef=OsTask_BSW_1ms
        rte_Stimulus_45: OsScheduleTblExpPointOffset=44
          TaskActivation1 (OsScheduleTableTaskActivation): OsScheduleTableActivateTaskRef=OsTask_BSW_1ms
        rte_Stimulus_46: OsScheduleTblExpPointOffset=45
          TaskActivation1 (OsScheduleTableTaskActivation): OsScheduleTableActivateTaskRef=OsTask_BSW_1ms
        rte_Stimulus_47: OsScheduleTblExpPointOffset=46
          TaskActivation1 (OsScheduleTableTaskActivation): OsScheduleTableActivateTaskRef=OsTask_BSW_1ms
        rte_Stimulus_48: OsScheduleTblExpPointOffset=47
          TaskActivation1 (OsScheduleTableTaskActivation): OsScheduleTableActivateTaskRef=OsTask_BSW_1ms
        rte_Stimulus_49: OsScheduleTblExpPointOffset=48
          TaskActivation1 (OsScheduleTableTaskActivation): OsScheduleTableActivateTaskRef=OsTask_BSW_1ms
        rte_Stimulus_50: OsScheduleTblExpPointOffset=49
          TaskActivation1 (OsScheduleTableTaskActivation): OsScheduleTableActivateTaskRef=OsTask_BSW_1ms
        rte_Stimulus_51: OsScheduleTblExpPointOffset=50
          7 x OsScheduleTableTaskActivation:
            TaskActivation1: OsScheduleTableActivateTaskRef=Core1_OsTask_ASW_10ms
            TaskActivation2: OsScheduleTableActivateTaskRef=Core1_OsTask_BSW_10ms
            TaskActivation3: OsScheduleTableActivateTaskRef=Core2_OsTask_ASW_10ms
            TaskActivation4: OsScheduleTableActivateTaskRef=Core2_OsTask_BSW_10ms
            TaskActivation5: OsScheduleTableActivateTaskRef=OsTask_ASW_10ms
            TaskActivation6: OsScheduleTableActivateTaskRef=OsTask_BSW_10ms
            TaskActivation7: OsScheduleTableActivateTaskRef=OsTask_BSW_1ms
        rte_Stimulus_52: OsScheduleTblExpPointOffset=51
          TaskActivation1 (OsScheduleTableTaskActivation): OsScheduleTableActivateTaskRef=OsTask_BSW_1ms
        rte_Stimulus_53: OsScheduleTblExpPointOffset=52
          TaskActivation1 (OsScheduleTableTaskActivation): OsScheduleTableActivateTaskRef=OsTask_BSW_1ms
        rte_Stimulus_54: OsScheduleTblExpPointOffset=53
          TaskActivation1 (OsScheduleTableTaskActivation): OsScheduleTableActivateTaskRef=OsTask_BSW_1ms
        rte_Stimulus_55: OsScheduleTblExpPointOffset=54
          TaskActivation1 (OsScheduleTableTaskActivation): OsScheduleTableActivateTaskRef=OsTask_BSW_1ms
        rte_Stimulus_56: OsScheduleTblExpPointOffset=55
          TaskActivation1 (OsScheduleTableTaskActivation): OsScheduleTableActivateTaskRef=OsTask_BSW_1ms
        rte_Stimulus_57: OsScheduleTblExpPointOffset=56
          TaskActivation1 (OsScheduleTableTaskActivation): OsScheduleTableActivateTaskRef=OsTask_BSW_1ms
        rte_Stimulus_58: OsScheduleTblExpPointOffset=57
          TaskActivation1 (OsScheduleTableTaskActivation): OsScheduleTableActivateTaskRef=OsTask_BSW_1ms
        rte_Stimulus_59: OsScheduleTblExpPointOffset=58
          TaskActivation1 (OsScheduleTableTaskActivation): OsScheduleTableActivateTaskRef=OsTask_BSW_1ms
        rte_Stimulus_60: OsScheduleTblExpPointOffset=59
          TaskActivation1 (OsScheduleTableTaskActivation): OsScheduleTableActivateTaskRef=OsTask_BSW_1ms
        rte_Stimulus_61: OsScheduleTblExpPointOffset=60
          7 x OsScheduleTableTaskActivation:
            TaskActivation1: OsScheduleTableActivateTaskRef=Core1_OsTask_ASW_10ms
            TaskActivation2: OsScheduleTableActivateTaskRef=Core1_OsTask_BSW_10ms
            TaskActivation3: OsScheduleTableActivateTaskRef=Core2_OsTask_ASW_10ms
            TaskActivation4: OsScheduleTableActivateTaskRef=Core2_OsTask_BSW_10ms
            TaskActivation5: OsScheduleTableActivateTaskRef=OsTask_ASW_10ms
            TaskActivation6: OsScheduleTableActivateTaskRef=OsTask_BSW_10ms
            TaskActivation7: OsScheduleTableActivateTaskRef=OsTask_BSW_1ms
        rte_Stimulus_62: OsScheduleTblExpPointOffset=61
          TaskActivation1 (OsScheduleTableTaskActivation): OsScheduleTableActivateTaskRef=OsTask_BSW_1ms
        rte_Stimulus_63: OsScheduleTblExpPointOffset=62
          TaskActivation1 (OsScheduleTableTaskActivation): OsScheduleTableActivateTaskRef=OsTask_BSW_1ms
        rte_Stimulus_64: OsScheduleTblExpPointOffset=63
          TaskActivation1 (OsScheduleTableTaskActivation): OsScheduleTableActivateTaskRef=OsTask_BSW_1ms
        rte_Stimulus_65: OsScheduleTblExpPointOffset=64
          TaskActivation1 (OsScheduleTableTaskActivation): OsScheduleTableActivateTaskRef=OsTask_BSW_1ms
        rte_Stimulus_66: OsScheduleTblExpPointOffset=65
          TaskActivation1 (OsScheduleTableTaskActivation): OsScheduleTableActivateTaskRef=OsTask_BSW_1ms
        rte_Stimulus_67: OsScheduleTblExpPointOffset=66
          TaskActivation1 (OsScheduleTableTaskActivation): OsScheduleTableActivateTaskRef=OsTask_BSW_1ms
        rte_Stimulus_68: OsScheduleTblExpPointOffset=67
          TaskActivation1 (OsScheduleTableTaskActivation): OsScheduleTableActivateTaskRef=OsTask_BSW_1ms
        rte_Stimulus_69: OsScheduleTblExpPointOffset=68
          TaskActivation1 (OsScheduleTableTaskActivation): OsScheduleTableActivateTaskRef=OsTask_BSW_1ms
        rte_Stimulus_70: OsScheduleTblExpPointOffset=69
          TaskActivation1 (OsScheduleTableTaskActivation): OsScheduleTableActivateTaskRef=OsTask_BSW_1ms
        rte_Stimulus_71: OsScheduleTblExpPointOffset=70
          7 x OsScheduleTableTaskActivation:
            TaskActivation1: OsScheduleTableActivateTaskRef=Core1_OsTask_ASW_10ms
            TaskActivation2: OsScheduleTableActivateTaskRef=Core1_OsTask_BSW_10ms
            TaskActivation3: OsScheduleTableActivateTaskRef=Core2_OsTask_ASW_10ms
            TaskActivation4: OsScheduleTableActivateTaskRef=Core2_OsTask_BSW_10ms
            TaskActivation5: OsScheduleTableActivateTaskRef=OsTask_ASW_10ms
            TaskActivation6: OsScheduleTableActivateTaskRef=OsTask_BSW_10ms
            TaskActivation7: OsScheduleTableActivateTaskRef=OsTask_BSW_1ms
        rte_Stimulus_72: OsScheduleTblExpPointOffset=71
          TaskActivation1 (OsScheduleTableTaskActivation): OsScheduleTableActivateTaskRef=OsTask_BSW_1ms
        rte_Stimulus_73: OsScheduleTblExpPointOffset=72
          TaskActivation1 (OsScheduleTableTaskActivation): OsScheduleTableActivateTaskRef=OsTask_BSW_1ms
        rte_Stimulus_74: OsScheduleTblExpPointOffset=73
          TaskActivation1 (OsScheduleTableTaskActivation): OsScheduleTableActivateTaskRef=OsTask_BSW_1ms
        rte_Stimulus_75: OsScheduleTblExpPointOffset=74
          TaskActivation1 (OsScheduleTableTaskActivation): OsScheduleTableActivateTaskRef=OsTask_BSW_1ms
        rte_Stimulus_76: OsScheduleTblExpPointOffset=75
          TaskActivation1 (OsScheduleTableTaskActivation): OsScheduleTableActivateTaskRef=OsTask_BSW_1ms
        rte_Stimulus_77: OsScheduleTblExpPointOffset=76
          TaskActivation1 (OsScheduleTableTaskActivation): OsScheduleTableActivateTaskRef=OsTask_BSW_1ms
        rte_Stimulus_78: OsScheduleTblExpPointOffset=77
          TaskActivation1 (OsScheduleTableTaskActivation): OsScheduleTableActivateTaskRef=OsTask_BSW_1ms
        rte_Stimulus_79: OsScheduleTblExpPointOffset=78
          TaskActivation1 (OsScheduleTableTaskActivation): OsScheduleTableActivateTaskRef=OsTask_BSW_1ms
        rte_Stimulus_80: OsScheduleTblExpPointOffset=79
          TaskActivation1 (OsScheduleTableTaskActivation): OsScheduleTableActivateTaskRef=OsTask_BSW_1ms
        rte_Stimulus_81: OsScheduleTblExpPointOffset=80
          7 x OsScheduleTableTaskActivation:
            TaskActivation1: OsScheduleTableActivateTaskRef=Core1_OsTask_ASW_10ms
            TaskActivation2: OsScheduleTableActivateTaskRef=Core1_OsTask_BSW_10ms
            TaskActivation3: OsScheduleTableActivateTaskRef=Core2_OsTask_ASW_10ms
            TaskActivation4: OsScheduleTableActivateTaskRef=Core2_OsTask_BSW_10ms
            TaskActivation5: OsScheduleTableActivateTaskRef=OsTask_ASW_10ms
            TaskActivation6: OsScheduleTableActivateTaskRef=OsTask_BSW_10ms
            TaskActivation7: OsScheduleTableActivateTaskRef=OsTask_BSW_1ms
        rte_Stimulus_82: OsScheduleTblExpPointOffset=81
          TaskActivation1 (OsScheduleTableTaskActivation): OsScheduleTableActivateTaskRef=OsTask_BSW_1ms
        rte_Stimulus_83: OsScheduleTblExpPointOffset=82
          TaskActivation1 (OsScheduleTableTaskActivation): OsScheduleTableActivateTaskRef=OsTask_BSW_1ms
        rte_Stimulus_84: OsScheduleTblExpPointOffset=83
          TaskActivation1 (OsScheduleTableTaskActivation): OsScheduleTableActivateTaskRef=OsTask_BSW_1ms
        rte_Stimulus_85: OsScheduleTblExpPointOffset=84
          TaskActivation1 (OsScheduleTableTaskActivation): OsScheduleTableActivateTaskRef=OsTask_BSW_1ms
        rte_Stimulus_86: OsScheduleTblExpPointOffset=85
          TaskActivation1 (OsScheduleTableTaskActivation): OsScheduleTableActivateTaskRef=OsTask_BSW_1ms
        rte_Stimulus_87: OsScheduleTblExpPointOffset=86
          TaskActivation1 (OsScheduleTableTaskActivation): OsScheduleTableActivateTaskRef=OsTask_BSW_1ms
        rte_Stimulus_88: OsScheduleTblExpPointOffset=87
          TaskActivation1 (OsScheduleTableTaskActivation): OsScheduleTableActivateTaskRef=OsTask_BSW_1ms
        rte_Stimulus_89: OsScheduleTblExpPointOffset=88
          TaskActivation1 (OsScheduleTableTaskActivation): OsScheduleTableActivateTaskRef=OsTask_BSW_1ms
        rte_Stimulus_90: OsScheduleTblExpPointOffset=89
          TaskActivation1 (OsScheduleTableTaskActivation): OsScheduleTableActivateTaskRef=OsTask_BSW_1ms
        rte_Stimulus_91: OsScheduleTblExpPointOffset=90
          7 x OsScheduleTableTaskActivation:
            TaskActivation1: OsScheduleTableActivateTaskRef=Core1_OsTask_ASW_10ms
            TaskActivation2: OsScheduleTableActivateTaskRef=Core1_OsTask_BSW_10ms
            TaskActivation3: OsScheduleTableActivateTaskRef=Core2_OsTask_ASW_10ms
            TaskActivation4: OsScheduleTableActivateTaskRef=Core2_OsTask_BSW_10ms
            TaskActivation5: OsScheduleTableActivateTaskRef=OsTask_ASW_10ms
            TaskActivation6: OsScheduleTableActivateTaskRef=OsTask_BSW_10ms
            TaskActivation7: OsScheduleTableActivateTaskRef=OsTask_BSW_1ms
        rte_Stimulus_92: OsScheduleTblExpPointOffset=91
          TaskActivation1 (OsScheduleTableTaskActivation): OsScheduleTableActivateTaskRef=OsTask_BSW_1ms
        rte_Stimulus_93: OsScheduleTblExpPointOffset=92
          TaskActivation1 (OsScheduleTableTaskActivation): OsScheduleTableActivateTaskRef=OsTask_BSW_1ms
        rte_Stimulus_94: OsScheduleTblExpPointOffset=93
          TaskActivation1 (OsScheduleTableTaskActivation): OsScheduleTableActivateTaskRef=OsTask_BSW_1ms
        rte_Stimulus_95: OsScheduleTblExpPointOffset=94
          TaskActivation1 (OsScheduleTableTaskActivation): OsScheduleTableActivateTaskRef=OsTask_BSW_1ms
        rte_Stimulus_96: OsScheduleTblExpPointOffset=95
          TaskActivation1 (OsScheduleTableTaskActivation): OsScheduleTableActivateTaskRef=OsTask_BSW_1ms
        rte_Stimulus_97: OsScheduleTblExpPointOffset=96
          TaskActivation1 (OsScheduleTableTaskActivation): OsScheduleTableActivateTaskRef=OsTask_BSW_1ms
        rte_Stimulus_98: OsScheduleTblExpPointOffset=97
          TaskActivation1 (OsScheduleTableTaskActivation): OsScheduleTableActivateTaskRef=OsTask_BSW_1ms
        rte_Stimulus_99: OsScheduleTblExpPointOffset=98
          TaskActivation1 (OsScheduleTableTaskActivation): OsScheduleTableActivateTaskRef=OsTask_BSW_1ms
        rte_Stimulus_100: OsScheduleTblExpPointOffset=99
          TaskActivation1 (OsScheduleTableTaskActivation): OsScheduleTableActivateTaskRef=OsTask_BSW_1ms
