AUTOSAR XML (schema 4-2-2)
package /ARPackage_0
  application sw component type ASW_CORE1
    behavior SwcInternalBehavior
      timing event TimingEvent_0: start-on-event=RE_CORE1_SW, period=0.01
      runnable RE_CORE1_SW: symbol=ASW_CORE1_func
