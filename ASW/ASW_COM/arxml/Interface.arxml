AUTOSAR XML (schema 4-2-2)
package /COM_Interface
  10 x sender receiver interface:
    SR_Interface_HCU01_TqCmd
      data HCU01_Tq_Cmd: type=sint16
    SR_Interface_HCU01_Shift
      data HCU01_Shift: type=uint8
    SR_Interface_HCU02_Poweroff
      data HCU02_Poweroff: type=boolean
    SR_Interface_MCU01_EmergShutDown
      data MCU01_EmergShutDown: type=boolean
    SR_Interface_MCU02_MaxTor
      data MCU02_MaxTor: type=uint16
    SR_Interface_MCU03_NRF_IdcSamp
      data MCU03_NRF_IdcSamp: type=boolean
    SR_Interface_HCU03_Poweroff
      data HCU03_Poweroff: type=boolean
    SR_Interface_HCU04_Poweroff
      data HCU04_Poweroff: type=boolean
    SR_Interface_MCU04_Test
      data MCU04_Test: type=boolean
    SR_Interface_HCU05_Poweroff
      data HCU05_Poweroff: type=boolean
