AUTOSAR XML (schema 4-2-2)
package /ARPackage
  application sw component type ASW_CORE2
    behavior SwcInternalBehavior
      timing event TimingEvent_0: start-on-event=RE_CORE2_SW, period=0.01
      runnable RE_CORE2_SW: symbol=ASW_CORE2_func
