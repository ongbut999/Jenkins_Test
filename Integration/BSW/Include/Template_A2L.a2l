/*
* This is a template file. It defines integration functions necessary to complete RTA-BSW.
* The integrator must complete the templates before deploying software containing functions defined in this file.
* Once templates have been completed, the integrator should delete the #error line.
* Note: The integrator is responsible for updates made to this file.
* To remove the following error define the macro NOT_READY_FOR_TESTING_OR_DEPLOYMENT with a compiler option (e.g. -D NOT_READY_FOR_TESTING_OR_DEPLOYMENT)
* The removal of the error only allows the user to proceed with the building phase
*/ #ifndef NOT_READY_FOR_TESTING_OR_DEPLOYMENT #error The content of this file is a template which provides empty stubs. The content of this file must be completed by the integrator accordingly to project specific requirements #else #warning The content of this file is a template which provides empty stubs. The content of this file must be completed by the integrator accordingly to project specific requirements #endif
/* NOT_READY_FOR_TESTING_OR_DEPLOYMENT */ ASAP2_VERSION 1 61
/begin PROJECT template_A2L ""
/* TODO: Change name according to project needs */
/begin MODULE template_A2L ""
/* TODO: Change name according to project needs */
/* A2ML - Language definitions */
/begin IF_DATA XCPplus 0x0102 /* TODO: Change version to the needed one */ /* Include of the generated TL/PL-information */
 /include "Xcp_A2L.a2l" /* TODO: Add the correct include */ /end IF_DATA
/* TODO: Add your measurements here... */
/end MODULE
/end PROJECT
