AUTOSAR XML (schema 4-2-2)
package /MCU_FlatView
  flat map MCU_FlatMap
    36 x flat instance descriptor:
      CPT_ASW_BASE: upstream-reference=RootSwCompositionPrototype.CPT_ASW_BASE, ecu-extract-reference=CPT_MCU_FlatView.CPT_ASW_BASE
      AppMode: sw-refresh-timing={cse-code=5, cse-code-factor=1}, upstream-reference=RootSwCompositionPrototype.CPT_ASW_BASE.PPort_SwcModeRequest.AppMode, ecu-extract-reference=CPT_MCU_FlatView.CPT_ASW_BASE.PPort_SwcModeRequest.AppMode
      CPT_ASW_COM: upstream-reference=RootSwCompositionPrototype.CPT_ASW_COM, ecu-extract-reference=CPT_MCU_FlatView.CPT_ASW_COM
      MCU01_EmergShutDown: sw-refresh-timing={cse-code=4, cse-code-factor=1}, upstream-reference=RootSwCompositionPrototype.CPT_ASW_COM.PPort_MCU01_EmergShutDown.MCU01_EmergShutDown, ecu-extract-reference=CPT_MCU_FlatView.CPT_ASW_COM.PPort_MCU01_EmergShutDown.MCU01_EmergShutDown
      MCU02_MaxTor: sw-refresh-timing={cse-code=4, cse-code-factor=1}, upstream-reference=RootSwCompositionPrototype.CPT_ASW_COM.PPort_MCU02_MaxTor.MCU02_MaxTor, ecu-extract-reference=CPT_MCU_FlatView.CPT_ASW_COM.PPort_MCU02_MaxTor.MCU02_MaxTor
      MCU03_NRF_IdcSamp: sw-refresh-timing={cse-code=4, cse-code-factor=1}, upstream-reference=RootSwCompositionPrototype.CPT_ASW_COM.PPort_MCU03_NRF_IdcSamp.MCU03_NRF_IdcSamp, ecu-extract-reference=CPT_MCU_FlatView.CPT_ASW_COM.PPort_MCU03_NRF_IdcSamp.MCU03_NRF_IdcSamp
      HCU01_Shift: sw-refresh-timing={cse-code=4, cse-code-factor=1}, upstream-reference=RootSwCompositionPrototype.CPT_ASW_COM.RPort_HCU01_Shift.HCU01_Shift, ecu-extract-reference=CPT_MCU_FlatView.CPT_ASW_COM.RPort_HCU01_Shift.HCU01_Shift
      HCU01_Tq_Cmd: sw-refresh-timing={cse-code=4, cse-code-factor=1}, upstream-reference=RootSwCompositionPrototype.CPT_ASW_COM.RPort_HCU01_TqCmd.HCU01_Tq_Cmd, ecu-extract-reference=CPT_MCU_FlatView.CPT_ASW_COM.RPort_HCU01_TqCmd.HCU01_Tq_Cmd
      HCU02_Poweroff: sw-refresh-timing={cse-code=4, cse-code-factor=1}, upstream-reference=RootSwCompositionPrototype.CPT_ASW_COM.RPort_HCU02_Poweroff.HCU02_Poweroff, ecu-extract-reference=CPT_MCU_FlatView.CPT_ASW_COM.RPort_HCU02_Poweroff.HCU02_Poweroff
      CPT_ASW_CORE1: upstream-reference=RootSwCompositionPrototype.CPT_ASW_CORE1, ecu-extract-reference=CPT_MCU_FlatView.CPT_ASW_CORE1
      CPT_ASW_CORE2: upstream-reference=RootSwCompositionPrototype.CPT_ASW_CORE2, ecu-extract-reference=CPT_MCU_FlatView.CPT_ASW_CORE2
      CPT_ASW_NM: upstream-reference=RootSwCompositionPrototype.CPT_ASW_NM, ecu-extract-reference=CPT_MCU_FlatView.CPT_ASW_NM
      ASW_NVM_BlockNative_1024_1: upstream-reference=RootSwCompositionPrototype.CPT_ASW_NVM.ASW_NVM_BlockNative_1024_1, ecu-extract-reference=CPT_MCU_FlatView.CPT_ASW_NVM.ASW_NVM_BlockNative_1024_1
      ASW_NVM_BlockNative_1024_2: upstream-reference=RootSwCompositionPrototype.CPT_ASW_NVM.ASW_NVM_BlockNative_1024_2, ecu-extract-reference=CPT_MCU_FlatView.CPT_ASW_NVM.ASW_NVM_BlockNative_1024_2
      CPT_ASW_NVM: upstream-reference=RootSwCompositionPrototype.CPT_ASW_NVM, ecu-extract-reference=CPT_MCU_FlatView.CPT_ASW_NVM
      CPT_ASW_WDG: upstream-reference=RootSwCompositionPrototype.CPT_ASW_WDG, ecu-extract-reference=CPT_MCU_FlatView.CPT_ASW_WDG
      CPT_BswM: upstream-reference=RootSwCompositionPrototype.CPT_BswM, ecu-extract-reference=CPT_MCU_FlatView.CPT_BswM
      uint8: sw-refresh-timing={cse-code=1000, cse-code-factor=1}, upstream-reference=RootSwCompositionPrototype.CPT_BswM.RP_BswMArbitration_BswM_MRP_SWC_Network.uint8, ecu-extract-reference=CPT_MCU_FlatView.CPT_BswM.RP_BswMArbitration_BswM_MRP_SWC_Network.uint8
      CPT_ComM: upstream-reference=RootSwCompositionPrototype.CPT_ComM, ecu-extract-reference=CPT_MCU_FlatView.CPT_ComM
      CPT_Dcm: upstream-reference=RootSwCompositionPrototype.CPT_Dcm, ecu-extract-reference=CPT_MCU_FlatView.CPT_Dcm
      Data: upstream-reference=RootSwCompositionPrototype.CPT_Dcm.P_DataServices_DcmDspData_SystemFaultRank.Data, ecu-extract-reference=CPT_MCU_FlatView.CPT_Dcm.P_DataServices_DcmDspData_SystemFaultRank.Data
      Data_0: upstream-reference=RootSwCompositionPrototype.CPT_Dcm.P_DataServices_DcmDspData_VehicleSpeed.Data, ecu-extract-reference=CPT_MCU_FlatView.CPT_Dcm.P_DataServices_DcmDspData_VehicleSpeed.Data
      CPT_Dem: upstream-reference=RootSwCompositionPrototype.CPT_Dem, ecu-extract-reference=CPT_MCU_FlatView.CPT_Dem
      CPT_Dem_SWC: upstream-reference=RootSwCompositionPrototype.CPT_Dem_SWC, ecu-extract-reference=CPT_MCU_FlatView.CPT_Dem_SWC
      CPT_Det: upstream-reference=RootSwCompositionPrototype.CPT_Det, ecu-extract-reference=CPT_MCU_FlatView.CPT_Det
      CPT_Diag: upstream-reference=RootSwCompositionPrototype.CPT_Diag, ecu-extract-reference=CPT_MCU_FlatView.CPT_Diag
      Data_1: sw-refresh-timing={cse-code=4, cse-code-factor=1}, upstream-reference=RootSwCompositionPrototype.CPT_Diag.P_DataServices_DcmDspData_SystemFaultRank_Read.Data, ecu-extract-reference=CPT_MCU_FlatView.CPT_Diag.P_DataServices_DcmDspData_SystemFaultRank_Read.Data
      Data_2: sw-refresh-timing={cse-code=4, cse-code-factor=1}, upstream-reference=RootSwCompositionPrototype.CPT_Diag.P_DataServices_DcmDspData_VehicleSpeed_Read.Data, ecu-extract-reference=CPT_MCU_FlatView.CPT_Diag.P_DataServices_DcmDspData_VehicleSpeed_Read.Data
      CPT_EcuM: upstream-reference=RootSwCompositionPrototype.CPT_EcuM, ecu-extract-reference=CPT_MCU_FlatView.CPT_EcuM
      CPT_NvM: upstream-reference=RootSwCompositionPrototype.CPT_NvM, ecu-extract-reference=CPT_MCU_FlatView.CPT_NvM
      CPT_Wdg: upstream-reference=RootSwCompositionPrototype.CPT_Wdg, ecu-extract-reference=CPT_MCU_FlatView.CPT_Wdg
      CPT_XCP: upstream-reference=RootSwCompositionPrototype.CPT_XCP, ecu-extract-reference=CPT_MCU_FlatView.CPT_XCP
      HCU03_Poweroff: sw-refresh-timing={cse-code=4, cse-code-factor=1}, upstream-reference=RootSwCompositionPrototype.CPT_ASW_COM.RPott_HCU03_Poweroff.HCU03_Poweroff, ecu-extract-reference=CPT_MCU_FlatView.CPT_ASW_COM.RPott_HCU03_Poweroff.HCU03_Poweroff
      MCU04_Test: sw-refresh-timing={cse-code=4, cse-code-factor=1}, upstream-reference=RootSwCompositionPrototype.CPT_ASW_COM.PPort_MCU04_Test.MCU04_Test, ecu-extract-reference=CPT_MCU_FlatView.CPT_ASW_COM.PPort_MCU04_Test.MCU04_Test
      HCU04_Poweroff: sw-refresh-timing={cse-code=4, cse-code-factor=1}, upstream-reference=RootSwCompositionPrototype.CPT_ASW_COM.RPort_HCU04_Poweroff.HCU04_Poweroff, ecu-extract-reference=CPT_MCU_FlatView.CPT_ASW_COM.RPort_HCU04_Poweroff.HCU04_Poweroff
      HCU05_Poweroff: sw-refresh-timing={cse-code=4, cse-code-factor=1}, upstream-reference=RootSwCompositionPrototype.CPT_ASW_COM.RPort_HCU05_Poweroff.HCU05_Poweroff, ecu-extract-reference=CPT_MCU_FlatView.CPT_ASW_COM.RPort_HCU05_Poweroff.HCU05_Poweroff
