AUTOSAR XML (schema 4-2-2)
package /ETAS_Project/EcucModuleConfigurationValuess
  module config MemIf: implementation-config-variant=VARIANT-PRE-COMPILE
    MemIfGeneral: MemIfVersionInfoApi=false, MemIfDevErrorDetect=true, MemIfNumberOfDevices=1
