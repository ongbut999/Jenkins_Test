AUTOSAR XML (schema 4-2-2)
package /ETAS_Project/EcucModuleConfigurationValuess
  module config NvM: implementation-config-variant=VARIANT-PRE-COMPILE
    9 x NvMBlockDescriptor, all with NvMSelectBlockForReadAll=true, NvMSelectBlockForWriteAll=true, NvMBlockJobPriority=1, NvMBlockManagementType=NVM_BLOCK_NATIVE, NvMBlockUseCrc=true, NvMBlockWriteProt=false, NvMInitBlockCallback=NULL_PTR, NvMMaxNumOfReadRetries=0, NvMMaxNumOfWriteRetries=0, NvMNvBlockNum=1, NvMNvramDeviceId=0, NvMResistantToChangedSw=false, NvMRomBlockNum=0, NvMStaticBlockIDCheck=false, NvMWriteBlockOnce=false, NvMWriteVerification=false, NvMWriteVerificationDataSize=0, NvMBlockCrcType=NVM_CRC16:
      NvMBlockDescriptor_DID_VehicleSpeed: NvMBlockUseSyncMechanism=false, NvMNvBlockLength=17, NvMRamBlockDataAddress=RamBlock_DID_F189
      NvMBlockDescriptor_DID_SystemFaultRank: NvMBlockUseSyncMechanism=false, NvMNvBlockLength=4, NvMRamBlockDataAddress=RamBlock_DID_F199
      NvMBlockDescriptor_Dem_EvMemEventMemory{0..4}: NvMBlockUseSyncMechanism=true, NvMCalcRamBlockCrc=0, NvMNvBlockLength=20, NvMReadRamBlockFromNvCallback=Dem_EvMemNvmReadRamBlockFromNvCallback{0..4}, NvMSingleBlockCallback=NULL_PTR, NvMWriteRamBlockToNvCallback=Dem_EvMemNvMWriteRamBlockToNvCallback{0..4}, NvMRbGenRteServicePort=false
      NvMBlockDescriptor_Dem_GenericNvData: NvMBlockUseSyncMechanism=true, NvMCalcRamBlockCrc=0, NvMNvBlockLength=16, NvMReadRamBlockFromNvCallback=Dem_GenericNVDataReadRamBlockFromNvCallback, NvMSingleBlockCallback=NULL_PTR, NvMWriteRamBlockToNvCallback=Dem_GenericNVDataWriteRamBlockToNvCallback, NvMRbGenRteServicePort=false
      NvMBlockDescriptor_Dem_AllEventsStatusByte: NvMBlockUseSyncMechanism=true, NvMCalcRamBlockCrc=0, NvMNvBlockLength=6, NvMReadRamBlockFromNvCallback=Dem_EventStatusByteReadRamBlockFromNvCallback, NvMWriteRamBlockToNvCallback=Dem_EventStatusByteWriteRamBlockToNvCallback, NvMRbGenRteServicePort=false
