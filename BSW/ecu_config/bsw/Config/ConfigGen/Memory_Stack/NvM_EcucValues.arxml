AUTOSAR XML (schema 4-2-2)
package /ETAS_Project/EcucModuleConfigurationValuess
  module config NvM: implementation-config-variant=VARIANT-PRE-COMPILE
    NvMCommon:
      NvMApiConfigClass = NVM_API_CONFIG_CLASS_3
      NvMBswMMultiBlockJobStatusInformation = true
      NvMCompiledConfigId = 0
      NvMCrcNumOfBytes = 1
      NvMDrvModeSwitch = false
      NvMDynamicConfiguration = false
      NvMJobPrioritization = false
      NvMMainFunctionCycleTime = 0.01
      NvMMultiBlockCallback = NULL_PTR
      NvMPollingMode = true
      NvMSetRamBlockStatusApi = true
      NvMSizeStandardJobQueue = 5
      NvMVersionInfoApi = false
      NvMDevErrorDetect = true
      NvMRbSetWriteAllTriggerApi = true
      NvMRbAuxInterface = false
      NvMRbGenArxmlVersion = NVM_GEN_ARXML_VERSION_402
      NvMRbInitAtLayoutChange = false
      NvMRbRamInitCheck = NVM_RB_RAM_INIT_CHECK_NONE
      NvMRbReqMonitor = NVM_RB_REQ_MON_DISABLED
      NvMRbRuntimeRamBlockConfiguration = false
      NvMRepeatMirrorOperations = 0
      NvMSizeImmediateJobQueue = 5
    4 x NvMBlockDescriptor, all with NvMBlockJobPriority=1, NvMBlockWriteProt=false, NvMWriteBlockOnce=false, NvMWriteVerification=false, NvMResistantToChangedSw=false, NvMBlockManagementType=NVM_BLOCK_NATIVE, NvMBlockUseCrc=true, NvMBlockUseSyncMechanism=false, NvMMaxNumOfReadRetries=0, NvMMaxNumOfWriteRetries=0, NvMNvBlockNum=1, NvMNvramDeviceId=0, NvMStaticBlockIDCheck=false, NvMWriteVerificationDataSize=0, NvMInitBlockCallback=NULL_PTR, NvMBlockCrcType=NVM_CRC16, NvMReadRamBlockFromNvCallback=NULL_PTR, NvMWriteRamBlockToNvCallback=NULL_PTR:
      NvM_MultiBlock: NvMNvBlockLength=1, NvMRomBlockNum=0, NvMRomBlockDataAddress=NULL_PTR, NvMSingleBlockCallback=NULL_PTR, NvMRamBlockDataAddress=NULL_PTR
      NvM_ConfigId: NvMNvBlockLength=1, NvMRamBlockDataAddress=NvM_Prv_idConfigStored_u16, NvMSelectBlockForReadAll=true, NvMSelectBlockForWriteAll=true, NvMRomBlockNum=0, NvMRomBlockDataAddress=NULL_PTR
      NvM_NativeBlock_1024_1: NvMRomBlockNum=1, NvMCalcRamBlockCrc=false, NvMNvBlockLength=1024, NvMRamBlockDataAddress=Rte_CPim_ASW_NVM_ASW_NVM_BlockNative_1024_1, NvMSelectBlockForWriteAll=true, NvMSelectBlockForReadAll=true, NvMRomBlockDataAddress=Rte_ROM_ASW_NVM_ASW_NVM_BlockNative_1024_1
      NvM_NativeBlock_1024_2: NvMRomBlockNum=1, NvMCalcRamBlockCrc=false, NvMNvBlockLength=1024, NvMRamBlockDataAddress=Rte_CPim_ASW_NVM_ASW_NVM_BlockNative_1024_2, NvMSelectBlockForWriteAll=true, NvMSelectBlockForReadAll=true, NvMRomBlockDataAddress=Rte_ROM_ASW_NVM_ASW_NVM_BlockNative_1024_2
