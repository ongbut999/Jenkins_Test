AUTOSAR XML (schema 4-2-2)
package /ETAS_Project/EcucModuleConfigurationValuess
  module config Fee: implementation-config-variant=VARIANT-PRE-COMPILE
    FeeGeneral:
      FeeIndex = 0
      FeePollingMode = true
      FeeRbMachineType = MCU_RB_MANUAL_CFG
      FeeSetModeSupported = false
      FeeVersionInfoApi = false
      FeeVirtualPageSize = 8
      FeeDevErrorDetect = true
      FeeRbFsSelect = FS1
      FeeRbConfirmSingleStorageBlockloss = true
      FeeNvmJobEndNotification = Fee_NvmJobEndNotification
      FeeNvmJobErrorNotification = Fee_NvmJobErrorNotification
      FeeRbSectorTable: FeeRbFastCacheInitActive=true, FeeRbHeaderRecheckActive=false, FlsRbPageSize=8, FlsRbErasedValue=0
        FeeRbSector_0 (FeeRbSector): FlsRbSectorSize=16384
        FeeRbSector_1 (FeeRbSector): FlsRbSectorSize=16384
    FeePublishedInformation
