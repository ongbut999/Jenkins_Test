AUTOSAR XML (schema 4-2-2)
package /RB/UBK/Project/EcucModuleConfigurationValuess
  module config WdgM
    WdgMConfigSet: WdgMInitialMode=WdgMConfigSet/WdgMMode_SlowMode
      3 x WdgMMode:
        WdgMMode_SlowMode: WdgMExpiredSupervisionCycleTol=0, WdgMModeId=1, WdgMSupervisionCycle=0.01
          Alive_Supervision_Entity1 (WdgMAliveSupervision):
            WdgMMaxMargin = 1
            WdgMMinMargin = 1
            WdgMExpectedAliveIndications = 9
            WdgMSupervisionReferenceCycle = 10
            WdgMAliveSupervisionCheckpointRef = WdgMCheckpoint_Alive_Supervision_Entity1
          WdgMLocalStatusParams_Alive_Supervision_Entity1 (WdgMLocalStatusParams): WdgMFailedAliveSupervisionRefCycleTol=0, WdgMLocalStatusSupervisedEntityRef=WdgMSupervisedEntity_Alive_Supervision_Entity1
          WdgMTrigger_SlowMode (WdgMTrigger): WdgMTriggerConditionValue=100, WdgMWatchDogMode=WDGIF_SLOW_MODE, WdgMTriggerWatchDogRef=WdgMWatchdog
        WdgMMode_SlowMode
        WdgMMode_FastMode: WdgMExpiredSupervisionCycleTol=0, WdgMModeId=0, WdgMSupervisionCycle=0.01
          Alive_Supervision_Entity1 (WdgMAliveSupervision):
            WdgMExpectedAliveIndications = 10
            WdgMMaxMargin = 2
            WdgMMinMargin = 0
            WdgMSupervisionReferenceCycle = 10
            WdgMAliveSupervisionCheckpointRef = WdgMCheckpoint_Alive_Supervision_Entity1
          WdgMLocalStatusParams_Alive_Supervision_Entity1 (WdgMLocalStatusParams): WdgMFailedAliveSupervisionRefCycleTol=2, WdgMLocalStatusSupervisedEntityRef=WdgMSupervisedEntity_Alive_Supervision_Entity1
          WdgMTrigger_FastMode (WdgMTrigger): WdgMTriggerConditionValue=40, WdgMWatchDogMode=WDGIF_FAST_MODE, WdgMTriggerWatchDogRef=WdgMWatchdog
      WdgMDemEventParameterRefs: WDGM_E_SUPERVISION=DemEventParameter_C153364
    WdgMGeneral:
      WdgMDefensiveBehavior = false
      WdgMDemStoppedSupervisionReport = true
      WdgMDevErrorDetect = true
      WdgMImmediateReset = false
      WdgMOffModeEnabled = false
      WdgMRbDeadlineTimeOutDetect = true
      WdgMRbDeadlineTimerSelection = AUTOSAR_OS_TIMER
      WdgMRbDebugOptionEnable = false
      WdgMRbInterruptLockDisable = true
      WdgMVersionInfoApi = false
      WdgMRbRteDisabled = false
      WdgMSupervisedEntity_Alive_Supervision_Entity1 (WdgMSupervisedEntity):
        WdgMSupervisedEntityId = 0
        WdgMInternalCheckpointInitialRef = WdgMCheckpoint_Alive_Supervision_Entity1
        WdgMInternalCheckpointFinalRef = WdgMCheckpoint_Alive_Supervision_Entity1
        WdgMCheckpoint_Alive_Supervision_Entity1 (WdgMCheckpoint): WdgMCheckpointId=0
      WdgMWatchdog: WdgMWatchdogDeviceRef=WdgIfDevice
