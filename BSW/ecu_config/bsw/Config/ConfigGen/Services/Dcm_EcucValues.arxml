AUTOSAR XML (schema 4-2-2)
package /ETAS_Project/EcucModuleConfigurationValuess
  module config Dcm: implementation-config-variant=VARIANT-PRE-COMPILE
    DcmConfigSet
      DcmDsd: DcmDsdRequestManufacturerNotificationEnabled=false, DcmDsdRequestSupplierNotificationEnabled=false
        DcmDsdServiceTable_UDS (DcmDsdServiceTable): DcmDsdSidTabId=0
          12 x DcmDsdService, all with DcmRbDsdSidTabScheduler=DcmMainScheduler, DcmDsdSidTabSessionLevelRef=DcmDspSession/ExtendedDiagnosticSession:
            DiagnosticSessionControl: DcmDsdSidTabFnc=Dcm_DcmDiagnosticSessionControl, DcmDsdSidTabServiceId=16, DcmDsdSidTabSubfuncAvail=true, DcmRbDsdSidTabSidInitFunction=Dcm_Dsp_DscIni, DcmDsdSidTabSessionLevelRef=DcmDspSession/DefaultSession, DcmDsdSidTabSessionLevelRef=DcmDspSession/ProgrammingSession
              3 x DcmDsdSubService, all with DcmDsdSubServiceSessionLevelRef=DcmDspSession/DefaultSession, DcmDsdSubServiceSessionLevelRef=DcmDspSession/ProgrammingSession, DcmDsdSubServiceSessionLevelRef=DcmDspSession/ExtendedDiagnosticSession:
                DefaultSession: DcmDsdSubServiceId=1
                ProgrammingSession: DcmDsdSubServiceId=2
                ExtendedDiagnosticSession: DcmDsdSubServiceId=3
            SecurityAccess: DcmDsdSidTabFnc=Dcm_DcmSecurityAccess, DcmDsdSidTabServiceId=39, DcmDsdSidTabSubfuncAvail=true, DcmRbDsdSidTabSidInitFunction=Dcm_Dsp_SecaIni, DcmDsdSidTabSessionLevelRef=DcmDspSession/ProgrammingSession
              DcmDsdSubService_requestSeed_SEC_LEV_L1 (DcmDsdSubService):
                DcmDsdSubServiceId = 1
                DcmDsdSubServiceSessionLevelRef = DcmDspSession/ExtendedDiagnosticSession
                DcmDsdSubServiceSessionLevelRef = DcmDspSession/ProgrammingSession
              DcmDsdSubService_sendKey_SEC_LEV_L1 (DcmDsdSubService):
                DcmDsdSubServiceId = 2
                DcmDsdSubServiceSessionLevelRef = DcmDspSession/ExtendedDiagnosticSession
                DcmDsdSubServiceSessionLevelRef = DcmDspSession/ProgrammingSession
            TesterPresent: DcmDsdSidTabFnc=Dcm_DcmTesterPresent, DcmDsdSidTabServiceId=62, DcmDsdSidTabSubfuncAvail=true, DcmRbDsdSidTabSidInitFunction=NULL_PTR, DcmDsdSidTabSessionLevelRef=DcmDspSession/DefaultSession, DcmDsdSidTabSessionLevelRef=DcmDspSession/ProgrammingSession
              zeroSubFunction (DcmDsdSubService):
                DcmDsdSubServiceId = 0
                DcmDsdSubServiceSessionLevelRef = DcmDspSession/DefaultSession
                DcmDsdSubServiceSessionLevelRef = DcmDspSession/ExtendedDiagnosticSession
                DcmDsdSubServiceSessionLevelRef = DcmDspSession/ProgrammingSession
            ECUReset: DcmDsdSidTabFnc=Dcm_DcmEcuReset, DcmDsdSidTabServiceId=17, DcmDsdSidTabSubfuncAvail=true, DcmRbDsdSidTabSidInitFunction=Dcm_Dsp_EcuReset_Ini, DcmDsdSidTabSessionLevelRef=DcmDspSession/DefaultSession
              HARD (DcmDsdSubService):
                DcmDsdSubServiceId = 1
                DcmDsdSubServiceSessionLevelRef = DcmDspSession/DefaultSession
                DcmDsdSubServiceSessionLevelRef = DcmDspSession/ExtendedDiagnosticSession
              SOFT (DcmDsdSubService):
                DcmDsdSubServiceId = 3
                DcmDsdSubServiceSessionLevelRef = DcmDspSession/DefaultSession
                DcmDsdSubServiceSessionLevelRef = DcmDspSession/ExtendedDiagnosticSession
            CommunicationControl: DcmDsdSidTabFnc=Dcm_DcmCommunicationControl, DcmDsdSidTabServiceId=40, DcmDsdSidTabSubfuncAvail=true, DcmRbDsdSidTabSidInitFunction=NULL_PTR
              4 x DcmDsdSubService, all with DcmDsdSubServiceSessionLevelRef=DcmDspSession/ExtendedDiagnosticSession:
                enableRxAndTx: DcmDsdSubServiceId=0
                enableRxAndDisableTx: DcmDsdSubServiceId=1
                disableRxAndEnableTx: DcmDsdSubServiceId=2
                disableRxAndTx: DcmDsdSubServiceId=3
            RoutineControl: DcmDsdSidTabFnc=Dcm_DcmRoutineControl, DcmDsdSidTabServiceId=49, DcmDsdSidTabSubfuncAvail=true, DcmRbDsdSidTabSidInitFunction=Dcm_Dsp_RC_Ini, DcmDsdSidTabSecurityLevelRef=DSP_SEC_LEV_L1
              3 x DcmDsdSubService, all with DcmDsdSubServiceSecurityLevelRef=DSP_SEC_LEV_L1, DcmDsdSubServiceSessionLevelRef=DcmDspSession/ExtendedDiagnosticSession:
                startRoutine: DcmDsdSubServiceId=1
                stopRoutine: DcmDsdSubServiceId=2
                requestRoutineResults: DcmDsdSubServiceId=3
            InputOutpuControlByIdentifier: DcmDsdSidTabFnc=Dcm_DcmInputOutputControlByIdentifier, DcmDsdSidTabServiceId=47, DcmRbDsdSidTabSidInitFunction=Dcm_Dsp_IOCBI_Ini, DcmDsdSidTabSubfuncAvail=false, DcmDsdSidTabSecurityLevelRef=DSP_SEC_LEV_L1
            ReadDataByIdentifier: DcmDsdSidTabFnc=Dcm_DcmReadDataByIdentifier, DcmDsdSidTabServiceId=34, DcmDsdSidTabSubfuncAvail=false, DcmRbDsdSidTabSidInitFunction=Dcm_Dsp_RdbiIni, DcmDsdSidTabSessionLevelRef=DcmDspSession/DefaultSession
            WriteDataByIdentifier: DcmDsdSidTabFnc=Dcm_DcmWriteDataByIdentifier, DcmDsdSidTabServiceId=46, DcmDsdSidTabSubfuncAvail=false, DcmRbDsdSidTabSidInitFunction=Dcm_Dcm_WDBIInit, DcmDsdSidTabSecurityLevelRef=DSP_SEC_LEV_L1
            ReadDTCInformation: DcmDsdSidTabFnc=Dcm_DcmReadDTCInformation, DcmDsdSidTabServiceId=25, DcmDsdSidTabSubfuncAvail=true, DcmRbDsdSidTabSidInitFunction=Dcm_Dsp_ReadDTCInfo_Ini, DcmDsdSidTabSessionLevelRef=DcmDspSession/DefaultSession
              5 x DcmDsdSubService, all with DcmDsdSubServiceSessionLevelRef=DcmDspSession/DefaultSession, DcmDsdSubServiceSessionLevelRef=DcmDspSession/ExtendedDiagnosticSession:
                DcmDsdSubService_ReportNumberOfDTCByStatusMask: DcmDsdSubServiceId=1
                DcmDsdSubService_ReportDTCByStatusMask: DcmDsdSubServiceId=2
                DcmDsdSubService_ReportDTCSnapshotRecordByDTCNumber: DcmDsdSubServiceId=4
                DcmDsdSubService_ReportDTCExtendedDataRecordByDTCNumber: DcmDsdSubServiceId=6
                DcmDsdSubService_ReportSupportedDTC: DcmDsdSubServiceId=10
            ClearDiagnosticInformation: DcmDsdSidTabFnc=Dcm_DcmClearDiagnosticInformation, DcmDsdSidTabServiceId=20, DcmDsdSidTabSubfuncAvail=false, DcmRbDsdSidTabSidInitFunction=Dcm_Dsp_CDIIni, DcmDsdSidTabSessionLevelRef=DcmDspSession/DefaultSession
            ControlDTCSetting: DcmDsdSidTabFnc=Dcm_DcmControlDTCSetting, DcmDsdSidTabServiceId=133, DcmDsdSidTabSubfuncAvail=true, DcmRbDsdSidTabSidInitFunction=Dcm_Dsp_CDTCSIni
              On (DcmDsdSubService): DcmDsdSubServiceId=1, DcmDsdSubServiceSessionLevelRef=DcmDspSession/ExtendedDiagnosticSession
              Off (DcmDsdSubService): DcmDsdSubServiceId=2, DcmDsdSubServiceSessionLevelRef=DcmDspSession/ExtendedDiagnosticSession
      DcmDsl
        DcmDslBuffer_UDS_Tx (DcmDslBuffer): DcmDslBufferSize=255
        DcmDslBuffer_UDS_Rx (DcmDslBuffer): DcmDslBufferSize=255
        DcmDslDiagResp: DcmDslDiagRespMaxNumRespPend=5
        DcmDslProtocol
          DcmDslProtocolRow_UDS (DcmDslProtocolRow):
            DcmDslProtocolID = DCM_UDS_ON_CAN
            DcmDslProtocolPriority = 0
            DcmSendRespPendOnTransToBoot = 0
            DcmTimStrP2ServerAdjust = 0.01
            DcmTimStrP2StarServerAdjust = 0.01
            DcmDslProtocolRxBufferRef = DcmDslBuffer_UDS_Rx
            DcmDslProtocolSIDTable = DcmDsdServiceTable_UDS
            DcmDslProtocolTxBufferRef = DcmDslBuffer_UDS_Tx
            DcmDslConnection_CAN (DcmDslConnection)
              DcmDslMainConnection: DcmDslProtocolRxTesterSourceAddr=0, DcmDslProtocolComMChannelRef=ComMChannel_Can_Network_Channel
                Diag_Physical_request_Can_Network_CANNODE_0_Phys_PduR2Dcm (DcmDslProtocolRx): DcmDslProtocolRxAddrType=DCM_PHYSICAL_TYPE, DcmDslProtocolRxPduRef=Diag_Physical_request_Can_Network_CANNODE_0_PduR2Dcm
                Diag_Functional_request_Can_Network_CANNODE_0_Phys_PduR2Dcm (DcmDslProtocolRx): DcmDslProtocolRxAddrType=DCM_FUNCTIONAL_TYPE, DcmDslProtocolRxPduRef=Diag_Functional_request_Can_Network_CANNODE_0_PduR2Dcm
                Diag_Physical_response_Can_Network_CANNODE_0_Phys_Dcm2PduR (DcmDslProtocolTx): DcmDslTxConfirmationPduId=0, DcmDslProtocolTxPduRef=Diag_Physical_response_Can_Network_CANNODE_0_Phys_Dcm2PduR
        DcmDslBuffer_RDPI (DcmDslBuffer): DcmDslBufferSize=4095
      DcmDsp:
        DcmDspDataDefaultEndianness = BIG_ENDIAN
        DcmDspMaxDidToRead = 1
        DcmDspMaxPeriodicDidToRead = 1
        DcmRbDspSesSecUsedInProtocol = UDS
        DcmRbDspSequenceCheckRequestUploadDisabled = false
        DcmDspSecurity: DcmRbDspSecurityDelayTimerMonitor=REQUEST_SEED, DcmRbDspSecurityNRCExceedNoOfAttempt=NumAttDelayAndNumAttLock, DcmRbDspSecurityStoreSeed=false
          DSP_SEC_LEV_L1 (DcmDspSecurityRow):
            DcmDspSecurityAttemptCounterEnabled = false
            DcmDspSecurityDelayTime = 10.0
            DcmDspSecurityDelayTimeOnBoot = 10.0
            DcmDspSecurityKeySize = 4
            DcmDspSecurityLevel = 1
            DcmDspSecurityNumAttDelay = 2
            DcmDspSecuritySeedSize = 4
            DcmDspSecurityUsePort = USE_ASYNCH_FNC
            DcmRbDspSecurityNumAttLock = 0
            DcmDspSecurityGetSeedFnc = GetSeed
            DcmDspSecurityCompareKeyFnc = CompareKey
        DcmDspSession: DcmRbDspSessionParamRecordEnabled=true
          3 x DcmDspSessionRow, all with DcmDspSessionP2ServerMax=0.05, DcmDspSessionP2StarServerMax=5.0:
            DefaultSession: DcmDspSessionForBoot=DCM_NO_BOOT, DcmDspSessionLevel=1
            ProgrammingSession: DcmDspSessionForBoot=DCM_OEM_BOOT, DcmDspSessionLevel=2
            ExtendedDiagnosticSession: DcmDspSessionForBoot=DCM_NO_BOOT, DcmDspSessionLevel=3
        DcmDspDriveVacuumPumpRoutineAuthorization (DcmDspCommonAuthorization): DcmDspCommonAuthorizationSessionRef=DcmDspSession/ExtendedDiagnosticSession, DcmDspCommonAuthorizationSecurityLevelRef=DSP_SEC_LEV_L1
        DcmDspComControl
          DcmDspComControlAllChannel: DcmDspAllComMChannelRef=ComMChannel_Can_Network_Channel
        DcmDspRoutine_DriveVacuumPump (DcmDspRoutine): DcmRbDspStopRoutineOnSessionChange=true, DcmDspRoutineIdentifier=1537, DcmDspRoutineUsePort=true
          DcmDspDriveVacuumPumpRequestRoutineResults (DcmDspRequestRoutineResults): DcmDspRequestRoutineResultsCommonAuthorizationRef=DcmDspDriveVacuumPumpRoutineAuthorization
            DcmDspRequestRoutineResultsOut_0 (DcmDspRequestRoutineResultsOut)
              DcmDspRequestRoutineResultsOutSignal_0 (DcmDspRequestRoutineResultsOutSignal): DcmDspRoutineSignalEndianness=LITTLE_ENDIAN, DcmDspRoutineSignalLength=8, DcmDspRoutineSignalPos=0, DcmDspRoutineSignalType=UINT8
          DcmDspDriveVacuumPumpStartRoutine (DcmDspStartRoutine): DcmDspStartRoutineCommonAuthorizationRef=DcmDspDriveVacuumPumpRoutineAuthorization
            DcmDspStartRoutineIn
              DcmDspStartRoutineInSignal: DcmDspRoutineSignalEndianness=LITTLE_ENDIAN, DcmDspRoutineSignalLength=8, DcmDspRoutineSignalPos=0, DcmDspRoutineSignalType=UINT8
            DcmDspStartRoutineOut
              DcmDspStartRoutineOutSignal: DcmDspRoutineSignalEndianness=LITTLE_ENDIAN, DcmDspRoutineSignalLength=8, DcmDspRoutineSignalPos=0, DcmDspRoutineSignalType=UINT8
          DcmDspDriveVacuumPumpStopRoutine (DcmDspStopRoutine): DcmDspStopRoutineCommonAuthorizationRef=DcmDspDriveVacuumPumpRoutineAuthorization
            DcmDspStopRoutineOut
              DcmDspStopRoutineOutSignal: DcmDspRoutineSignalEndianness=LITTLE_ENDIAN, DcmDspRoutineSignalLength=8, DcmDspRoutineSignalPos=0, DcmDspRoutineSignalType=UINT8
        DcmDspData_VacuumPumpPressure_1100 (DcmDspData): DcmDspDataSize=16, DcmDspDataType=UINT8_N, DcmDspDataUsePort=USE_DATA_SYNCH_CLIENT_SERVER, DcmDspDataConditionCheckReadFncUsed=false
        DcmDspDidInfo_VacuumPumpPressure_1100 (DcmDspDidInfo): DcmDspDidDynamicallyDefined=false
          DcmDspDidControl:
            DcmDspDidControlMask = DCM_CONTROLMASK_NO
            DcmRbDspIoCtrlResetOnSessSecurityChange = true
            DcmDspDidFreezeCurrentState = true
            DcmDspDidResetToDefault = true
            DcmDspDidShortTermAdjustment = true
            DcmDspDidControlSecurityLevelRef = DSP_SEC_LEV_L1
            DcmDspDidControlSessionRef = DcmDspSession/ExtendedDiagnosticSession
          DcmDspDidRead: DcmDspDidReadSessionRef=DcmDspSession/DefaultSession, DcmDspDidReadSessionRef=DcmDspSession/ExtendedDiagnosticSession
        DcmDspDid_VacuumPumpPressure_1100 (DcmDspDid): DcmDspDidIdentifier=4352, DcmDspDidInfoRef=DcmDspDidInfo_VacuumPumpPressure_1100
          DcmDspDidSignal: DcmDspDidDataPos=0, DcmDspDidDataRef=DcmDspData_VacuumPumpPressure_1100
        DcmDspData_VehicleSpeed (DcmDspData): DcmDspDataSize=8, DcmDspDataType=UINT8, DcmDspDataUsePort=USE_DATA_SENDER_RECEIVER
        DcmDspData_SystemFaultRank (DcmDspData): DcmDspDataSize=8, DcmDspDataType=UINT8, DcmDspDataUsePort=USE_DATA_SENDER_RECEIVER
        DcmDspDidInfo_VehicleSpeed (DcmDspDidInfo): DcmDspDidDynamicallyDefined=false
          DcmDspDidRead: DcmDspDidReadSessionRef=DcmDspSession/DefaultSession, DcmDspDidReadSessionRef=DcmDspSession/ExtendedDiagnosticSession
          DcmDspDidRead
          DcmDspDidWrite:
            DcmDspDidWriteSecurityLevelRef = DSP_SEC_LEV_L1
            DcmDspDidWriteSessionRef = DcmDspSession/DefaultSession
            DcmDspDidWriteSessionRef = DcmDspSession/ExtendedDiagnosticSession
        DcmDspDidInfo_SystemFaultRank (DcmDspDidInfo): DcmDspDidDynamicallyDefined=false
          DcmDspDidRead: DcmDspDidReadSessionRef=DcmDspSession/DefaultSession, DcmDspDidReadSessionRef=DcmDspSession/ExtendedDiagnosticSession
          DcmDspDidWrite:
            DcmDspDidWriteSecurityLevelRef = DSP_SEC_LEV_L1
            DcmDspDidWriteSessionRef = DcmDspSession/DefaultSession
            DcmDspDidWriteSessionRef = DcmDspSession/ExtendedDiagnosticSession
        DcmDspDid_VehicleSpeed (DcmDspDid): DcmDspDidIdentifier=8976, DcmDspDidInfoRef=DcmDspDidInfo_VehicleSpeed
          DcmDspDidSignal: DcmDspDidDataPos=0, DcmDspDidDataRef=DcmDspData_VehicleSpeed
        DcmDspDid_SystemFaultRank (DcmDspDid): DcmDspDidIdentifier=8977, DcmDspDidInfoRef=DcmDspDidInfo_SystemFaultRank
          DcmDspDidSignal: DcmDspDidDataPos=0, DcmDspDidDataRef=DcmDspData_SystemFaultRank
        DcmRbDspReadDTC: DcmRbDspReadDTCMaxNumDTCRead=5, DcmRbDspReadDTCMaxNumRecordRead=5
      DcmPageBufferCfg: DcmPagedBufferEnabled=false
    DcmGeneral: DcmDevErrorDetect=true, DcmRespondAllRequest=false, DcmTaskTime=0.001, DcmVersionInfoApi=true
      DcmRbGeneral:
        DcmRbApplCallRequiredOnReqReception = false
        DcmRbApplTxConfirmationRequiredAlways = false
        DcmRbConfirmForDSDGeneratedNegRes = false
        DcmRbDiagAdaptSupport = false
        DcmRbOSTimerUse = CyclicCount
        DcmRbRestoringEnabled = true
        DcmRbRTEsupport = true
        DcmRbSignalDefaultValue = 0
        DcmRbStoringEnabled = true
        DcmRbQueuingOfRequestEnabled = false
