AUTOSAR XML (schema 4-2-2)
package /ETAS_Project/EcucModuleConfigurationValuess
  module config Dem: implementation-config-variant=VARIANT-PRE-COMPILE
    DemConfigSet
      DemComponent_C110117 (DemComponent): DemComponentIgnoresPriority=false
      DemComponent_C110216 (DemComponent): DemComponentIgnoresPriority=false
      DemDebounceCounterBasedClass_C110117 (DemDebounceCounterBasedClass):
        DemDebounceBehavior = DEM_DEBOUNCE_FREEZE
        DemDebounceCounterDecrementStepSize = 1
        DemDebounceCounterFailedThreshold = 2
        DemDebounceCounterIncrementStepSize = 1
        DemDebounceCounterPassedThreshold = -2
        DemDebounceCounterStorage = 0
      4 x DemEventParameter, all with DemEventAvailable=true, DemEventFailureCycleCounterThreshold=1, DemFFPrestorageSupported=false, DemOperationCycleRef=DemOperationCycle_0:
        DemEventParameter_C110117: DemEventKind=DEM_EVENT_KIND_SWC, DemComponentClassRef=DemComponent_C110117, DemDTCRef=DemDTC_C110117
          DemEventClassRB (DemRbEventClass): DemRbEventBufferTime=0
          DemDebounceAlgorithmClass
            DemDebounceCounterBased_LostComm_Sen (DemDebounceCounterBased): DemDebounceCounterBasedClassRef=DemDebounceCounterBasedClass_C110117
        DemEventParameter_C110216: DemEventKind=DEM_EVENT_KIND_SWC, DemComponentClassRef=DemComponent_C110216, DemDTCRef=DemDTC_C110216
          DemEventClassRB (DemRbEventClass): DemRbEventBufferTime=0
          DemDebounceAlgorithmClass
            DemDebounceCounterBased: DemDebounceCounterBasedClassRef=DemDebounceCounterBasedClass_C110216
        DemEventParameter_C153364: DemEventKind=DEM_EVENT_KIND_BSW, DemComponentClassRef=DemComponent_C153364, DemDTCRef=DemDTC_C153364
          DemEventClassRB (DemRbEventClass): DemRbEventBufferTime=0
          DemDebounceAlgorithmClass
            DemDebounceCounterBased: DemDebounceCounterBasedClassRef=DemDebounceCounterBasedClass_Wdg
        DemEventParameter_CanBusoff: DemEventKind=DEM_EVENT_KIND_SWC, DemComponentClassRef=DemComponent_Busoff, DemDTCRef=DemDTC_CANBusOff
          DemEventClassRB (DemRbEventClass): DemRbEventBufferTime=0
          DemDebounceAlgorithmClass
            DemDebounceCounterBased: DemDebounceCounterBasedClassRef=DemDebounceCounterBasedClass_C153364
      3 x DemDTCAttributes, all with DemAgingAllowed=true, DemAgingCycleCounterThreshold=40, DemImmediateNvStorage=true, DemMaxNumberFreezeFrameRecords=2, DemDTCSignificance=DEM_EVENT_SIGNIFICANCE_FAULT, DemAgingCycleRef=DemOperationCycle_0, DemExtendedDataClassRef=Set1_Extd, DemFreezeFrameClassRef=Set1_Freeze, DemMemoryDestinationRef=DemPrimaryMemory:
        DemDTCAttributes_C110117: DemDTCPriority=1
        DemDTCAttributes_C110216: DemDTCPriority=2
        DemDTCAttributes_C153364: DemDTCPriority=3
      DemComponent_C153364 (DemComponent): DemComponentIgnoresPriority=false
      DemComponent_Busoff (DemComponent): DemComponentIgnoresPriority=false
      DemDebounceCounterBasedClass_C153364 (DemDebounceCounterBasedClass):
        DemDebounceCounterStorage = 0
        DemDebounceBehavior = DEM_DEBOUNCE_FREEZE
        DemDebounceCounterDecrementStepSize = 1
        DemDebounceCounterFailedThreshold = 2
        DemDebounceCounterIncrementStepSize = 1
        DemDebounceCounterPassedThreshold = -2
      DemDTCAttributes_CANBusOff (DemDTCAttributes):
        DemAgingAllowed = true
        DemAgingCycleCounterThreshold = 40
        DemDTCPriority = 4
        DemDTCSignificance = DEM_EVENT_SIGNIFICANCE_FAULT
        DemImmediateNvStorage = true
        DemMaxNumberFreezeFrameRecords = 2
        DemAgingCycleRef = DemOperationCycle_0
        DemExtendedDataClassRef = Set1_Extd
        DemFreezeFrameClassRef = Set1_Freeze
        DemMemoryDestinationRef = DemPrimaryMemory
      4 x DemDTC, all with DemDTCSeverity=DEM_SEVERITY_CHECK_IMMEDIATELY:
        DemDTC_C110117: DemDtcValue=852224, DemDTCAttributesRef=DemDTCAttributes_C110117
        DemDTC_C110216: DemDtcValue=852480, DemDTCAttributesRef=DemDTCAttributes_C110216
        DemDTC_C153364: DemDtcValue=852736, DemDTCAttributesRef=DemDTCAttributes_C153364
        DemDTC_CANBusOff: DemDtcValue=852992, DemDTCAttributesRef=DemDTCAttributes_CANBusOff
      DemDebounceCounterBasedClass_C110216 (DemDebounceCounterBasedClass):
        DemDebounceCounterStorage = 0
        DemDebounceBehavior = DEM_DEBOUNCE_FREEZE
        DemDebounceCounterDecrementStepSize = 1
        DemDebounceCounterFailedThreshold = 1
        DemDebounceCounterIncrementStepSize = 1
        DemDebounceCounterPassedThreshold = -2
      DemDebounceCounterBasedClass_Wdg (DemDebounceCounterBasedClass):
        DemDebounceCounterStorage = 0
        DemDebounceBehavior = DEM_DEBOUNCE_FREEZE
        DemDebounceCounterDecrementStepSize = 1
        DemDebounceCounterFailedThreshold = 1
        DemDebounceCounterIncrementStepSize = 1
        DemDebounceCounterPassedThreshold = -2
      DemEventParameter_CanController1_Busoff (DemEventParameter):
        DemEventAvailable = false
        DemEventFailureCycleCounterThreshold = 1
        DemEventKind = DEM_EVENT_KIND_BSW
        DemFFPrestorageSupported = false
        DemOperationCycleRef = DemOperationCycle_0
        DemDebounceAlgorithmClass
          DemDebounceCounterBased: DemDebounceCounterBasedClassRef=DemDebounceCounterBasedClass_C153364
        DemRbEventClass: DemRbEventBufferTime=0
    DemGeneral:
      DemAgingRequieresTestedCycle = false
      DemAvailabilitySupport = DEM_EVENT_AVAILABILITY
      DemBswErrorBufferSize = 10
      DemClearDTCBehavior = DEM_CLRRESP_VOLATILE
      DemClearDTCLimitation = DEM_ONLY_CLEAR_ALL_DTCS
      DemDataElementDefaultEndianness = BIG_ENDIAN
      DemDebounceCounterBasedSupport = true
      DemDebounceTimeBasedSupport = false
      DemDevErrorDetect = true
      DemDtcStatusAvailabilityMask = 255
      DemEventCombinationSupport = DEM_EVCOMB_DISABLED
      DemEventDisplacementStrategy = DEM_DISPLACEMENT_FULL
      DemEventMemoryEntryStorageTrigger = DEM_TRIGGER_ON_CONFIRMED
      DemGeneralInterfaceSupport = false
      DemMaxNumberEventEntryPermanent = 6
      DemMaxNumberPrestoredFF = 5
      DemOBDSupport = DEM_OBD_NO_OBD_SUPPORT
      DemOccurrenceCounterProcessing = DEM_PROCESS_OCCCTR_TF
      DemOperationCycleStatusStorage = false
      DemResetConfirmedBitOnOverflow = true
      DemStatusBitHandlingTestFailedSinceLastClear = DEM_STATUS_BIT_NORMAL
      DemStatusBitStorageTestFailed = true
      DemSuppressionSupport = DEM_NO_SUPPRESSION
      DemTaskTime = 0.001
      DemTriggerDcmReports = false
      DemTriggerDltReports = false
      DemTriggerFiMReports = false
      DemTriggerMonitorInitBeforeClearOk = false
      DemTypeOfDTCSupported = DEM_DTC_TRANSLATION_ISO14229_1
      DemTypeOfFreezeFrameRecordNumeration = DEM_FF_RECNUM_CALCULATED
      DemVersionInfoApi = false
      DemEnvironmentDataCapture = DEM_CAPTURE_SYNCHRONOUS_TO_REPORTING
      DemMaxNumberEventEntryEventBuffer = 10
      VehicleSpeed (DemDidClass): DemDidIdentifier=8976, DemDidDataElementClassRef=DemDataElementClass_VehicleSpeed
      DemDidClass_SystemFaultRank (DemDidClass): DemDidIdentifier=8977, DemDidDataElementClassRef=DemGeneral/DemDataElementClass_SystemFaultRank
      Set1_Extd (DemExtendedDataClass): DemExtendedDataRecordClassRef=Ext_AgingCounter
      Ext_AgingCounter (DemExtendedDataRecordClass):
        DemExtendedDataRecordNumber = 1
        DemExtendedDataRecordTrigger = DEM_TRIGGER_ON_TEST_FAILED
        DemExtendedDataRecordUpdate = DEM_UPDATE_RECORD_NO
        DemDataElementClassRef = DemInternalDataElementClass_AgingCounter
      Set1_Freeze (DemFreezeFrameClass): DemDidClassRef=DemDidClass_SystemFaultRank, DemDidClassRef=VehicleSpeed
      5 x DemNvRamBlockId:
        DEM_NVM_ID_EVMEM_LOC_{0..4}: DemNvRamBlockIdRef=NvMBlockDescriptor_Dem_EvMemEventMemory{0..4}
      DemOperationCycle_0 (DemOperationCycle): DemOperationCycleType=DEM_OPCYC_POWER
      DemPrimaryMemory: DemMaxNumberEventEntryPrimary=5
      DemRBGeneral (DemRbGeneral):
        DemRbAgingCounterType = COUNT_UP
        DemRbDebLimitRelevantForJumping = false
        DemRbDebounceTimeBasedTaskTime = 0.001
        DemRbDebugData = ON_32BIT
        DemRbDisturbanceMemoryCallbackOnDisturbance = false
        DemRbDisturbanceMemorySupported = false
        DemRbOccurrenceCounterType = AUTOSAR
        DemRbSupportEventCategory = false
        DemRbSupportFailureDependency = false
        DemRbSymbolicNamesAccordingAR402 = false
        DemEventCategory_0 (DemRbEventCategory): DemRbEventCategoryId=254
        DemRbOptimization
      DemStorageCondition_0 (DemStorageCondition): DemStorageConditionId=0, DemStorageConditionStatus=true
      3 x DemDataElementClass:
        DemDataElementClass_SystemFaultRank
          DemDataElementClass_SystemFaultRank (DemExternalCSDataElementClass): DemDataElementDataSize=1, DemDataElementReadFnc=, DemDataElementUsePort=true
        DemDataElementClass_VehicleSpeed
          Dem_External_CSDataElementClass_VehicleSpeed (DemExternalCSDataElementClass): DemDataElementDataSize=2, DemDataElementReadFnc=, DemDataElementUsePort=true
        DemDataElementClass_Aging_Counter
          DemInternalDataElementClass_AgingCounter (DemInternalDataElementClass): DemInternalDataElement=DEM_AGINGCTR_UPCNT, DemDataElementDataSize=1
      DemFreezeFrameRecordClass: DemFreezeFrameRecordNumber=1, DemFreezeFrameRecordTrigger=DEM_TRIGGER_ON_CONFIRMED, DemFreezeFrameRecordUpdate=DEM_UPDATE_RECORD_YES
      DemFreezeFrameRecNumClass: DemFreezeFrameRecordClassRef=DemFreezeFrameRecordClass
      DEM_NVM_ID_DEM_GENERIC_NV_DATA (DemNvRamBlockId): DemNvRamBlockIdRef=NvMBlockDescriptor_Dem_GenericNvData
      DEM_NVM_ID_EVT_STATUSBYTE (DemNvRamBlockId): DemNvRamBlockIdRef=NvMBlockDescriptor_Dem_AllEventsStatusByte
      DemClient: DemClientFunctionality=DEM_CLIENT_USES_FULL_FUNCTIONALITY, DemClientUsesRte=false, DemRbClientPriority=1
