AUTOSAR XML (schema 4-2-2)
package /ETAS_Project/EcucModuleConfigurationValuess
  module config Det
    DetGeneral: DetForwardToDlt=false, DetVersionInfoApi=false
      DetGeneralRB: Det_EntryBufferSize=10
      DetRbBuffer: DetRbErrorBufferSize=10, DetRbUseErrorBufferApi=0
