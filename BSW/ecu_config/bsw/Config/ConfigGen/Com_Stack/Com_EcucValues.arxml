AUTOSAR XML (schema 4-2-2)
package /ETAS_Project/EcucModuleConfigurationValuess
  module config Com: implementation-config-variant=VARIANT-PRE-COMPILE
    ComConfig_0 (ComConfig): ComConfigurationId=0
      ComTimeBase: ComGwTimeBase=0.005, ComRxTimeBase=0.01, ComTxTimeBase=0.01
      ComIPduGroup_Rx (ComIPduGroup)
      HCU_01_Can_Network_CANNODE_0 (ComIPdu):
        ComIPduSignalProcessing = IMMEDIATE
        ComIPduType = NORMAL
        ComIPduDirection = RECEIVE
        ComIPduGroupRef = ComIPduGroup_Rx
        ComPduIdRef = HCU_01_Can_Network_CANNODE_0_PduR2Com
        ComIPduSignalRef = HCU01_EmergShutDown
        ComIPduSignalRef = HCU01_CheckSum
        ComIPduSignalRef = HCU01_Counter
        ComIPduSignalRef = HCU01_ActiveDischarge
        ComIPduSignalRef = HCU01_McuModeCmd
        ComIPduSignalRef = HCU01_EnaMCU
        ComIPduSignalRef = HCU01_SpeedCmd
        ComIPduSignalRef = HCU01_Shift
        ComIPduSignalRef = HCU01_TqCmd
      9 x ComSignal, all with ComSignalEndianness=BIG_ENDIAN, ComUpdateBitPosition=-1, ComTransferProperty=TRIGGERED:
        HCU01_EmergShutDown: ComSignalInitValue=0, ComSignalType=BOOLEAN, ComBitSize=1, ComBitPosition=36, ComSystemTemplateSystemSignalRef=HCU01_EmergShutDown
        HCU01_CheckSum: ComSignalInitValue=0, ComSignalType=UINT8, ComBitSize=8, ComBitPosition=63, ComSystemTemplateSystemSignalRef=HCU01_CheckSum
        HCU01_Counter: ComSignalInitValue=0, ComSignalType=UINT8, ComBitSize=4, ComBitPosition=51, ComSystemTemplateSystemSignalRef=HCU01_Counter
        HCU01_ActiveDischarge: ComSignalInitValue=0, ComSignalType=BOOLEAN, ComBitSize=1, ComBitPosition=37, ComSystemTemplateSystemSignalRef=HCU01_ActiveDischarge
        HCU01_McuModeCmd: ComSignalInitValue=0, ComSignalType=UINT8, ComBitSize=2, ComBitPosition=39, ComSystemTemplateSystemSignalRef=HCU01_McuModeCmd
        HCU01_EnaMCU: ComSignalInitValue=0, ComSignalType=BOOLEAN, ComBitSize=1, ComBitPosition=24, ComSystemTemplateSystemSignalRef=HCU01_EnaMCU
        HCU01_SpeedCmd: ComSignalInitValue=255.0, ComSignalType=UINT16, ComBitSize=15, ComBitPosition=23, ComNotification=(unset), ComTimeoutNotification=(unset), ComSystemTemplateSystemSignalRef=HCU01_SpeedCmd
        HCU01_Shift: ComSignalInitValue=3, ComSignalType=UINT8, ComBitSize=2, ComBitPosition=33, ComNotification=Rte_COMCbk_HCU01_Shift, ComTimeoutNotification=Rte_COMCbkTOut_HCU01_Shift, ComTimeout=0.3, ComRxDataTimeoutAction=REPLACE, ComSystemTemplateSystemSignalRef=HCU01_Shift
        HCU01_TqCmd: ComSignalInitValue=255, ComSignalType=UINT16, ComBitSize=14, ComBitPosition=7, ComNotification=Rte_COMCbk_HCU01_TqCmd, ComTimeoutNotification=Rte_COMCbkTOut_HCU01_TqCmd, ComTimeout=0.3, ComRxDataTimeoutAction=REPLACE, ComSystemTemplateSystemSignalRef=HCU01_TqCmd
      HCU_02_Can_Network_CANNODE_0 (ComIPdu):
        ComIPduSignalProcessing = IMMEDIATE
        ComIPduType = NORMAL
        ComIPduDirection = RECEIVE
        ComIPduGroupRef = ComIPduGroup_Rx
        ComPduIdRef = HCU_02_Can_Network_CANNODE_0_PduR2Com
        ComIPduSignalRef = HCU02_Poweroff
      HCU02_Poweroff (ComSignal):
        ComSignalInitValue = 1.0
        ComSignalType = BOOLEAN
        ComSignalEndianness = BIG_ENDIAN
        ComBitSize = 1
        ComBitPosition = 6
        ComUpdateBitPosition = -1
        ComTransferProperty = TRIGGERED
        ComNotification = Rte_COMCbk_HCU02_Poweroff
        ComTimeoutNotification = Rte_COMCbkTOut_HCU02_Poweroff
        ComRxDataTimeoutAction = REPLACE
        ComTimeout = 0.3
        ComSystemTemplateSystemSignalRef = HCU02_Poweroff
      ComIPduGroup_Tx (ComIPduGroup)
      MCU_02_Can_Network_CANNODE_0 (ComIPdu):
        ComIPduSignalProcessing = IMMEDIATE
        ComIPduType = NORMAL
        ComIPduDirection = SEND
        ComFirstTimeout = 0.05
        ComTimeout = 0.05
        ComIPduGroupRef = ComIPduGroup_Tx
        ComPduIdRef = MCU_02_Can_Network_CANNODE_0_Com2PduR
        ComIPduSignalRef = MCU02_IGBTTmp
        ComIPduSignalRef = MCU02_MotorTmp
        ComIPduSignalRef = MCU02_Vdc
        ComIPduSignalRef = MCU02_Idc
        ComIPduSignalRef = MCU02_MinTor
        ComIPduSignalRef = MCU02_MaxTor
        ComTxIPdu: ComMinimumDelayTime=0.0, ComTxIPduUnusedAreasDefault=255
          ComTxModeTrue
            ComTxMode: ComTxModeTimePeriod=0.05, ComTxModeMode=PERIODIC, ComTxModeNumberOfRepetitions=0, ComTxModeRepetitionPeriod=0, ComTxModeTimeOffset=0.0
      6 x ComSignal, all with ComSignalEndianness=BIG_ENDIAN, ComUpdateBitPosition=-1, ComTransferProperty=TRIGGERED:
        MCU02_IGBTTmp: ComSignalInitValue=40, ComSignalType=UINT8, ComBitSize=8, ComBitPosition=47, ComSystemTemplateSystemSignalRef=MCU02_IGBTTmp
        MCU02_MotorTmp: ComSignalInitValue=40, ComSignalType=UINT8, ComBitSize=8, ComBitPosition=55, ComSystemTemplateSystemSignalRef=MCU02_MotorTmp
        MCU02_Vdc: ComSignalInitValue=0, ComSignalType=UINT16, ComBitSize=10, ComBitPosition=19, ComSystemTemplateSystemSignalRef=MCU02_Vdc
        MCU02_Idc: ComSignalInitValue=511, ComSignalType=UINT16, ComBitSize=10, ComBitPosition=25, ComSystemTemplateSystemSignalRef=MCU02_Idc
        MCU02_MinTor: ComSignalInitValue=0, ComSignalType=UINT16, ComBitSize=9, ComBitPosition=12, ComSystemTemplateSystemSignalRef=MCU02_MinTor
        MCU02_MaxTor: ComSignalInitValue=0, ComSignalType=UINT16, ComBitSize=11, ComBitPosition=7, ComSystemTemplateSystemSignalRef=MCU02_MaxTor
      MCU_01_Can_Network_CANNODE_0 (ComIPdu):
        ComIPduSignalProcessing = IMMEDIATE
        ComIPduType = NORMAL
        ComIPduDirection = SEND
        ComFirstTimeout = 0.01
        ComTimeout = 0.01
        ComIPduGroupRef = ComIPduGroup_Tx
        ComPduIdRef = MCU_01_Can_Network_CANNODE_0_Com2PduR
        ComIPduSignalRef = MCU01_ShutDownAllowed
        ComIPduSignalRef = MCU01_Ready
        ComIPduSignalRef = MCU01_HighVolAllowed
        ComIPduSignalRef = MCU01_Status
        ComIPduSignalRef = MCU01_ActDischStatus
        ComIPduSignalRef = MCU01_SelfCheck
        ComIPduSignalRef = MCU01_CheckSum
        ComIPduSignalRef = MCU01_Counter
        ComIPduSignalRef = MCU01_CurCntTor
        ComIPduSignalRef = MCU01_Motorspd
        ComIPduSignalRef = MCU01_EmergShutDown
        ComTxIPdu: ComMinimumDelayTime=0.0, ComTxIPduUnusedAreasDefault=255
          ComTxModeTrue
            ComTxMode: ComTxModeTimePeriod=0.01, ComTxModeMode=PERIODIC, ComTxModeNumberOfRepetitions=0, ComTxModeRepetitionPeriod=0, ComTxModeTimeOffset=0.0
      11 x ComSignal, all with ComSignalEndianness=BIG_ENDIAN, ComUpdateBitPosition=-1, ComTransferProperty=TRIGGERED:
        MCU01_ShutDownAllowed: ComSignalInitValue=0, ComSignalType=BOOLEAN, ComBitSize=1, ComBitPosition=24, ComSystemTemplateSystemSignalRef=MCU01_ShutDownAllowed
        MCU01_Ready: ComSignalInitValue=0, ComSignalType=BOOLEAN, ComBitSize=1, ComBitPosition=40, ComSystemTemplateSystemSignalRef=MCU01_Ready
        MCU01_HighVolAllowed: ComSignalInitValue=0, ComSignalType=BOOLEAN, ComBitSize=1, ComBitPosition=41, ComSystemTemplateSystemSignalRef=MCU01_HighVolAllowed
        MCU01_Status: ComSignalInitValue=0, ComSignalType=UINT8, ComBitSize=2, ComBitPosition=43, ComSystemTemplateSystemSignalRef=MCU01_Status
        MCU01_ActDischStatus: ComSignalInitValue=0, ComSignalType=UINT8, ComBitSize=2, ComBitPosition=45, ComSystemTemplateSystemSignalRef=MCU01_ActDischStatus
        MCU01_SelfCheck: ComSignalInitValue=0, ComSignalType=UINT8, ComBitSize=2, ComBitPosition=47, ComSystemTemplateSystemSignalRef=MCU01_SelfCheck
        MCU01_CheckSum: ComSignalInitValue=0, ComSignalType=UINT8, ComBitSize=8, ComBitPosition=63, ComSystemTemplateSystemSignalRef=MCU01_CheckSum
        MCU01_Counter: ComSignalInitValue=0, ComSignalType=UINT8, ComBitSize=4, ComBitPosition=35, ComSystemTemplateSystemSignalRef=MCU01_Counter
        MCU01_CurCntTor: ComSignalInitValue=4094, ComSignalType=UINT16, ComBitSize=13, ComBitPosition=23, ComSystemTemplateSystemSignalRef=MCU01_CurCntTor
        MCU01_Motorspd: ComSignalInitValue=32767, ComSignalType=UINT16, ComBitSize=16, ComBitPosition=7, ComSystemTemplateSystemSignalRef=MCU01_Motorspd
        MCU01_EmergShutDown: ComSignalInitValue=0, ComSignalType=BOOLEAN, ComBitSize=1, ComBitPosition=55, ComSystemTemplateSystemSignalRef=MCU01_EmergShutDown
      MCU_03_Can_Network_CANNODE_0 (ComIPdu):
        ComIPduSignalProcessing = IMMEDIATE
        ComIPduType = NORMAL
        ComIPduDirection = SEND
        ComFirstTimeout = 0.05
        ComTimeout = 0.05
        ComIPduGroupRef = ComIPduGroup_Tx
        ComPduIdRef = MCU_03_Can_Network_CANNODE_0_Com2PduR
        ComIPduSignalRef = MCU03_LI_OverSpeed
        ComIPduSignalRef = MCU03_LI_OverTempEM
        ComIPduSignalRef = MCU03_LI_OverTempINV
        ComIPduSignalRef = MCU03_LI_UdcUnder
        ComIPduSignalRef = MCU03_LI_UdcOver
        ComIPduSignalRef = MCU03_RF_PhaseImp
        ComIPduSignalRef = MCU03_12VSupply
        ComIPduSignalRef = MCU03_RF_PhCOver
        ComIPduSignalRef = MCU03_RF_PhBOver
        ComIPduSignalRef = MCU03_RF_PhAOver
        ComIPduSignalRef = MCU03_RF_OverSpeed
        ComIPduSignalRef = MCU03_RF_MsgTO
        ComIPduSignalRef = MCU03_RF_OverTempEM
        ComIPduSignalRef = MCU03_RF_OverTempINV
        ComIPduSignalRef = MCU03_RF_IntError
        ComIPduSignalRef = MCU03_RF_HWOverCur
        ComIPduSignalRef = MCU03_RF_UDCUnder
        ComIPduSignalRef = MCU03_RF_UdcOver
        ComIPduSignalRef = MCU03_RF_IdcOver
        ComIPduSignalRef = MCU03_RF_ToqError
        ComIPduSignalRef = MCU03_RF_BusOff
        ComIPduSignalRef = MCU03_NRF_SysFailure
        ComIPduSignalRef = MCU03_NRF_Resolver
        ComIPduSignalRef = MCU03_NRF_PhCSamp
        ComIPduSignalRef = MCU03_NRF_PhBSamp
        ComIPduSignalRef = MCU03_NRF_InvTempSamp
        ComIPduSignalRef = MCU03_NRF_PhASamp
        ComIPduSignalRef = MCU03_NRF_DESAT
        ComIPduSignalRef = MCU03_NRF_UdcSamp
        ComIPduSignalRef = MCU03_NRF_COMError
        ComIPduSignalRef = MCU03_NRF_5VSupply
        ComIPduSignalRef = MCU03_NRF_EMTempSamp
        ComIPduSignalRef = MCU03_NRF_IdcSamp
        ComTxIPdu: ComMinimumDelayTime=0.0, ComTxIPduUnusedAreasDefault=255
          ComTxModeTrue
            ComTxMode: ComTxModeTimePeriod=0.05, ComTxModeMode=PERIODIC, ComTxModeNumberOfRepetitions=0, ComTxModeRepetitionPeriod=0, ComTxModeTimeOffset=0.0
      33 x ComSignal, all with ComSignalInitValue=0, ComSignalType=BOOLEAN, ComSignalEndianness=BIG_ENDIAN, ComBitSize=1, ComUpdateBitPosition=-1, ComTransferProperty=TRIGGERED:
        MCU03_LI_OverSpeed: ComBitPosition=51, ComSystemTemplateSystemSignalRef=MCU03_LI_OverSpeed
        MCU03_LI_OverTempEM: ComBitPosition=50, ComSystemTemplateSystemSignalRef=MCU03_LI_OverTempEM
        MCU03_LI_OverTempINV: ComBitPosition=49, ComSystemTemplateSystemSignalRef=MCU03_LI_OverTempINV
        MCU03_LI_UdcUnder: ComBitPosition=48, ComSystemTemplateSystemSignalRef=MCU03_LI_UdcUnder
        MCU03_LI_UdcOver: ComBitPosition=52, ComSystemTemplateSystemSignalRef=MCU03_LI_UdcOver
        MCU03_RF_PhaseImp: ComBitPosition=39, ComSystemTemplateSystemSignalRef=MCU03_RF_PhaseImp
        MCU03_12VSupply: ComBitPosition=32, ComSystemTemplateSystemSignalRef=MCU03_12VSupply
        MCU03_RF_PhCOver: ComBitPosition=47, ComSystemTemplateSystemSignalRef=MCU03_RF_PhCOver
        MCU03_RF_PhBOver: ComBitPosition=46, ComSystemTemplateSystemSignalRef=MCU03_RF_PhBOver
        MCU03_RF_PhAOver: ComBitPosition=45, ComSystemTemplateSystemSignalRef=MCU03_RF_PhAOver
        MCU03_RF_OverSpeed: ComBitPosition=41, ComSystemTemplateSystemSignalRef=MCU03_RF_OverSpeed
        MCU03_RF_MsgTO: ComBitPosition=43, ComSystemTemplateSystemSignalRef=MCU03_RF_MsgTO
        MCU03_RF_OverTempEM: ComBitPosition=40, ComSystemTemplateSystemSignalRef=MCU03_RF_OverTempEM
        MCU03_RF_OverTempINV: ComBitPosition=36, ComSystemTemplateSystemSignalRef=MCU03_RF_OverTempINV
        MCU03_RF_IntError: ComBitPosition=38, ComSystemTemplateSystemSignalRef=MCU03_RF_IntError
        MCU03_RF_HWOverCur: ComBitPosition=44, ComSystemTemplateSystemSignalRef=MCU03_RF_HWOverCur
        MCU03_RF_UDCUnder: ComBitPosition=37, ComSystemTemplateSystemSignalRef=MCU03_RF_UDCUnder
        MCU03_RF_UdcOver: ComBitPosition=34, ComSystemTemplateSystemSignalRef=MCU03_RF_UdcOver
        MCU03_RF_IdcOver: ComBitPosition=33, ComSystemTemplateSystemSignalRef=MCU03_RF_IdcOver
        MCU03_RF_ToqError: ComBitPosition=35, ComSystemTemplateSystemSignalRef=MCU03_RF_ToqError
        MCU03_RF_BusOff: ComBitPosition=42, ComSystemTemplateSystemSignalRef=MCU03_RF_BusOff
        MCU03_NRF_SysFailure: ComBitPosition=11, ComSystemTemplateSystemSignalRef=MCU03_NRF_SysFailure
        MCU03_NRF_Resolver: ComBitPosition=2, ComSystemTemplateSystemSignalRef=MCU03_NRF_Resolver
        MCU03_NRF_PhCSamp: ComBitPosition=5, ComSystemTemplateSystemSignalRef=MCU03_NRF_PhCSamp
        MCU03_NRF_PhBSamp: ComBitPosition=4, ComSystemTemplateSystemSignalRef=MCU03_NRF_PhBSamp
        MCU03_NRF_InvTempSamp: ComBitPosition=9, ComSystemTemplateSystemSignalRef=MCU03_NRF_InvTempSamp
        MCU03_NRF_PhASamp: ComBitPosition=3, ComSystemTemplateSystemSignalRef=MCU03_NRF_PhASamp
        MCU03_NRF_DESAT: ComBitPosition=0, ComSystemTemplateSystemSignalRef=MCU03_NRF_DESAT
        MCU03_NRF_UdcSamp: ComBitPosition=8, ComSystemTemplateSystemSignalRef=MCU03_NRF_UdcSamp
        MCU03_NRF_COMError: ComBitPosition=10, ComSystemTemplateSystemSignalRef=MCU03_NRF_COMError
        MCU03_NRF_5VSupply: ComBitPosition=1, ComSystemTemplateSystemSignalRef=MCU03_NRF_5VSupply
        MCU03_NRF_EMTempSamp: ComBitPosition=6, ComSystemTemplateSystemSignalRef=MCU03_NRF_EMTempSamp
        MCU03_NRF_IdcSamp: ComBitPosition=15, ComSystemTemplateSystemSignalRef=MCU03_NRF_IdcSamp
      HCU_03_Can_Network_CANNODE_0 (ComIPdu):
        ComIPduSignalProcessing = IMMEDIATE
        ComIPduType = NORMAL
        ComIPduDirection = RECEIVE
        ComIPduGroupRef = ComIPduGroup_Rx
        ComPduIdRef = HCU_03_Can_Network_CANNODE_0_PduR2Com
        ComIPduSignalRef = HCU03_Poweroff
      HCU03_Poweroff (ComSignal):
        ComSignalInitValue = 1.0
        ComSignalType = BOOLEAN
        ComSignalEndianness = BIG_ENDIAN
        ComBitSize = 1
        ComBitPosition = 0
        ComUpdateBitPosition = -1
        ComTransferProperty = TRIGGERED
        ComNotification = Rte_COMCbk_HCU03_Poweroff
        ComTimeoutNotification = Rte_COMCbkTOut_HCU03_Poweroff
        ComTimeout = 0.3
        ComRxDataTimeoutAction = REPLACE
        ComSystemTemplateSystemSignalRef = HCU03_Poweroff
      HCU_04_Can_Network_CANNODE_0 (ComIPdu):
        ComIPduSignalProcessing = IMMEDIATE
        ComIPduType = NORMAL
        ComIPduDirection = RECEIVE
        ComIPduGroupRef = ComIPduGroup_Rx
        ComPduIdRef = HCU_04_Can_Network_CANNODE_0_PduR2Com
        ComIPduSignalRef = HCU04_Poweroff
      HCU04_Poweroff (ComSignal):
        ComSignalInitValue = 0
        ComSignalType = BOOLEAN
        ComSignalEndianness = BIG_ENDIAN
        ComBitSize = 1
        ComBitPosition = 0
        ComUpdateBitPosition = -1
        ComTransferProperty = TRIGGERED
        ComNotification = Rte_COMCbk_HCU04_Poweroff
        ComTimeoutNotification = Rte_COMCbkTOut_HCU04_Poweroff
        ComTimeout = 0.3
        ComRxDataTimeoutAction = REPLACE
        ComSystemTemplateSystemSignalRef = HCU04_Poweroff
      HCU_05_Can_Network_CANNODE_0 (ComIPdu):
        ComIPduSignalProcessing = IMMEDIATE
        ComIPduType = NORMAL
        ComIPduDirection = RECEIVE
        ComIPduGroupRef = ComIPduGroup_Rx
        ComPduIdRef = HCU_05_Can_Network_CANNODE_0_PduR2Com
        ComIPduSignalRef = HCU05_Poweroff
      HCU05_Poweroff (ComSignal):
        ComSignalInitValue = 0
        ComSignalType = BOOLEAN
        ComSignalEndianness = BIG_ENDIAN
        ComBitSize = 1
        ComBitPosition = 0
        ComUpdateBitPosition = -1
        ComTransferProperty = TRIGGERED
        ComNotification = Rte_COMCbk_HCU05_Poweroff
        ComTimeoutNotification = Rte_COMCbkTOut_HCU05_Poweroff
        ComTimeout = 0.3
        ComRxDataTimeoutAction = REPLACE
        ComSystemTemplateSystemSignalRef = HCU05_Poweroff
      MCU_04_Can_Network_CANNODE_0 (ComIPdu):
        ComIPduSignalProcessing = IMMEDIATE
        ComIPduType = NORMAL
        ComIPduDirection = SEND
        ComFirstTimeout = 0.05
        ComTimeout = 0.05
        ComIPduGroupRef = ComIPduGroup_Tx
        ComPduIdRef = MCU_04_Can_Network_CANNODE_0_Com2PduR
        ComIPduSignalRef = MCU04_Test
        ComTxIPdu: ComMinimumDelayTime=0.0, ComTxIPduUnusedAreasDefault=255
          ComTxModeTrue
            ComTxMode: ComTxModeTimePeriod=0.05, ComTxModeMode=PERIODIC, ComTxModeNumberOfRepetitions=0, ComTxModeRepetitionPeriod=0, ComTxModeTimeOffset=0.0
          ComTxModeFalse
            ComTxMode: ComTxModeTimePeriod=0.05, ComTxModeMode=PERIODIC, ComTxModeNumberOfRepetitions=0, ComTxModeRepetitionPeriod=0, ComTxModeTimeOffset=0.0
      MCU04_Test (ComSignal):
        ComSignalInitValue = 0
        ComSignalType = BOOLEAN
        ComSignalEndianness = BIG_ENDIAN
        ComBitSize = 1
        ComBitPosition = 15
        ComUpdateBitPosition = -1
        ComTransferProperty = TRIGGERED
        ComSystemTemplateSystemSignalRef = MCU04_Test
    ComGeneral:
      ComVersionInfoApi = false
      ComCommonIPduTxPeriodFeature = false
      ComEnableJitterFilter = false
      ComEnableSignalGroupArrayApi = false
      ComCancellationSupport = false
      ComConfigurationUseDet = true
      ComTxDoubleBuffer = false
