AUTOSAR XML (schema 4-2-2)
package /ETAS_Project/EcucModuleConfigurationValuess
  module config PduR: implementation-config-variant=VARIANT-PRE-COMPILE
    PduRGeneral:
      PduRVersionInfoApi = false
      PduRZeroCostOperation = false
      PduRFifoTxBufferSupport = false
      PduRIFGatewayOperation = false
      PduRTPGatewayOperation = false
      PduRMemorySize = 0
      PduRMinimumRoutingLoRxPduId = 0
      PduRMinimumRoutingLoTxPduId = 0
      PduRMinimumRoutingUpRxPduId = 0
      PduRMinimumRoutingUpTxPduId = 0
      PduRMulticastFromIfSupport = false
      PduRMulticastFromTpSupport = false
      PduRMulticastToIfSupport = false
      PduRMulticastToTpSupport = false
      PduRSbTxBufferSupport = false
      PduRQueueingSupport = false
      PduRCanTpChangeParameterRequestApi = false
      PduRFrTpChangeParameterRequestApi = false
      PduRDevErrorDetect = true
      PduRGwTpWithLimitedBuffer = false
    PduRRoutingTables: PduRConfigurationId=0
      PduRRoutingTable
        12 x PduRRoutingPath:
          HCU_01_Can_Network_CANNODE_0_CanIf2Com
            HCU_01_Can_Network_CANNODE_0_CanIf2PduR (PduRSrcPdu): PduRSrcPduRef=HCU_01_Can_Network_CANNODE_0_CanIf2PduR
            HCU_01_Can_Network_CANNODE_0_PduR2Com (PduRDestPdu): PduRTransmissionConfirmation=false, PduRDestPduRef=HCU_01_Can_Network_CANNODE_0_PduR2Com
          HCU_02_Can_Network_CANNODE_0_CanIf2Com
            HCU_02_Can_Network_CANNODE_0_CanIf2PduR (PduRSrcPdu): PduRSrcPduRef=HCU_02_Can_Network_CANNODE_0_CanIf2PduR
            HCU_02_Can_Network_CANNODE_0_PduR2Com (PduRDestPdu): PduRTransmissionConfirmation=false, PduRDestPduRef=HCU_02_Can_Network_CANNODE_0_PduR2Com
          MCU_02_Can_Network_CANNODE_0_Com2CanIf
            MCU_02_Can_Network_CANNODE_0_Com2PduR (PduRSrcPdu): PduRSrcPduRef=MCU_02_Can_Network_CANNODE_0_Com2PduR
            MCU_02_Can_Network_CANNODE_0_PduR2CanIf (PduRDestPdu): PduRTransmissionConfirmation=false, PduRDestPduRef=MCU_02_Can_Network_CANNODE_0_PduR2CanIf
          MCU_01_Can_Network_CANNODE_0_Com2CanIf
            MCU_01_Can_Network_CANNODE_0_Com2PduR (PduRSrcPdu): PduRSrcPduRef=MCU_01_Can_Network_CANNODE_0_Com2PduR
            MCU_01_Can_Network_CANNODE_0_PduR2CanIf (PduRDestPdu): PduRTransmissionConfirmation=false, PduRDestPduRef=MCU_01_Can_Network_CANNODE_0_PduR2CanIf
          MCU_03_Can_Network_CANNODE_0_Com2CanIf
            MCU_03_Can_Network_CANNODE_0_Com2PduR (PduRSrcPdu): PduRSrcPduRef=MCU_03_Can_Network_CANNODE_0_Com2PduR
            MCU_03_Can_Network_CANNODE_0_PduR2CanIf (PduRDestPdu): PduRTransmissionConfirmation=false, PduRDestPduRef=MCU_03_Can_Network_CANNODE_0_PduR2CanIf
          Diag_Functional_request_Can_Network_CANNODE_0_CanTp2Dcm
            Diag_Functional_request_Can_Network_CANNODE_0_CanTp2PduR (PduRSrcPdu): PduRSrcPduRef=Diag_Functional_request_Can_Network_CANNODE_0_CanTp2PduR
            Diag_Functional_request_Can_Network_CANNODE_0_PduR2Dcm (PduRDestPdu): PduRTransmissionConfirmation=false, PduRDestPduRef=Diag_Functional_request_Can_Network_CANNODE_0_PduR2Dcm
          Diag_Physical_request_Can_Network_CANNODE_0_CanTp2Dcm
            Diag_Physical_request_Can_Network_CANNODE_0_CanTp2PduR (PduRSrcPdu): PduRSrcPduRef=Diag_Physical_request_Can_Network_CANNODE_0_CanTp2PduR
            Diag_Physical_request_Can_Network_CANNODE_0_PduR2Dcm (PduRDestPdu): PduRTransmissionConfirmation=false, PduRDestPduRef=Diag_Physical_request_Can_Network_CANNODE_0_PduR2Dcm
          Diag_Physical_response_Can_Network_CANNODE_0_Dcm2CanTp
            Diag_Physical_response_Can_Network_CANNODE_0_Phys_Dcm2PduR (PduRSrcPdu): PduRSrcPduRef=Diag_Physical_response_Can_Network_CANNODE_0_Phys_Dcm2PduR
            Diag_Physical_response_Can_Network_CANNODE_0_Phys_PduR2CanTp (PduRDestPdu): PduRTransmissionConfirmation=false, PduRDestPduRef=Diag_Physical_response_Can_Network_CANNODE_0_Phys_PduR2CanTp
          HCU_03_Can_Network_CANNODE_0_CanIf2Com
            HCU_03_Can_Network_CANNODE_0_CanIf2PduR (PduRSrcPdu): PduRSrcPduRef=HCU_03_Can_Network_CANNODE_0_CanIf2PduR
            HCU_03_Can_Network_CANNODE_0_PduR2Com (PduRDestPdu): PduRTransmissionConfirmation=false, PduRDestPduRef=HCU_03_Can_Network_CANNODE_0_PduR2Com
          HCU_04_Can_Network_CANNODE_0_CanIf2Com
            HCU_04_Can_Network_CANNODE_0_CanIf2PduR (PduRSrcPdu): PduRSrcPduRef=HCU_04_Can_Network_CANNODE_0_CanIf2PduR
            HCU_04_Can_Network_CANNODE_0_PduR2Com (PduRDestPdu): PduRTransmissionConfirmation=false, PduRDestPduRef=HCU_04_Can_Network_CANNODE_0_PduR2Com
          HCU_05_Can_Network_CANNODE_0_CanIf2Com
            HCU_05_Can_Network_CANNODE_0_CanIf2PduR (PduRSrcPdu): PduRSrcPduRef=HCU_05_Can_Network_CANNODE_0_CanIf2PduR
            HCU_05_Can_Network_CANNODE_0_PduR2Com (PduRDestPdu): PduRTransmissionConfirmation=false, PduRDestPduRef=HCU_05_Can_Network_CANNODE_0_PduR2Com
          MCU_04_Can_Network_CANNODE_0_Com2CanIf
            MCU_04_Can_Network_CANNODE_0_Com2PduR (PduRSrcPdu): PduRSrcPduRef=MCU_04_Can_Network_CANNODE_0_Com2PduR
            MCU_04_Can_Network_CANNODE_0_PduR2CanIf (PduRDestPdu): PduRTransmissionConfirmation=false, PduRDestPduRef=MCU_04_Can_Network_CANNODE_0_PduR2CanIf
    4 x PduRBswModules, all with PduRCancelReceive=0, PduRChangeParameterApi=0, PduRRetransmission=0, PduRUseTag=0:
      Com: PduRCancelTransmit=0, PduRCommunicationInterface=1, PduRLowerModule=0, PduRTransportProtocol=1, PduRTriggertransmit=1, PduRTxConfirmation=0, PduRUpperModule=1, PduRBswModuleRef=Com
      CanIf: PduRCancelTransmit=0, PduRCommunicationInterface=1, PduRLowerModule=1, PduRTransportProtocol=0, PduRTriggertransmit=0, PduRTxConfirmation=1, PduRUpperModule=0, PduRBswModuleRef=CanIf
      CanTp: PduRCancelTransmit=1, PduRCommunicationInterface=0, PduRLowerModule=1, PduRTransportProtocol=1, PduRTriggertransmit=0, PduRTxConfirmation=1, PduRUpperModule=0, PduRBswModuleRef=CanTp
        PduRInvalidHandlers: PduRIHCancelReceive=false, PduRIHCancelTransmit=false
      Dcm: PduRCancelTransmit=1, PduRCommunicationInterface=0, PduRLowerModule=0, PduRTransportProtocol=1, PduRTriggertransmit=0, PduRTxConfirmation=1, PduRUpperModule=1, PduRBswModuleRef=Dcm
