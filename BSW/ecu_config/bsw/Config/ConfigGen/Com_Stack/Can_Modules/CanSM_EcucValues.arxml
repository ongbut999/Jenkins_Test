AUTOSAR XML (schema 4-2-2)
package /ETAS_Project/EcucModuleConfigurationValuess
  module config CanSM: implementation-config-variant=VARIANT-PRE-COMPILE
    CanSMConfiguration: CanSMModeRequestRepetitionMax=5, CanSMModeRequestRepetitionTime=0.07
      CanSMManagerNetwork_Can_Network (CanSMManagerNetwork):
        CanSMBorTxConfirmationPolling = false
        CanSMBorCounterL1ToL2 = 5
        CanSMBorTimeL1 = 0.1
        CanSMBorTimeL2 = 1.0
        CanSMBorTimeTxEnsured = 5.0
        CanSMNetworkIndex = 0
        CanSMComMNetworkHandleRef = ComMChannel_Can_Network_Channel
        CanSMDemEventParameterRefs: CanSMRbDynCreate_CANSM_E_BUS_OFF=Disabled, CANSM_E_BUS_OFF=DemEventParameter_CanBusoff
        CanSMController_Can_Network_CANNODE_0 (CanSMController): CanSMControllerId=Can_Network_CANNODE_0
      CanSMManagerNetwork_Can_Network_XCP (CanSMManagerNetwork):
        CanSMBorTxConfirmationPolling = false
        CanSMBorCounterL1ToL2 = 5
        CanSMBorTimeL1 = 0.1
        CanSMBorTimeL2 = 1
        CanSMBorTimeTxEnsured = 5
        CanSMNetworkIndex = 1
        CanSMComMNetworkHandleRef = ComMChannel_Can_Network_XCP_Channel
        CanSMDemEventParameterRefs1 (CanSMDemEventParameterRefs): CanSMRbDynCreate_CANSM_E_BUS_OFF=Disabled, CANSM_E_BUS_OFF=DemEventParameter_CanController1_Busoff
        CanSMController_Can_Network_CANNODE_1 (CanSMController): CanSMControllerId=Can_Network_CANNODE_1
    CanSMGeneral: CanSMMainFunctionTimePeriod=0.001, CanSMVersionInfoApi=false, CanSMDevErrorDetect=true, CanSMChangeBaudrateApi=false
