AUTOSAR XML (schema 4-2-2)
package /RB/UBK/Project/EcucModuleConfigurationValuess
  module config CanNm: implementation-config-variant=VARIANT-PRE-COMPILE
    CanNmGlobalConfig_0 (CanNmGlobalConfig):
      CanNmBusLoadReductionEnabled = false
      CanNmBusSynchronizationEnabled = false
      CanNmComControlEnabled = true
      CanNmComUserDataSupport = false
      CanNmCoordinatorSyncSupport = false
      CanNmDevErrorDetect = true
      CanNmImmediateRestartEnabled = false
      CanNmImmediateTxconfEnabled = false
      CanNmMainFunctionPeriod = 0.01
      CanNmNodeDetectionEnabled = true
      CanNmNodeIdEnabled = true
      CanNmPassiveModeEnabled = false
      CanNmPduRxIndicationEnabled = true
      CanNmRemoteSleepIndEnabled = false
      CanNmRepeatMsgIndEnabled = true
      CanNmStateChangeIndEnabled = true
      CanNmUserDataEnabled = true
      CanNmVersionInfoApi = true
      CanNmChannelConfig_0 (CanNmChannelConfig):
        CanNmCarWakeUpRxEnabled = 0
        CanNmBusLoadReductionActive = false
        CanNmMsgCycleOffset = 0.0
        CanNmMsgCycleTime = 0.2
        CanNmMsgReducedTime = 0.2
        CanNmMsgTimeoutTime = 2.0
        CanNmNodeId = 30
        CanNmPduCbvPosition = CANNM_PDU_BYTE_1
        CanNmPduNidPosition = CANNM_PDU_BYTE_0
        CanNmRepeatMessageTime = 0.6
        CanNmTimeoutTime = 2.0
        CanNmWaitBusSleepTime = 5.0
        CanNmImmediateNmTransmissions = 0
        CanNmComMNetworkHandleRef = ComMChannel_Can_Network_Channel
        CanNmRxPdu_0 (CanNmRxPdu): CanNmRxPduRef=NM_VCU_Rx_ETAS_Can_Network_CANNODE_0_CanIf2CanNm
        CanNmTxPdu: CanNmTxPduRef=NM_VCU_Can_Network_CANNODE_0_CanNm2CanIf
