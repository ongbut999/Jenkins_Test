AUTOSAR XML (schema 4-2-2)
package /ETAS_Project/EcucModuleConfigurationValuess
  module config CanIf: implementation-config-variant=VARIANT-PRE-COMPILE
    CanIfInitCfg: CanIfInitCfgSet=0
      CanIfInitHohCfg
        Can_Network_CANNODE_0_Rx_Std_MailBox_1 (CanIfHrhCfg): CanIfHrhIdSymRef=Can_Network_CANNODE_0_Rx_Std_MailBox_1, CanIfHrhCanCtrlIdRef=Can_Network_CANNODE_0
        Can_Network_CANNODE_0_Rx_Std_MailBox_2 (CanIfHrhCfg): CanIfHrhIdSymRef=Can_Network_CANNODE_0_Rx_Std_MailBox_2, CanIfHrhCanCtrlIdRef=Can_Network_CANNODE_0
        3 x CanIfHthCfg, all with CanIfHthCanCtrlIdRef=Can_Network_CANNODE_0:
          Can_Network_CANNODE_0_Tx_Std_MailBox_{1..3}: CanIfHthIdSymRef=Can_Network_CANNODE_0_Tx_Std_MailBox_{1..3}
        Can_Network_CANNODE_0_Rx_Std_MailBox_3 (CanIfHrhCfg): CanIfHrhIdSymRef=Can_Network_CANNODE_0_Rx_Std_MailBox_3, CanIfHrhCanCtrlIdRef=Can_Network_CANNODE_0
        Can_Network_CANNODE_0_Rx_Std_MailBox_4 (CanIfHrhCfg): CanIfHrhIdSymRef=Can_Network_CANNODE_0_Rx_Std_MailBox_4, CanIfHrhCanCtrlIdRef=Can_Network_CANNODE_0
        Can_Network_CANNODE_0_Tx_Std_MailBox_4 (CanIfHthCfg): CanIfHthIdSymRef=Can_Network_CANNODE_0_Tx_Std_MailBox_4, CanIfHthCanCtrlIdRef=Can_Network_CANNODE_0
        Can_Network_CANNODE_0_Rx_Std_MailBox_5 (CanIfHrhCfg): CanIfHrhIdSymRef=Can_Network_CANNODE_0_Rx_Std_MailBox_5, CanIfHrhCanCtrlIdRef=Can_Network_CANNODE_0
        Can_Network_CANNODE_0_Tx_Std_MailBox_5 (CanIfHthCfg): CanIfHthIdSymRef=Can_Network_CANNODE_0_Tx_Std_MailBox_5, CanIfHthCanCtrlIdRef=Can_Network_CANNODE_0
        Can_Network_CANNODE_1_Rx_Std_MailBox_1 (CanIfHrhCfg): CanIfHrhIdSymRef=Can_Network_CANNODE_1_Rx_Std_MailBox_1, CanIfHrhCanCtrlIdRef=Can_Network_CANNODE_1
        4 x CanIfHthCfg, all with CanIfHthCanCtrlIdRef=Can_Network_CANNODE_1:
          Can_Network_CANNODE_1_Tx_Std_MailBox_{1..4}: CanIfHthIdSymRef=Can_Network_CANNODE_1_Tx_Std_MailBox_{1..4}
        4 x CanIfHrhCfg:
          Can_Network_CANNODE_1_Rx_Std_MailBox_2: CanIfHrhCanCtrlIdRef=Can_Network_CANNODE_1, CanIfHrhIdSymRef=Can_Network_CANNODE_1_Rx_Std_MailBox_2
          Can_Network_CANNODE_0_Rx_Std_MailBox_6: CanIfHrhCanCtrlIdRef=Can_Network_CANNODE_0, CanIfHrhIdSymRef=Can_Network_CANNODE_0_Rx_Std_MailBox_6
          Can_Network_CANNODE_0_Rx_Std_MailBox_7: CanIfHrhIdSymRef=Can_Network_CANNODE_0_Rx_Std_MailBox_7, CanIfHrhCanCtrlIdRef=Can_Network_CANNODE_0
          Can_Network_CANNODE_0_Rx_Std_MailBox_8: CanIfHrhIdSymRef=Can_Network_CANNODE_0_Rx_Std_MailBox_8, CanIfHrhCanCtrlIdRef=Can_Network_CANNODE_0
        Can_Network_CANNODE_0_Tx_Std_MailBox_6 (CanIfHthCfg): CanIfHthIdSymRef=Can_Network_CANNODE_0_Tx_Std_MailBox_6, CanIfHthCanCtrlIdRef=Can_Network_CANNODE_0
      HCU_01_Can_Network_CANNODE_0 (CanIfRxPduCfg):
        CanIfRxPduReadData = false
        CanIfRxPduReadNotifyStatus = true
        CanIfRxPduCanId = 129
        CanIfRxPduCanIdType = STANDARD_CAN
        CanIfRxPduDlc = 8
        CanIfRxPduId = 0
        CanIfRxPduUserRxIndicationName = PduR_CanIfRxIndication
        CanIfRxPduUserRxIndicationUL = PDUR
        CanIfRxPduHrhIdRef = Can_Network_CANNODE_0_Rx_Std_MailBox_1
        CanIfRxPduControllerRef = Can_Network_CANNODE_0
        CanIfRxPduRef = HCU_01_Can_Network_CANNODE_0_CanIf2PduR
      HCU_02_Can_Network_CANNODE_0 (CanIfRxPduCfg):
        CanIfRxPduReadData = false
        CanIfRxPduReadNotifyStatus = true
        CanIfRxPduCanId = 609
        CanIfRxPduCanIdType = STANDARD_CAN
        CanIfRxPduDlc = 1
        CanIfRxPduId = 1
        CanIfRxPduUserRxIndicationName = PduR_CanIfRxIndication
        CanIfRxPduUserRxIndicationUL = PDUR
        CanIfRxPduHrhIdRef = Can_Network_CANNODE_0_Rx_Std_MailBox_2
        CanIfRxPduControllerRef = Can_Network_CANNODE_0
        CanIfRxPduRef = HCU_02_Can_Network_CANNODE_0_CanIf2PduR
      Buffer_Can_Network_CANNODE_0_Tx_Std_MailBox_1 (CanIfBufferCfg): CanIfBufferSize=0, CanIfBufferHthRef=Can_Network_CANNODE_0_Tx_Std_MailBox_1
      MCU_02_Can_Network_CANNODE_0 (CanIfTxPduCfg):
        CanIfTxPduReadNotifyStatus = false
        CanIfTxPduType = STATIC
        CanIfTxPduCanIdType = STANDARD_CAN
        CanIfTxPduCanId = 151
        CanIfTxPduDlc = 7
        CanIfTxPduUserTxConfirmationUL = PDUR
        CanIfTxPduTruncation = true
        CanIfTxPduControllerRef = Can_Network_CANNODE_0
        CanIfTxPduBufferRef = Buffer_Can_Network_CANNODE_0_Tx_Std_MailBox_1
        CanIfTxPduRef = MCU_02_Can_Network_CANNODE_0_PduR2CanIf
      Buffer_Can_Network_CANNODE_0_Tx_Std_MailBox_2 (CanIfBufferCfg): CanIfBufferSize=0, CanIfBufferHthRef=Can_Network_CANNODE_0_Tx_Std_MailBox_2
      MCU_01_Can_Network_CANNODE_0 (CanIfTxPduCfg):
        CanIfTxPduReadNotifyStatus = false
        CanIfTxPduType = STATIC
        CanIfTxPduCanIdType = STANDARD_CAN
        CanIfTxPduCanId = 85
        CanIfTxPduDlc = 6
        CanIfTxPduId = 1
        CanIfTxPduUserTxConfirmationUL = PDUR
        CanIfTxPduTruncation = true
        CanIfTxPduControllerRef = Can_Network_CANNODE_0
        CanIfTxPduBufferRef = Buffer_Can_Network_CANNODE_0_Tx_Std_MailBox_2
        CanIfTxPduRef = MCU_01_Can_Network_CANNODE_0_PduR2CanIf
      Buffer_Can_Network_CANNODE_0_Tx_Std_MailBox_3 (CanIfBufferCfg): CanIfBufferSize=0, CanIfBufferHthRef=Can_Network_CANNODE_0_Tx_Std_MailBox_3
      MCU_03_Can_Network_CANNODE_0 (CanIfTxPduCfg):
        CanIfTxPduReadNotifyStatus = false
        CanIfTxPduType = STATIC
        CanIfTxPduCanIdType = STANDARD_CAN
        CanIfTxPduCanId = 262
        CanIfTxPduDlc = 8
        CanIfTxPduId = 2
        CanIfTxPduUserTxConfirmationUL = PDUR
        CanIfTxPduTruncation = true
        CanIfTxPduControllerRef = Can_Network_CANNODE_0
        CanIfTxPduBufferRef = Buffer_Can_Network_CANNODE_0_Tx_Std_MailBox_3
        CanIfTxPduRef = MCU_03_Can_Network_CANNODE_0_PduR2CanIf
      Diag_Functional_request_Can_Network_CANNODE_0 (CanIfRxPduCfg):
        CanIfRxPduReadData = false
        CanIfRxPduReadNotifyStatus = true
        CanIfRxPduCanId = 2015
        CanIfRxPduCanIdType = STANDARD_CAN
        CanIfRxPduDlc = 1
        CanIfRxPduId = 2
        CanIfRxPduUserRxIndicationUL = CAN_TP
        CanIfRxPduHrhIdRef = Can_Network_CANNODE_0_Rx_Std_MailBox_3
        CanIfRxPduControllerRef = Can_Network_CANNODE_0
        CanIfRxPduRef = Diag_Functional_request_Can_Network_CANNODE_0_CanIf2CanTp
      Diag_Physical_request_Can_Network_CANNODE_0 (CanIfRxPduCfg):
        CanIfRxPduReadData = false
        CanIfRxPduReadNotifyStatus = true
        CanIfRxPduCanId = 1856
        CanIfRxPduCanIdType = STANDARD_CAN
        CanIfRxPduDlc = 1
        CanIfRxPduId = 3
        CanIfRxPduUserRxIndicationUL = CAN_TP
        CanIfRxPduHrhIdRef = Can_Network_CANNODE_0_Rx_Std_MailBox_4
        CanIfRxPduControllerRef = Can_Network_CANNODE_0
        CanIfRxPduRef = Diag_Physical_request_Can_Network_CANNODE_0_CanIf2CanTp
      Buffer_Can_Network_CANNODE_0_Tx_Std_MailBox_4 (CanIfBufferCfg): CanIfBufferSize=0, CanIfBufferHthRef=Can_Network_CANNODE_0_Tx_Std_MailBox_4
      Diag_Physical_response_Can_Network_CANNODE_0 (CanIfTxPduCfg):
        CanIfTxPduReadNotifyStatus = false
        CanIfTxPduType = STATIC
        CanIfTxPduCanIdType = STANDARD_CAN
        CanIfTxPduCanId = 1864
        CanIfTxPduDlc = 8
        CanIfTxPduId = 3
        CanIfTxPduUserTxConfirmationUL = CAN_TP
        CanIfTxPduTruncation = true
        CanIfTxPduControllerRef = Can_Network_CANNODE_0
        CanIfTxPduBufferRef = Buffer_Can_Network_CANNODE_0_Tx_Std_MailBox_4
        CanIfTxPduRef = Diag_Physical_response_Can_Network_CANNODE_0_Phys_CanTp2CanIf
      NM_VCU_Rx_ETAS_Can_Network_CANNODE_0 (CanIfRxPduCfg):
        CanIfRxPduReadData = false
        CanIfRxPduReadNotifyStatus = true
        CanIfRxPduCanId = 1536
        CanIfRxPduCanIdType = STANDARD_CAN
        CanIfRxPduDlc = 8
        CanIfRxPduId = 4
        CanIfRxPduUserRxIndicationUL = CAN_NM
        CanIfRxPduHrhIdRef = Can_Network_CANNODE_0_Rx_Std_MailBox_5
        CanIfRxPduControllerRef = Can_Network_CANNODE_0
        CanIfRxPduRef = NM_VCU_Rx_ETAS_Can_Network_CANNODE_0_CanIf2CanNm
      Buffer_Can_Network_CANNODE_0_Tx_Std_MailBox_5 (CanIfBufferCfg): CanIfBufferSize=0, CanIfBufferHthRef=Can_Network_CANNODE_0_Tx_Std_MailBox_5
      NM_VCU_Can_Network_CANNODE_0 (CanIfTxPduCfg):
        CanIfTxPduReadNotifyStatus = false
        CanIfTxPduType = STATIC
        CanIfTxPduCanIdType = STANDARD_CAN
        CanIfTxPduCanId = 1655
        CanIfTxPduDlc = 8
        CanIfTxPduId = 4
        CanIfTxPduUserTxConfirmationUL = CAN_NM
        CanIfTxPduTruncation = true
        CanIfTxPduControllerRef = Can_Network_CANNODE_0
        CanIfTxPduBufferRef = Buffer_Can_Network_CANNODE_0_Tx_Std_MailBox_5
        CanIfTxPduRef = NM_VCU_Can_Network_CANNODE_0_CanNm2CanIf
      XCP_RX_CMD_Can_Network_CANNODE_1 (CanIfRxPduCfg):
        CanIfRxPduReadData = false
        CanIfRxPduReadNotifyStatus = true
        CanIfRxPduCanId = 819
        CanIfRxPduCanIdType = STANDARD_NO_FD_CAN
        CanIfRxPduDlc = 1
        CanIfRxPduId = 5
        CanIfRxPduUserRxIndicationUL = XCP
        CanIfRxPduHrhIdRef = Can_Network_CANNODE_1_Rx_Std_MailBox_1
        CanIfRxPduControllerRef = Can_Network_CANNODE_1
        CanIfRxPduRef = XCP_RX_CMD_Can_Network_CANNODE_1_CanIf2Xcp
      Buffer_Can_Network_CANNODE_1_Tx_Std_MailBox_1 (CanIfBufferCfg): CanIfBufferSize=0, CanIfBufferHthRef=Can_Network_CANNODE_1_Tx_Std_MailBox_1
      XCP_TX_RES_Can_Network_CANNODE_1 (CanIfTxPduCfg):
        CanIfTxPduReadNotifyStatus = false
        CanIfTxPduType = STATIC
        CanIfTxPduCanIdType = STANDARD_CAN
        CanIfTxPduCanId = 1911
        CanIfTxPduDlc = 8
        CanIfTxPduId = 5
        CanIfTxPduUserTxConfirmationUL = XCP
        CanIfTxPduTruncation = true
        CanIfTxPduControllerRef = Can_Network_CANNODE_1
        CanIfTxPduBufferRef = Buffer_Can_Network_CANNODE_1_Tx_Std_MailBox_1
        CanIfTxPduRef = XCP_TX_RES_Can_Network_CANNODE_1_Xcp2CanIf
      XCP_RX_Broadcast_Can_Network_CANNODE_1 (CanIfRxPduCfg):
        CanIfRxPduReadData = false
        CanIfRxPduReadNotifyStatus = true
        CanIfRxPduCanId = 818
        CanIfRxPduCanIdType = STANDARD_NO_FD_CAN
        CanIfRxPduDlc = 1
        CanIfRxPduId = 6
        CanIfRxPduUserRxIndicationUL = XCP
        CanIfRxPduControllerRef = Can_Network_CANNODE_1
        CanIfRxPduRef = XCP_RX_Broadcast_Can_Network_CANNODE_1_CanIf2Xcp
        CanIfRxPduHrhIdRef = Can_Network_CANNODE_1_Rx_Std_MailBox_2
      Buffer_Can_Network_CANNODE_1_Tx_Std_MailBox_2 (CanIfBufferCfg): CanIfBufferSize=0, CanIfBufferHthRef=Can_Network_CANNODE_1_Tx_Std_MailBox_2
      XCP_TX_DAQ2_Can_Network_CANNODE_1 (CanIfTxPduCfg):
        CanIfTxPduReadNotifyStatus = false
        CanIfTxPduType = STATIC
        CanIfTxPduCanIdType = STANDARD_CAN
        CanIfTxPduCanId = 1914
        CanIfTxPduDlc = 8
        CanIfTxPduId = 6
        CanIfTxPduUserTxConfirmationUL = XCP
        CanIfTxPduTruncation = true
        CanIfTxPduControllerRef = Can_Network_CANNODE_1
        CanIfTxPduBufferRef = Buffer_Can_Network_CANNODE_1_Tx_Std_MailBox_2
        CanIfTxPduRef = XCP_TX_DAQ2_Can_Network_CANNODE_1_Xcp2CanIf
      Buffer_Can_Network_CANNODE_1_Tx_Std_MailBox_3 (CanIfBufferCfg): CanIfBufferSize=0, CanIfBufferHthRef=Can_Network_CANNODE_1_Tx_Std_MailBox_3
      XCP_TX_DAQ1_Can_Network_CANNODE_1 (CanIfTxPduCfg):
        CanIfTxPduReadNotifyStatus = false
        CanIfTxPduType = STATIC
        CanIfTxPduCanIdType = STANDARD_CAN
        CanIfTxPduCanId = 1913
        CanIfTxPduDlc = 8
        CanIfTxPduId = 7
        CanIfTxPduUserTxConfirmationUL = XCP
        CanIfTxPduTruncation = true
        CanIfTxPduControllerRef = Can_Network_CANNODE_1
        CanIfTxPduBufferRef = Buffer_Can_Network_CANNODE_1_Tx_Std_MailBox_3
        CanIfTxPduRef = XCP_TX_DAQ1_Can_Network_CANNODE_1_Xcp2CanIf
      Buffer_Can_Network_CANNODE_1_Tx_Std_MailBox_4 (CanIfBufferCfg): CanIfBufferSize=0, CanIfBufferHthRef=Can_Network_CANNODE_1_Tx_Std_MailBox_4
      XCP_TX_DAQ0_Can_Network_CANNODE_1 (CanIfTxPduCfg):
        CanIfTxPduReadNotifyStatus = false
        CanIfTxPduType = STATIC
        CanIfTxPduCanIdType = STANDARD_CAN
        CanIfTxPduCanId = 1912
        CanIfTxPduDlc = 8
        CanIfTxPduId = 8
        CanIfTxPduUserTxConfirmationUL = XCP
        CanIfTxPduTruncation = true
        CanIfTxPduControllerRef = Can_Network_CANNODE_1
        CanIfTxPduBufferRef = Buffer_Can_Network_CANNODE_1_Tx_Std_MailBox_4
        CanIfTxPduRef = XCP_TX_DAQ0_Can_Network_CANNODE_1_Xcp2CanIf
      3 x CanIfRxPduCfg, all with CanIfRxPduReadData=false, CanIfRxPduReadNotifyStatus=true, CanIfRxPduCanIdType=STANDARD_CAN, CanIfRxPduDlc=1, CanIfRxPduUserRxIndicationName=PduR_CanIfRxIndication, CanIfRxPduUserRxIndicationUL=PDUR:
        HCU_03_Can_Network_CANNODE_0: CanIfRxPduCanId=614, CanIfRxPduHrhIdRef=Can_Network_CANNODE_0_Rx_Std_MailBox_6, CanIfRxPduRef=HCU_03_Can_Network_CANNODE_0_CanIf2PduR
        HCU_04_Can_Network_CANNODE_0: CanIfRxPduCanId=631, CanIfRxPduHrhIdRef=Can_Network_CANNODE_0_Rx_Std_MailBox_7, CanIfRxPduRef=HCU_04_Can_Network_CANNODE_0_CanIf2PduR
        HCU_05_Can_Network_CANNODE_0: CanIfRxPduCanId=648, CanIfRxPduHrhIdRef=Can_Network_CANNODE_0_Rx_Std_MailBox_8, CanIfRxPduRef=HCU_05_Can_Network_CANNODE_0_CanIf2PduR
      Buffer_Can_Network_CANNODE_0_Tx_Std_MailBox_6 (CanIfBufferCfg): CanIfBufferSize=0, CanIfBufferHthRef=Can_Network_CANNODE_0_Tx_Std_MailBox_6
      MCU_04_Can_Network_CANNODE_0 (CanIfTxPduCfg):
        CanIfTxPduReadNotifyStatus = false
        CanIfTxPduType = STATIC
        CanIfTxPduTruncation = false
        CanIfTxPduCanIdType = STANDARD_CAN
        CanIfTxPduCanId = 264
        CanIfTxPduUserTxConfirmationUL = PDUR
        CanIfTxPduBufferRef = Buffer_Can_Network_CANNODE_0_Tx_Std_MailBox_6
        CanIfTxPduRef = MCU_04_Can_Network_CANNODE_0_PduR2CanIf
    CanIfCtrlDrvCfg:
      CanIfCtrlDrvBusOffNotification = true
      CanIfCtrlDrvWakeUpNotification = false
      CanIfCtrlDrvNameRef = CanGeneral
      CanIfCtrlDrvInitHohConfigRef = CanIfInitHohCfg
      Can_Network_CANNODE_0 (CanIfCtrlCfg): CanIfCtrlId=0, CanIfMaxDlc=8, CanIfCtrlWakeupSupport=false, CanIfCtrlCanCtrlRef=Can_Network_CANNODE_0
      Can_Network_CANNODE_1 (CanIfCtrlCfg): CanIfCtrlId=1, CanIfCtrlWakeupSupport=false, CanIfCtrlCanCtrlRef=Can_Network_CANNODE_1
    CanIfDispatchCfg: CanIfDispatchUserCtrlBusOffUL=CAN_SM, CanIfDispatchUserCtrlModeIndicationUL=CAN_SM, CanIfDispatchUserTrcvModeIndicationName=CAN_SM
    CanIfPrivateCfg: CanIfPrivateDlcCheck=true
    CanIfPublicCfg:
      CanIfPublicReadRxPduDataApi = false
      CanIfPublicReadRxPduNotifyStatusApi = true
      CanIfPublicReadTxPduNotifyStatusApi = true
      CanIfPublicSetDynamicTxIdApi = false
      CanIfPublicTxBuffering = false
      CanIfPublicTxConfirmPollingSupport = false
      CanIfPublicVersionInfoApi = false
      CanIfPublicChangeBaudrateSupport = false
      CanIfPublicCancelTransmitSupport = false
      CanIfPublicRxBuffering = false
      CanIfPublicErrorPassiveSupport = false
      CanIfPublicDynamicTxIdSupport = false
      CanIfPublicCanIfLiteConfiguration = false
      CanIfPublicUserTpTxInOfflineMode = false
      CanIfPublicWakeupCheckValidSupport = false
      CanIfPublicPnSupport = false
      CanIfPublicHandleTypeEnum = UINT16
      CanIfPublicBusoffRecoveryfromRxIndication = false
      CanIfPublicInstanceId = 1
      CanIfPublicDevErrorDetect = true
      CanIfTriggerTransmitSupport = true
      CanIfTxOfflineActiveSupport = false
      CanIfWakeupSupport = false
      CanIfReadMsgIdApi = true
      CanIfCalibrationSupport: CanIfCalibration=false
