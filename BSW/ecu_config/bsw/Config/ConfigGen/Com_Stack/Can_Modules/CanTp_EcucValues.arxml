AUTOSAR XML (schema 4-2-2)
package /CanTp_EcucValues
  module config CanTp: implementation-config-variant=VARIANT-PRE-COMPILE
    CanTpConfig: CanTpMainFunctionPeriod=0.001
      CanTpChannel_UDS (CanTpChannel): CanTpChannelMode=CANTP_MODE_FULL_DUPLEX
        Diag_Functional_request_Can_Network_CANNODE_0_Phys_CanTp2PduR (CanTpRxNSdu):
          CanTpBs = 8
          CanTpNar = 1.0
          CanTpNbr = 0.0
          CanTpNcr = 1.0
          CanTpRxAddressingFormat = CANTP_STANDARD
          CanTpRxPaddingActivation = CANTP_OFF
          CanTpRxTaType = CANTP_FUNCTIONAL
          CanTpSTmin = 0.002
          CanTpRxNSduId = 0
          CanTpRxNSduRef = Diag_Functional_request_Can_Network_CANNODE_0_CanTp2PduR
          Diag_Functional_request_Can_Network_CANNODE_0_Phys_CanIf2CanTp (CanTpRxNPdu): CanTpRxNPduRef=Diag_Functional_request_Can_Network_CANNODE_0_CanIf2CanTp
        Diag_Physical_request_Can_Network_CANNODE_0_Func_CanTp2PduR (CanTpRxNSdu):
          CanTpBs = 8
          CanTpNar = 1.0
          CanTpNbr = 0.0
          CanTpNcr = 1.0
          CanTpRxAddressingFormat = CANTP_STANDARD
          CanTpRxNSduId = 0
          CanTpRxPaddingActivation = CANTP_OFF
          CanTpRxTaType = CANTP_PHYSICAL
          CanTpSTmin = 0.002
          CanTpRxNSduRef = Diag_Physical_request_Can_Network_CANNODE_0_CanTp2PduR
          Diag_Physical_request_Can_Network_CANNODE_0_Phys_CanIf2CanTp (CanTpRxNPdu): CanTpRxNPduRef=Diag_Physical_request_Can_Network_CANNODE_0_CanIf2CanTp
          Diag_Physical_response_Can_Network_CANNODE_0_Phys_CanTp2CanIf (CanTpTxFcNPdu): CanTpTxFcNPduRef=Diag_Physical_response_Can_Network_CANNODE_0_Phys_CanTp2CanIf
        Diag_Physical_response_Can_Network_CANNODE_0_Phys_PduR2CanTp (CanTpTxNSdu):
          CanTpNas = 1.0
          CanTpNbs = 1.0
          CanTpNcs = 0.002
          CanTpTc = 1
          CanTpTxAddressingFormat = CANTP_STANDARD
          CanTpTxPaddingActivation = CANTP_ON
          CanTpTxTaType = CANTP_PHYSICAL
          CanTpTxNSduRef = Diag_Physical_response_Can_Network_CANNODE_0_Phys_PduR2CanTp
          Diag_Physical_response_Can_Network_CANNODE_0_Phys_CanTp2CanIf (CanTpTxNPdu): CanTpTxNPduRef=Diag_Physical_response_Can_Network_CANNODE_0_Phys_CanTp2CanIf
          Diag_Physical_request_Can_Network_CANNODE_0_Phys_CanIf2CanTp (CanTpRxFcNPdu): CanTpRxFcNPduRef=Diag_Physical_request_Can_Network_CANNODE_0_CanIf2CanTp
    CanTpGeneral:
      CanTpDynIdSupport = 0
      CanTpFlexibleDataRateSupport = 1
      CanTpGenericConnectionSupport = 0
      CanTpRbDynamicFlowControlSupport = 0
      CanTpRbLegacySharedFcEnabled = 0
      CanTpRbLiteSupport = 0
      CanTpRbStrictBsCrTimeoutCheck = 0
      CanTpRbStrictDlcCheck = 0
      CanTpChangeParameterApi = 0
      CanTpDevErrorDetect = true
      CanTpPaddingByte = 0
      CanTpVersionInfoApi = false
      CanTpReadParameterApi = 0
      CanTpRbPageConfirmation = false
