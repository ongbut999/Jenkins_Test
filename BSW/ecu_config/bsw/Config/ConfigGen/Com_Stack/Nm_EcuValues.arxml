AUTOSAR XML (schema 4-2-2)
package /RB/UBK/Project/EcucModuleConfigurationValuess
  module config Nm_EcuValues: definition=Nm
    NmChannelConfig_0 (NmChannelConfig):
      NmShutdownDelayTimer = 0.0
      NmChannelSleepMaster = false
      NmStateReportEnabled = false
      NmSynchronizingNetwork = false
      NmComMChannelRef = ComMChannel_Can_Network_Channel
      NmBusType_0 (NmBusType)
        NmStandardBusNmConfig: NmStandardBusType=NM_BUSNM_CANNM
    NmGlobalConfig_0 (NmGlobalConfig)
      NmGlobalConstants_0 (NmGlobalConstants): NmNumberOfChannels=1, NmRxIndicationCallback=Nm_RxIndicationCallback, NmStateChangeIndCallback=Nm_StateChangeIndication
      NmGlobalFeatures_0 (NmGlobalFeatures):
        NmCarWakeUpRxEnabled = 0
        NmComUserDataSupport = 0
        NmCoordinatorSupportEnabled = false
        NmBusSynchronizationEnabled = false
        NmComControlEnabled = true
        NmCoordinatorSyncSupport = false
        NmNodeDetectionEnabled = true
        NmNodeIdEnabled = true
        NmPassiveModeEnabled = false
        NmPduRxIndicationEnabled = true
        NmRemoteSleepIndEnabled = false
        NmRepeatMsgIndEnabled = true
        NmStateChangeIndEnabled = true
        NmUserDataEnabled = true
      NmGlobalProperties_0 (NmGlobalProperties): NmDevErrorDetect=true, NmCycletimeMainFunction=0.01, NmVersionInfoApi=true
