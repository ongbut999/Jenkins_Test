AUTOSAR XML (schema 4-2-2)
package /ETAS_Project/EcucModuleConfigurationValuess
  module config ComM: implementation-config-variant=VARIANT-PRE-COMPILE
    ComMGeneral:
      ComMEcuGroupClassification = 0
      ComMModeLimitationEnabled = true
      ComMTMinFullComModeDuration = 0.01
      ComMVersionInfoApi = false
      ComMWakeupInhibitionEnabled = false
      ComMPncGatewayEnabled = false
      ComMPncSupport = false
      ComMResetAfterForcingNoComm = false
      ComMSynchronousWakeUp = false
      ComMRteEnabled = true
      ComMDevErrorDetect = true
    ComMConfigSet
      ComMUser_Can_Network_Channel (ComMUser): ComMUserIdentifier=0
      ComMChannel_Can_Network_Channel (ComMChannel):
        ComMMainFunctionPeriod = 0.01
        ComMFullCommRequestNotificationEnabled = false
        ComMNoCom = false
        ComMNoWakeUpInhibitionNvmStorage = false
        ComMNoWakeup = false
        ComMChannelId = 0
        ComMBusType = COMM_BUS_TYPE_CAN
        ComMNetworkManagement: ComMNmLightTimeout=2.0, ComMNmVariant=FULL, ComMPncNmRequest=false
        ComMUserPerChannel_Can_Network_Channel (ComMUserPerChannel): ComMUserChannel=ComMUser_Can_Network_Channel
      ComMUser_Can_Network_XCP_Channel (ComMUser): ComMUserIdentifier=1
      ComMChannel_Can_Network_XCP_Channel (ComMChannel):
        ComMMainFunctionPeriod = 0.01
        ComMFullCommRequestNotificationEnabled = false
        ComMNoCom = true
        ComMNoWakeUpInhibitionNvmStorage = false
        ComMNoWakeup = true
        ComMChannelId = 1
        ComMBusType = COMM_BUS_TYPE_CAN
        ComMNetworkManagement: ComMNmLightTimeout=10, ComMNmVariant=NONE, ComMPncNmRequest=false
        ComMUserPerChannel_Can_Network_XCP_Channel (ComMUserPerChannel): ComMUserChannel=ComMUser_Can_Network_XCP_Channel
