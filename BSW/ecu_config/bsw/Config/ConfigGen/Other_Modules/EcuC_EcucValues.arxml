AUTOSAR XML (schema 4-2-2)
package /ETAS_Project/EcucModuleConfigurationValuess
  module config EcuC: implementation-config-variant=VARIANT-PRE-COMPILE
    EcucConfigSet
      PduCollection (EcucPduCollection): PduIdTypeEnum=uint16, PduLengthTypeEnum=uint16
        35 x Pdu:
          HCU_01_Can_Network_CANNODE_0_CanIf2PduR: PduLength=8
          HCU_01_Can_Network_CANNODE_0_PduR2Com: PduLength=8
          HCU_02_Can_Network_CANNODE_0_CanIf2PduR: PduLength=1
          HCU_02_Can_Network_CANNODE_0_PduR2Com: PduLength=1
          MCU_02_Can_Network_CANNODE_0_Com2PduR: PduLength=8
          MCU_02_Can_Network_CANNODE_0_PduR2CanIf: PduLength=8
          MCU_01_Can_Network_CANNODE_0_Com2PduR: PduLength=8
          MCU_01_Can_Network_CANNODE_0_PduR2CanIf: PduLength=8
          MCU_03_Can_Network_CANNODE_0_Com2PduR: PduLength=7
          MCU_03_Can_Network_CANNODE_0_PduR2CanIf: PduLength=7
          Diag_Functional_request_Can_Network_CANNODE_0_CanIf2CanTp: PduLength=8
          Diag_Functional_request_Can_Network_CANNODE_0_CanTp2PduR: PduLength=8
          Diag_Functional_request_Can_Network_CANNODE_0_PduR2Dcm: PduLength=8
          Diag_Physical_request_Can_Network_CANNODE_0_CanIf2CanTp: PduLength=8
          Diag_Physical_request_Can_Network_CANNODE_0_CanTp2PduR: PduLength=8
          Diag_Physical_request_Can_Network_CANNODE_0_PduR2Dcm: PduLength=8
          Diag_Physical_response_Can_Network_CANNODE_0_Phys_Dcm2PduR: PduLength=8
          Diag_Physical_response_Can_Network_CANNODE_0_Phys_PduR2CanTp: PduLength=8
          Diag_Physical_response_Can_Network_CANNODE_0_Phys_CanTp2CanIf: PduLength=8
          XCP_RX_CMD_Can_Network_CANNODE_1_CanIf2Xcp: PduLength=8
          NM_VCU_Rx_ETAS_Can_Network_CANNODE_0_CanIf2CanNm: PduLength=7
          NM_VCU_Can_Network_CANNODE_0_CanNm2CanIf: PduLength=7
          XCP_TX_RES_Can_Network_CANNODE_1_Xcp2CanIf: PduLength=8
          XCP_RX_Broadcast_Can_Network_CANNODE_1_CanIf2Xcp: PduLength=8
          XCP_TX_DAQ2_Can_Network_CANNODE_1_Xcp2CanIf: PduLength=8
          XCP_TX_DAQ1_Can_Network_CANNODE_1_Xcp2CanIf: PduLength=8
          XCP_TX_DAQ0_Can_Network_CANNODE_1_Xcp2CanIf: PduLength=8
          HCU_03_Can_Network_CANNODE_0_CanIf2PduR: PduLength=1
          HCU_03_Can_Network_CANNODE_0_PduR2Com: PduLength=1
          HCU_04_Can_Network_CANNODE_0_CanIf2PduR: PduLength=1
          HCU_04_Can_Network_CANNODE_0_PduR2Com: PduLength=1
          HCU_05_Can_Network_CANNODE_0_CanIf2PduR: PduLength=1
          HCU_05_Can_Network_CANNODE_0_PduR2Com: PduLength=1
          MCU_04_Can_Network_CANNODE_0_Com2PduR: PduLength=8
          MCU_04_Can_Network_CANNODE_0_PduR2CanIf: PduLength=8
    EcuCRbSettings: EcuCRbArRelease=AR42_Rev2, EcuCRbRteInUse=true
    EcucPartitionCollection
      3 x EcucPartition, all with PartitionCanBeRestarted=false:
        EcucPartition_Core0: EcucPartitionBswModuleExecution=1, EcucPartitionSoftwareComponentInstanceRef=CPT_NvM, EcucPartitionSoftwareComponentInstanceRef=CPT_XCP, EcucPartitionSoftwareComponentInstanceRef=CPT_Wdg, EcucPartitionSoftwareComponentInstanceRef=CPT_BswM, EcucPartitionSoftwareComponentInstanceRef=CPT_Dem_SWC, EcucPartitionSoftwareComponentInstanceRef=CPT_EcuM, EcucPartitionSoftwareComponentInstanceRef=CPT_ASW_COM, EcucPartitionSoftwareComponentInstanceRef=CPT_Diag, EcucPartitionSoftwareComponentInstanceRef=CPT_Dcm, EcucPartitionSoftwareComponentInstanceRef=CPT_ComM, EcucPartitionSoftwareComponentInstanceRef=CPT_Det, EcucPartitionSoftwareComponentInstanceRef=CPT_Dem, EcucPartitionSoftwareComponentInstanceRef=CPT_ASW_NM, EcucPartitionSoftwareComponentInstanceRef=CPT_ASW_NVM, EcucPartitionSoftwareComponentInstanceRef=CPT_ASW_WDG, EcucPartitionSoftwareComponentInstanceRef=CPT_ASW_BASE
        EcucPartition_Core1: EcucPartitionBswModuleExecution=false, EcucPartitionSoftwareComponentInstanceRef=CPT_ASW_CORE1
        EcucPartition_Core2: EcucPartitionBswModuleExecution=false, EcucPartitionSoftwareComponentInstanceRef=CPT_ASW_CORE2
    EcucHardware
      3 x EcucCoreDefinition:
        EcucCore0: EcucCoreId=0, EcucCoreHwRef=(unset)
        EcucCore1: EcucCoreId=1
        EcucCore2: EcucCoreId=2
