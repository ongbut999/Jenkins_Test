AUTOSAR XML (schema 4-2-2)
package /RB/UBK/Project/EcucModuleConfigurationValuess
  module config Platform
    PlatformRbSettings_0 (PlatformRbSettings):
      PlatformRbArRelease = AR42_Rev2
      PlatformRbCpuBitOrder = LSB_FIRST
      PlatformRbCpuByteOrder = LOW_BYTE_FIRST
      PlatformRbCpuType = CPU_TYPE_32
      PlatformRbFloatActivation = ALLOW
      PlatformRbNativeBoolean = unsigned char
      PlatformRbNativeFloat32 = float
      PlatformRbNativeFloat64 = double
      PlatformRbNativeSint16 = signed short
      PlatformRbNativeSint16Least = signed long
      PlatformRbNativeSint32 = signed int
      PlatformRbNativeSint32Least = signed long
      PlatformRbNativeSint64 = signed long long
      PlatformRbNativeSint8 = signed char
      PlatformRbNativeSint8Least = signed long
      PlatformRbNativeUint16 = unsigned short
      PlatformRbNativeUint16Least = unsigned long
      PlatformRbNativeUint32 = unsigned int
      PlatformRbNativeUint32Least = unsigned long
      PlatformRbNativeUint64 = unsigned long long
      PlatformRbNativeUint8 = unsigned char
      PlatformRbNativeUint8Least = unsigned long
