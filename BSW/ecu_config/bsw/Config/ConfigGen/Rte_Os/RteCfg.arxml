AUTOSAR XML (schema 4-2-2)
package /RteCfg
  module config RteCfg: definition=Rte
    RteGeneration_0 (RteGeneration):
      RteBypassSupport = NONE
      RteCalibrationSupport = NONE
      RteDevErrorDetect = false
      RteDevErrorDetectUninit = false
      RteGenerationMode = VENDOR_MODE
      RteInExclusiveAreaCheckEnabled = true
      RteIocInteractionReturnValue = RTE_IOC
      RteMeasurementSupport = false
      RteOptimizationMode = RUNTIME
      RteToolChainSignificantCharacters = 31
      RteValueRangeCheckEnabled = false
      RteVfbTraceEnabled = false
    RteInitializationBehavior_0 (RteInitializationBehavior)
    RteOsInteraction_0 (RteOsInteraction)
    6 x RteBswModuleInstance:
      BSWIMPL_BswM: RteBswImplementationRef=BSWIMPL_BswM, RteBswModuleConfigurationRef=BswM
        5 x RteBswEventToTaskMapping:
          MSE_BswM_Cfg_DfrdBswNotification_BswM_MRP_BswM_MDG_ECUM_STATE_STARTUP_TWO: RteBswPositionInTask=3, RteBswEventRef=MSE_BswM_Cfg_DfrdBswNotification_BswM_MRP_BswM_MDG_ECUM_STATE_STARTUP_TWO
          MSE_BswM_Cfg_DfrdBswNotification_BswM_MRP_BswM_MDG_ECUM_STATE_RUN: RteBswPositionInTask=4, RteBswEventRef=MSE_BswM_Cfg_DfrdBswNotification_BswM_MRP_BswM_MDG_ECUM_STATE_RUN
          MSE_BswM_Cfg_DfrdBswNotification_BswM_MRP_BswM_MDG_ECUM_STATE_STARTUP_ONE: RteBswPositionInTask=5, RteBswEventRef=MSE_BswM_Cfg_DfrdBswNotification_BswM_MRP_BswM_MDG_ECUM_STATE_STARTUP_ONE
          TE_BswM_MainFunction: RteBswPositionInTask=12, RteBswActivationOffset=0.0, RteBswMappedToTaskRef=OsTask_BSW_10ms, RteBswEventRef=TE_BswM_MainFunction
          MSE_BswM_Cfg_DfrdBswNotification_BswM_MRP_BswM_MDG_ECUM_STATE_SHUTDOWN: RteBswPositionInTask=6, RteBswEventRef=MSE_BswM_Cfg_DfrdBswNotification_BswM_MRP_BswM_MDG_ECUM_STATE_SHUTDOWN
        RteBswRequiredModeGroupConnection:
          RteBswProvidedModeGroupRef = MDGP_AUTOSAR_BswM_ModeDeclarationGroups_MDG_ECUM_STATE
          RteBswRequiredModeGroupRef = MDGR_BswM_MRP_BswM_MDG
          RteBswProvidedModeGrpModInstRef = BSWIMPL_BswM
        RteBswRequiredModeGroupEcuReset (RteBswRequiredModeGroupConnection):
          RteBswProvidedModeGroupRef = DcmEcuReset
          RteBswRequiredModeGroupRef = MDGR_BswM_MRP_DCM_ModeNotification_EcuReset
          RteBswProvidedModeGrpModInstRef = Dcm
        MSE_BswM_Cfg_ImdtBswNotification_BswM_MRP_DCM_ModeNotification_EcuReset_HARD (RteBswEventToTaskMapping): RteBswPositionInTask=8, RteBswEventRef=MSE_BswM_Cfg_DfrdBswNotification_BswM_MRP_DCM_ModeNotification_EcuReset_EXECUTE
        RteBswRequiredModeGroupSessionControl (RteBswRequiredModeGroupConnection):
          RteBswProvidedModeGroupRef = DcmDiagnosticSessionControl
          RteBswRequiredModeGroupRef = MDGR_BswM_MRP_DCM_DiagnosticSessionControl
          RteBswProvidedModeGrpModInstRef = Dcm
        10 x RteBswEventToTaskMapping:
          MSE_BswM_Cfg_DfrdBswNotification_BswM_MRP_BswM_MDG_ECUM_STATE_PREP_SHUTDOWN: RteBswPositionInTask=2, RteBswEventRef=MSE_BswM_Cfg_DfrdBswNotification_BswM_MRP_BswM_MDG_ECUM_STATE_PREP_SHUTDOWN
          MSE_BswM_Cfg_ImdtBswNotification_BswM_MRP_DCM_ModeNotification_EcuReset_SOFT: RteBswPositionInTask=9, RteBswEventRef=MSE_BswM_Cfg_DfrdBswNotification_BswM_MRP_DCM_ModeNotification_EcuReset_SOFT
          MSE_BswM_Cfg_ImdtBswNotification_BswM_MRP_DCM_DiagnosticSessionControl_DEFAULT_SESSION: RteBswPositionInTask=10, RteBswEventRef=MSE_BswM_Cfg_ImdtBswNotification_BswM_MRP_DCM_DiagnosticSessionControl_DEFAULT_SESSION
          MSE_BswM_Cfg_ImdtBswNotification_BswM_MRP_DCM_DiagnosticSessionControl_PROGRAMMING_SESSION: RteBswPositionInTask=11, RteBswEventRef=MSE_BswM_Cfg_ImdtBswNotification_BswM_MRP_DCM_DiagnosticSessionControl_PROGRAMMING_SESSION
          MSE_BswM_Cfg_ImdtBswNotification_BswM_MRP_DCM_DiagnosticSessionControl_EXTENDED_DIAGNOSTIC_SESSION: RteBswPositionInTask=12, RteBswEventRef=MSE_BswM_Cfg_ImdtBswNotification_BswM_MRP_DCM_DiagnosticSessionControl_EXTENDED_DIAGNOSTIC_SESSION
          MSE_BswM_Cfg_DfrdBswNotification_BswM_MRP_BswM_MDG_ECUM_STATE_APP_RUN: RteBswEventRef=MSE_BswM_Cfg_DfrdBswNotification_BswM_MRP_BswM_MDG_ECUM_STATE_APP_RUN
          MSE_BswM_Cfg_ImdtBswNotification_BswM_MRP_DCM_ModeNotification_EcuReset_EXECUTE: RteBswEventRef=MSE_BswM_Cfg_DfrdBswNotification_BswM_MRP_DCM_ModeNotification_EcuReset_EXECUTE
          MSE_BswM_Cfg_DfrdBswNotification_BswM_MRP_DCM_ModeNotification_EcuReset_SOFT: RteBswEventRef=MSE_BswM_Cfg_DfrdBswNotification_BswM_MRP_DCM_ModeNotification_EcuReset_SOFT
          MSE_BswM_Cfg_DfrdBswNotification_BswM_MRP_DCM_ModeNotification_EcuReset_EXECUTE: RteBswEventRef=MSE_BswM_Cfg_DfrdBswNotification_BswM_MRP_DCM_ModeNotification_EcuReset_EXECUTE
          MSE_BswM_Cfg_DfrdBswNotification_BswM_MRP_DCM_ModeNotification_EcuReset_JUMPTOBOOTLOADER: RteBswEventRef=MSE_BswM_Cfg_ImdtBswNotification_BswM_MRP_DCM_DiagnosticSessionControl_JUMPTOBOOTLOADER
      Com: RteBswImplementationRef=Com
        EV_BSWSE_MainFunctionRx (RteBswEventToTaskMapping): RteBswPositionInTask=9, RteBswActivationOffset=0.0, RteBswMappedToTaskRef=OsTask_BSW_10ms, RteBswEventRef=EV_BSWSE_MainFunctionRx
        EV_BSWSE_MainFunctionTx (RteBswEventToTaskMapping): RteBswPositionInTask=10, RteBswActivationOffset=0.0, RteBswMappedToTaskRef=OsTask_BSW_10ms, RteBswEventRef=EV_BSWSE_MainFunctionTx
      ComM: RteBswImplementationRef=ComM
        EV_BSWSE_MainFunction_ComMChannel_Can_Network_Channel (RteBswEventToTaskMapping):
          RteBswPositionInTask = 13
          RteBswActivationOffset = 0.0
          RteBswMappedToTaskRef = OsTask_BSW_10ms
          RteBswEventRef = EV_BSWSE_MainFunction_ComMChannel_Can_Network_Channel
        EV_BSWSE_MainFunction_ComMChannel_Can_Network_XCP_Channel (RteBswEventToTaskMapping):
          RteBswPositionInTask = 14
          RteBswActivationOffset = 0.0
          RteBswMappedToTaskRef = OsTask_BSW_10ms
          RteBswEventRef = EV_BSWSE_MainFunction_ComMChannel_Can_Network_XCP_Channel
      PduR: RteBswImplementationRef=PduR
      BSWIMPL_Can: RteBswImplementationRef=BSWIMPL_Can
        3 x RteBswEventToTaskMapping, all with RteBswActivationOffset=0.0:
          BSWTE_MainFunction_BusOff: RteBswPositionInTask=16, RteBswMappedToTaskRef=OsTask_BSW_10ms, RteBswEventRef=BSWTE_MainFunction_BusOff
          BSWTE_MainFunction_Write: RteBswPositionInTask=4, RteBswMappedToTaskRef=OsTask_BSW_1ms, RteBswEventRef=BSWTE_MainFunction_Write
          BSWTE_MainFunction_Read: RteBswPositionInTask=3, RteBswMappedToTaskRef=OsTask_BSW_1ms, RteBswEventRef=BSWTE_MainFunction_Read
      NVM: RteBswImplementationRef=NvM
        EV_SE_MainFunction (RteBswEventToTaskMapping): RteBswPositionInTask=8, RteBswActivationOffset=0.0, RteBswMappedToTaskRef=OsTask_BSW_10ms, RteBswEventRef=EV_SE_MainFunction
    CPT_BswM (RteSwComponentInstance): RteSoftwareComponentInstanceRef=CPT_BswM
      DRE_BswM_Cfg_DfrdSwcReqst_BswMSwcModeRequest (RteEventToTaskMapping): RtePositionInTask=3, RteActivationOffset=0.0, RteMappedToTaskRef=BSW_OsTask_SwcRequest, RteEventRef=DRE_BswM_Cfg_DfrdSwcReqst_BswMSwcModeRequest
      DRE_BswM_Cfg_DfrdSwcReqst_BswM_MRP_SWC_Network (RteEventToTaskMapping): RtePositionInTask=2, RteActivationOffset=0.0, RteMappedToTaskRef=BSW_OsTask_SwcRequest, RteEventRef=DRE_BswM_Cfg_DfrdSwcReqst_BswM_MRP_SWC_Network
    CPT_ASW_NVM (RteSwComponentInstance): RteSoftwareComponentInstanceRef=CPT_ASW_NVM
      TE_ASW_NVM_10ms (RteEventToTaskMapping): RtePositionInTask=5, RteActivationOffset=0.0, RteMappedToTaskRef=OsTask_ASW_10ms, RteEventRef=TE_ASW_NVM_10ms
    Dcm (RteBswModuleInstance): RteBswImplementationRef=Dcm
      EV_Dcm_MainFunction (RteBswEventToTaskMapping): RteBswPositionInTask=9, RteBswActivationOffset=0.0, RteBswMappedToTaskRef=OsTask_BSW_1ms, RteBswEventRef=EV_Dcm_MainFunction
      RteBswRequiredModeGroupConnection:
        RteBswProvidedModeGroupRef = DcmCommunicationControl_ComMChannel_Can_Network_Channel
        RteBswRequiredModeGroupRef = R_DcmCommunicationControl_ComMChannel_Can_Network_Channel
        RteBswProvidedModeGrpModInstRef = Dcm
    CanTp (RteBswModuleInstance): RteBswImplementationRef=CanTp
      TE_CanTpNormalOperatingMode (RteBswEventToTaskMapping): RteBswPositionInTask=7, RteBswActivationOffset=0.0, RteBswMappedToTaskRef=OsTask_BSW_1ms, RteBswEventRef=TE_CanTpNormalOperatingMode
    CPT_Diag (RteSwComponentInstance): RteSoftwareComponentInstanceRef=CPT_Diag
      TE_Diag_SWC (RteEventToTaskMapping): RtePositionInTask=6, RteActivationOffset=0.0, RteMappedToTaskRef=OsTask_ASW_10ms, RteEventRef=TE_Diag_SWC
    CPT_Dem_SWC (RteSwComponentInstance): RteSoftwareComponentInstanceRef=CPT_Dem_SWC
      TimingEvent_Dem_SWC (RteEventToTaskMapping): RtePositionInTask=8, RteActivationOffset=0.0, RteMappedToTaskRef=OsTask_ASW_10ms, RteEventRef=TimingEvent_Dem_SWC
    Xcp (RteBswModuleInstance): RteBswImplementationRef=Xcp
      4 x RteBswEventToTaskMapping, all with RteBswActivationOffset=0.0:
        EV_BSWSE_EventChannel_10ms: RteBswPositionInTask=9, RteBswMappedToTaskRef=OsTask_ASW_10ms, RteBswEventRef=EV_BSWSE_EventChannel_10ms
        EV_BSWSE_MainFunction: RteBswPositionInTask=11, RteBswMappedToTaskRef=OsTask_BSW_10ms, RteBswEventRef=EV_BSWSE_MainFunction
        EV_BSWSE_EventChannel_100ms: RteBswPositionInTask=6, RteBswMappedToTaskRef=OsTask_ASW_100ms, RteBswEventRef=EV_BSWSE_EventChannel_100ms
        EV_BSWSE_EventChannel_50ms: RteBswPositionInTask=10, RteBswMappedToTaskRef=OsTask_ASW_10ms, RteBswEventRef=EV_BSWSE_EventChannel_50ms
    CPT_XCP (RteSwComponentInstance): RteSoftwareComponentInstanceRef=CPT_XCP
      TimingEvent_0 (RteEventToTaskMapping): RtePositionInTask=5, RteActivationOffset=0.0, RteMappedToTaskRef=OsTask_ASW_100ms, RteEventRef=TimingEvent_0
    Dem (RteBswModuleInstance): RteBswImplementationRef=Dem, RteBswModuleConfigurationRef=Dem
      EV_MainFunction (RteBswEventToTaskMapping): RteBswPositionInTask=2, RteBswActivationOffset=0.0, RteBswMappedToTaskRef=OsTask_BSW_1ms, RteBswEventRef=EV_MainFunction
    4 x RteSwComponentInstance:
      CPT_ASW_BASE: RteSoftwareComponentInstanceRef=CPT_ASW_BASE
        TE_Base_SWC_100ms (RteEventToTaskMapping): RtePositionInTask=1, RteActivationOffset=0.0, RteMappedToTaskRef=OsTask_ASW_100ms, RteEventRef=TE_Base_SWC_100ms
        TE_OsShell_TriggerBg_1ms (RteEventToTaskMapping): RtePositionInTask=10, RteActivationOffset=0.0, RteMappedToTaskRef=OsTask_BSW_1ms, RteEventRef=TE_OsShell_TriggerBg_1ms
      CPT_ASW_WDG: RteSoftwareComponentInstanceRef=CPT_ASW_WDG
        TimingEvent_Alive_Supervision_Entity1 (RteEventToTaskMapping): RtePositionInTask=3, RteActivationOffset=0.0, RteMappedToTaskRef=OsTask_ASW_10ms, RteEventRef=TimingEvent_Alive_Supervision_Entity1
      CPT_ASW_NM: RteSoftwareComponentInstanceRef=CPT_ASW_NM
        TE_ASW_Nm_10ms (RteEventToTaskMapping): RtePositionInTask=2, RteActivationOffset=0.0, RteMappedToTaskRef=OsTask_ASW_10ms, RteEventRef=TE_ASW_Nm_10ms
      CPT_ASW_COM: RteSoftwareComponentInstanceRef=CPT_ASW_COM
        TE_SWC_COM_10ms (RteEventToTaskMapping): RtePositionInTask=1, RteActivationOffset=0.0, RteMappedToTaskRef=OsTask_ASW_10ms, RteEventRef=TE_SWC_COM_10ms
    3 x RteBswModuleInstance:
      WdgM: RteBswImplementationRef=WdgM
        TE_WdgMSupervisionCycle0 (RteBswEventToTaskMapping): RteBswPositionInTask=6, RteBswActivationOffset=0.0, RteBswMappedToTaskRef=OsTask_BSW_10ms, RteBswEventRef=TE_WdgMSupervisionCycle0
      CanSM: RteBswImplementationRef=CanSM
        EV_BSWSE_MainFunction (RteBswEventToTaskMapping): RteBswPositionInTask=1, RteBswActivationOffset=0.0, RteBswMappedToTaskRef=OsTask_BSW_1ms, RteBswEventRef=EV_BSWSE_MainFunction
      CanNm: RteBswImplementationRef=CanNm
        EV_BSWSE_MainFunction (RteBswEventToTaskMapping): RteBswPositionInTask=3, RteBswActivationOffset=0.0, RteBswMappedToTaskRef=OsTask_BSW_10ms, RteBswEventRef=EV_BSWSE_MainFunction
    CPT_ASW_CORE1 (RteSwComponentInstance): RteSoftwareComponentInstanceRef=CPT_ASW_CORE1
      TimingEvent_0 (RteEventToTaskMapping): RtePositionInTask=2, RteActivationOffset=0.0, RteMappedToTaskRef=Core1_OsTask_ASW_10ms, RteEventRef=TimingEvent_0
    EcuM (RteBswModuleInstance): RteBswImplementationRef=EcuM
      3 x RteBswEventToTaskMapping, all with RteBswPositionInTask=1, RteBswActivationOffset=0.0:
        TE_EcuM_MainFunction_Core0: RteBswMappedToTaskRef=OsTask_BSW_10ms, RteBswEventRef=TE_EcuM_MainFunction_Core0
        TE_EcuM_MainFunction_Core1: RteBswMappedToTaskRef=Core1_OsTask_BSW_10ms, RteBswEventRef=TE_EcuM_MainFunction_Core1
        TE_EcuM_MainFunction_Core2: RteBswMappedToTaskRef=Core2_OsTask_BSW_10ms, RteBswEventRef=TE_EcuM_MainFunction_Core2
    CPT_ASW_CORE2 (RteSwComponentInstance): RteSoftwareComponentInstanceRef=CPT_ASW_CORE2
      TimingEvent_0 (RteEventToTaskMapping): RtePositionInTask=1, RteActivationOffset=0.0, RteMappedToTaskRef=Core2_OsTask_ASW_10ms, RteEventRef=TimingEvent_0
