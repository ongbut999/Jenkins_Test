AUTOSAR XML (schema 4-2-2)
package /OsCfg
  module config OsCfg: definition=Os
    3 x OsApplication, all with OsTrusted=true, OsTrustedApplicationDelayTimingViolationCall=false, OsTrustedApplicationWithProtection=false:
      OsApplication_Core0: OsAppEcucPartitionRef=EcucPartition_Core0, OsAppTaskRef=OsTask_ASW_100ms, OsAppTaskRef=OsTask_ASW_10ms, OsAppTaskRef=OsTask_BSW_1ms, OsAppTaskRef=OsTask_BSW_10ms, OsAppTaskRef=BSW_OsTask_SwcRequest, OsApplicationCoreRef=EcucCore0
        OsApplicationHooks_0 (OsApplicationHooks)
      OsApplication_Core1: OsAppEcucPartitionRef=EcucPartition_Core1, OsAppTaskRef=Core1_OsTask_ASW_10ms, OsApplicationCoreRef=EcucCore1, OsAppTaskRef=Core1_OsTask_BSW_10ms
      OsApplication_Core2: OsAppEcucPartitionRef=EcucPartition_Core2, OsApplicationCoreRef=EcucCore2, OsAppTaskRef=Core2_OsTask_ASW_10ms, OsAppTaskRef=Core2_OsTask_BSW_10ms
