AUTOSAR XML (schema 4-2-2)
package /OsCfg
  module config OsCfg: definition=Os
    OSDEFAULTAPPMODE (OsAppMode)
    3 x OsTask, all with OsTaskActivation=1, OsTaskSchedule=FULL, OsTaskAccessingApplication=OsApplication_Core0:
      OsTask_ASW_10ms: OsTaskPriority=9
      OsTask_BSW_10ms: OsTaskPriority=12
      OsTask_BSW_1ms: OsTaskPriority=13
    OsCounter:
      OsCounterMaxAllowedValue = 65535
      OsCounterMinCycle = 1
      OsCounterTicksPerBase = 1
      OsCounterType = SOFTWARE
      OsSecondsPerTick = 0.001
      OsCounterAccessingApplication = OsApplication_Core0
    3 x OsTask, all with OsTaskActivation=1, OsTaskSchedule=FULL:
      OsTask_ASW_100ms: OsTaskPriority=6, OsTaskAccessingApplication=OsApplication_Core0
      BSW_OsTask_SwcRequest: OsTaskPriority=14, OsTaskAccessingApplication=OsApplication_Core0
      Core1_OsTask_ASW_10ms: OsTaskPriority=8, OsTaskAccessingApplication=OsApplication_Core1
    OsOS:
      OsUseResScheduler = true
      OsSuppressVectorGen = false
      OsNumberOfCores = 3
      OsScalabilityClass = SC1
      OsStackMonitoring = false
      OsStatus = STANDARD
      OsUseGetServiceId = false
      OsUseParameterAccess = false
      OsHooks_0 (OsHooks): OsStackFaultHook=0, OsStartupHook=true, OsErrorHook=true, OsPostTaskHook=false, OsPreTaskHook=false, OsProtectionHook=true, OsShutdownHook=true
    3 x OsTask, all with OsTaskActivation=1, OsTaskSchedule=FULL:
      Core1_OsTask_BSW_10ms: OsTaskPriority=11, OsTaskAccessingApplication=OsApplication_Core1
      Core2_OsTask_ASW_10ms: OsTaskPriority=7
      Core2_OsTask_BSW_10ms: OsTaskPriority=10
