AUTOSAR XML (schema 4-2-2)
package /Can
  module config Can: implementation-config-variant=VARIANT-PRE-COMPILE
    CanGeneral:
      CanMainFunctionBusoffPeriod = 0.0010
      CanMainFunctionModePeriod = 0.0010
      CanMultiplexedTransmission = false
      CanVersionInfoApi = false
      CanIndex = 0
      CanPublicIcomSupport = false
      CanTimeoutDuration = 1
      CanDevErrorDetection = false
    CanConfigSet
      Can_Network_CANNODE_0 (CanController):
        CanBusoffProcessing = POLLING
        CanControllerActivation = true
        CanControllerBaseAddress = 0
        CanTxProcessing = POLLING
        CanWakeupFunctionalityAPI = false
        CanWakeupProcessing = POLLING
        CanWakeupSupport = false
        CanControllerId = 0
        CanRxProcessing = POLLING
        CanControllerDefaultBaudrate = Can_Network_CANNODE_0/Can_Network_CANNODE_0
        Can_Network_CANNODE_0 (CanControllerBaudrateConfig):
          CanControllerBaudRate = 500
          CanControllerBaudRateConfigID = 1
          CanControllerPropSeg = 1
          CanControllerSeg1 = 12
          CanControllerSeg2 = 6
          CanControllerSyncJumpWidth = 1
      Can_Network_CANNODE_1 (CanController):
        CanBusoffProcessing = POLLING
        CanControllerActivation = true
        CanControllerBaseAddress = 0
        CanTxProcessing = POLLING
        CanWakeupFunctionalityAPI = false
        CanWakeupProcessing = POLLING
        CanWakeupSupport = false
        CanControllerId = 1
        CanRxProcessing = POLLING
        CanControllerDefaultBaudrate = Can_Network_CANNODE_1/Can_Network_CANNODE_1
        Can_Network_CANNODE_1 (CanControllerBaudrateConfig):
          CanControllerBaudRate = 500
          CanControllerBaudRateConfigID = 1
          CanControllerPropSeg = 1
          CanControllerSeg1 = 3
          CanControllerSeg2 = 3
          CanControllerSyncJumpWidth = 1
      20 x CanHardwareObject, all with CanHwObjectCount=1, CanHandleType=FULL, CanIdType=STANDARD:
        Can_Network_CANNODE_0_Rx_Std_MailBox_1: CanObjectType=RECEIVE, CanObjectId=0, CanControllerRef=CanConfigSet/Can_Network_CANNODE_0
          CanHwFilter: CanHwFilterCode=129, CanHwFilterMask=2047
        Can_Network_CANNODE_0_Rx_Std_MailBox_2: CanObjectType=RECEIVE, CanObjectId=1, CanControllerRef=CanConfigSet/Can_Network_CANNODE_0
          CanHwFilter: CanHwFilterCode=609, CanHwFilterMask=2047
        Can_Network_CANNODE_0_Rx_Std_MailBox_3: CanObjectType=RECEIVE, CanObjectId=2, CanControllerRef=CanConfigSet/Can_Network_CANNODE_0
          CanHwFilter: CanHwFilterCode=2015, CanHwFilterMask=2047
        Can_Network_CANNODE_0_Rx_Std_MailBox_4: CanObjectType=RECEIVE, CanObjectId=3, CanControllerRef=CanConfigSet/Can_Network_CANNODE_0
          CanHwFilter: CanHwFilterCode=1856, CanHwFilterMask=2047
        Can_Network_CANNODE_0_Rx_Std_MailBox_5: CanObjectType=RECEIVE, CanObjectId=4, CanControllerRef=CanConfigSet/Can_Network_CANNODE_0
          CanHwFilter: CanHwFilterCode=1536, CanHwFilterMask=2047
        Can_Network_CANNODE_0_Rx_Std_MailBox_6: CanObjectType=RECEIVE, CanObjectId=5, CanControllerRef=CanConfigSet/Can_Network_CANNODE_0
          CanHwFilter: CanHwFilterCode=614, CanHwFilterMask=2047
        Can_Network_CANNODE_0_Rx_Std_MailBox_7: CanObjectType=RECEIVE, CanObjectId=6, CanControllerRef=CanConfigSet/Can_Network_CANNODE_0
          CanHwFilter: CanHwFilterCode=631, CanHwFilterMask=2047
        Can_Network_CANNODE_0_Rx_Std_MailBox_8: CanObjectType=RECEIVE, CanObjectId=7, CanControllerRef=CanConfigSet/Can_Network_CANNODE_0
          CanHwFilter: CanHwFilterCode=648, CanHwFilterMask=2047
        Can_Network_CANNODE_0_Tx_Std_MailBox_1: CanObjectType=TRANSMIT, CanObjectId=10, CanControllerRef=CanConfigSet/Can_Network_CANNODE_0
        Can_Network_CANNODE_0_Tx_Std_MailBox_2: CanObjectType=TRANSMIT, CanObjectId=11, CanControllerRef=CanConfigSet/Can_Network_CANNODE_0
        Can_Network_CANNODE_0_Tx_Std_MailBox_3: CanObjectType=TRANSMIT, CanObjectId=12, CanControllerRef=CanConfigSet/Can_Network_CANNODE_0
        Can_Network_CANNODE_0_Tx_Std_MailBox_4: CanObjectType=TRANSMIT, CanObjectId=13, CanControllerRef=CanConfigSet/Can_Network_CANNODE_0
        Can_Network_CANNODE_0_Tx_Std_MailBox_5: CanObjectType=TRANSMIT, CanObjectId=14, CanControllerRef=CanConfigSet/Can_Network_CANNODE_0
        Can_Network_CANNODE_0_Tx_Std_MailBox_6: CanObjectType=TRANSMIT, CanObjectId=15, CanControllerRef=CanConfigSet/Can_Network_CANNODE_0
        Can_Network_CANNODE_1_Rx_Std_MailBox_1: CanObjectType=RECEIVE, CanObjectId=8, CanControllerRef=CanConfigSet/Can_Network_CANNODE_1
          CanHwFilter: CanHwFilterCode=819, CanHwFilterMask=2047
        Can_Network_CANNODE_1_Rx_Std_MailBox_2: CanObjectType=RECEIVE, CanObjectId=9, CanControllerRef=CanConfigSet/Can_Network_CANNODE_1
          CanHwFilter: CanHwFilterCode=818, CanHwFilterMask=2047
        Can_Network_CANNODE_1_Tx_Std_MailBox_1: CanObjectType=TRANSMIT, CanObjectId=16, CanControllerRef=CanConfigSet/Can_Network_CANNODE_1
        Can_Network_CANNODE_1_Tx_Std_MailBox_2: CanObjectType=TRANSMIT, CanObjectId=17, CanControllerRef=CanConfigSet/Can_Network_CANNODE_1
        Can_Network_CANNODE_1_Tx_Std_MailBox_3: CanObjectType=TRANSMIT, CanObjectId=18, CanControllerRef=CanConfigSet/Can_Network_CANNODE_1
        Can_Network_CANNODE_1_Tx_Std_MailBox_4: CanObjectType=TRANSMIT, CanObjectId=19, CanControllerRef=CanConfigSet/Can_Network_CANNODE_1
