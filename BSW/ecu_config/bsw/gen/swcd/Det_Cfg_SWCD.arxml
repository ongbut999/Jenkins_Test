AUTOSAR XML (schema 4-2-2)
package /AUTOSAR_Det/SwComponentTypes
  service sw component type Det
    behavior IntBeh_Det
      runnable Det_ReportError: can-be-invoked-concurrently=true
      runnable Det_ReportRuntimeError: can-be-invoked-concurrently=true
      runnable Det_ReportTransientFault: can-be-invoked-concurrently=true
package /AUTOSAR_Det/SwcImplementations
  swc implementation Impl_Det: programming-language=C, sw-version=5.0.0, vendor-id=6, behavior=IntBeh_Det
    code-descriptors:
      code CodeDescr_Det: artifact-descriptors=autosar-engineering-object={short-label=Code_0, category=SWSRC}
package /AUTOSAR_Det/PortInterfaces
  client server interface DETService: is-service=true
    operation ReportError: possible-error=E_OK
      arg InstanceId: type=uint8, direction=IN
      arg ApiId: type=uint8, direction=IN
      arg ErrorId: type=uint8, direction=IN
    operation ReportRuntimeError: possible-error=E_OK
      arg InstanceId: type=uint8, direction=IN
      arg ApiId: type=uint8, direction=IN
      arg ErrorId: type=uint8, direction=IN
    operation ReportTransientFault: possible-error=E_OK
      arg InstanceId: type=uint8, direction=IN
      arg ApiId: type=uint8, direction=IN
      arg FaultId: type=uint8, direction=IN
    error E_OK: error-code=0
