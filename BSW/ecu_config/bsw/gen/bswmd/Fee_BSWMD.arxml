AUTOSAR XML (schema 4-2-2)
package /AUTOSAR_Fee/ApplicationDataTypes
  app type Fee_DataTypeSctCngCnt_u32: category=VALUE, sw-calibration-access=READ-ONLY, compu-method=Identical, range phys 0..16777216 Fee_NoUnit, display-format=%5.1f  # Primitive uint32 as an application data type for Sector Change Counter
package /AUTOSAR_Fee/BswImplementations
  bsw implementation Fee: programming-language=C, sw-version=9.0.0, ar-release-version=4.0.3, behavior=BswInternalBehavior
    code-descriptors:
      code CodeDescriptor: artifact-descriptors=autosar-engineering-object={short-label=ArEngObj, category=SWSRC}
package /AUTOSAR_Fee/BswModuleDescriptions
  bsw module description AUTOSAR_Fee: category=BSW_MODULE  # Flash EEPROM Emulation
    bsw internal behavior BswInternalBehavior: data-type-mapping=DataTypeMappingSet
      static-memorys:
        data Fee_SecChngCnt_u32: category=VALUE, sw-addr-method=INTERNAL_VAR_CLEARED, sw-calibration-access=READ-ONLY, display-format=%5.1f, type=Fee_DataTypeSctCngCnt_u32  # Current Sector Change Counter of the Flash EEPROM Emulation
package /AUTOSAR_Fee/DataTypeMappingSets
  data type mapping set DataTypeMappingSet: data-type-map{application-data-type=Fee_DataTypeSctCngCnt_u32, implementation-data-type=uint32}
package /AUTOSAR_Fee/Units
  unit Fee_NoUnit: display-name=Fee_NoUnit, factor-si-to-unit=1.0, offset-si-to-unit=0.0, physical-dimension=Fee_NoPhysDim  # Fee No Unit
package /AUTOSAR_Fee/PhysicalDimensions
  physical dimension Fee_NoPhysDim: length-exp=0
