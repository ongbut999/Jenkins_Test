AUTOSAR XML (schema 4-2-2)
package /AUTOSAR_ComM/ApplicationDataTypes
  application array data type ComM_UserStruct_Array_App: category=ARRAY, sw-calibration-access=READ-WRITE  # Array for usermode requested by ComMUser of type uint8
    element ComM_UserStruct_Sub_App: category=STRUCTURE, type=ComM_UserStruct_App, max-number-of-elements=2
  application array data type ComM_ChannelStruct_Array_App: category=ARRAY, sw-calibration-access=READ-WRITE  # Array of channel structure
    element ComM_ChannelStruct_Sub_App: category=STRUCTURE, type=ComM_ChannelStruct_App, max-number-of-elements=2
  app type ComM_uint8_App: category=VALUE, sw-calibration-access=READ-WRITE, compu-method=Identical, range phys 0..255, display-format=%5.0f  # uint8 application datatype in ComM
  app type ComM_boolean_App: category=VALUE, sw-calibration-access=READ-WRITE, compu-method=Identical, range phys 0..255, display-format=%5.0f  # boolean application datatype in ComM
  application record data type ComM_ChannelStruct_App: category=STRUCTURE, sw-calibration-access=READ-WRITE  # Structure containing all channel related parameters
    15 x application record element, all with category=VALUE:
      ChannelState_e: type=ComM_uint32_App
      LightTimeoutCtr_u32: type=ComM_uint32_App
      MinFullComTimeoutCtr_u16: type=ComM_unit16_App
      ChannelMode_u8: type=ComM_uint8_App
      BusSmMode_u8: type=ComM_uint8_App
      UserRequestCtr_u8: type=ComM_uint8_App
      PassiveRequestState_u8: type=ComM_uint8_App
      PncRequestCtr_u8: type=ComM_uint8_App
      InhibitionReqStatus_u8: type=ComM_uint8_App
      NmNetworkRequestStatus_b: type=ComM_boolean_App
      DiagnosticRequestState_b: type=ComM_boolean_App
      CommunicationAllowed_b: type=ComM_boolean_App
      NmBusSleepIndicationStatus_b: type=ComM_boolean_App
      NmPrepareBusSleepIndicationStatus_b: type=ComM_boolean_App
      NmNetworkModeStatus_b: type=ComM_boolean_App
  app type ComM_unit16_App: category=VALUE, sw-calibration-access=READ-WRITE, compu-method=Identical, range phys 0..65535, display-format=%5.0f  # uint16 application data type in ComM
  app type ComM_uint32_App: category=VALUE, sw-calibration-access=READ-WRITE, compu-method=Identical, range phys 0..4294967295, display-format=%5.0f  # application data type for uint32 in ComM
  application record data type ComM_UserStruct_App: category=STRUCTURE, sw-calibration-access=READ-WRITE  # Structure containing all user related parameters
    7 x application record element, all with category=VALUE:
      WakeUpInhibitionCtr_u16: type=ComM_unit16_App
      LimitToNoComCtr_u16: type=ComM_unit16_App
      RequestedUserMode_t: type=ComM_uint8_App
      IndicatedUserMode_t: type=ComM_uint8_App
      numChannelsInFullCom_u8: type=ComM_uint8_App
      numChannelsInSilentCom_u8: type=ComM_uint8_App
      numChannelsInNoCom_u8: type=ComM_uint8_App
package /AUTOSAR_ComM/BswImplementations
  bsw implementation ComM: programming-language=C, sw-version=8.0.0, ar-release-version=4.2.2, behavior=BswInternalBehavior, vendor-specific-module-def=ComM
    code-descriptors:
      code CodeDescriptor: artifact-descriptors=autosar-engineering-object={short-label=ArEngObj, category=SWSRC}
package /AUTOSAR_ComM/BswModuleDescriptions
  bsw module description ComM
    bsw internal behavior BswInternalBehavior: data-type-mapping=DataTypeMappingSet
      static-memorys:
        data ComM_UserStruct: category=ARRAY, sw-addr-method=INTERNAL_VAR_CLEARED, sw-calibration-access=READ-ONLY, type=ComM_UserStruct_Array_App  # ComM user structure
        data ComM_ChannelStruct: category=ARRAY, sw-addr-method=INTERNAL_VAR_CLEARED, sw-calibration-access=READ-ONLY, type=ComM_ChannelStruct_Array_App  # ComM Channel structure
      bsw schedulable entity BSWSE_MainFunction_ComMChannel_Can_Network_Channel: implemented-entry=ComM_MainFunction_ComMChannel_Can_Network_Channel
      bsw schedulable entity BSWSE_MainFunction_ComMChannel_Can_Network_XCP_Channel: implemented-entry=ComM_MainFunction_ComMChannel_Can_Network_XCP_Channel
      bsw timing event EV_BSWSE_MainFunction_ComMChannel_Can_Network_Channel: starts-on-event=BSWSE_MainFunction_ComMChannel_Can_Network_Channel, period=0.01
      bsw timing event EV_BSWSE_MainFunction_ComMChannel_Can_Network_XCP_Channel: starts-on-event=BSWSE_MainFunction_ComMChannel_Can_Network_XCP_Channel, period=0.01
package /AUTOSAR_ComM/DataTypeMappingSets
  data type mapping set DataTypeMappingSet
    data-type-maps:
      application-data-type=ComM_UserStruct_Array_App, implementation-data-type=ComM_UserStruct_Array_Impl
      application-data-type=ComM_ChannelStruct_Array_App, implementation-data-type=ComM_ChannelStruct_Array_Impl
      application-data-type=ComM_uint8_App, implementation-data-type=ComM_uint8_Impl
      application-data-type=ComM_boolean_App, implementation-data-type=ComM_bool_Impl
      application-data-type=ComM_ChannelStruct_App, implementation-data-type=ComM_ChannelStruct_Impl
      application-data-type=ComM_unit16_App, implementation-data-type=ComM_uint16_Impl
      application-data-type=ComM_uint32_App, implementation-data-type=ComM_uint32_Impl
      application-data-type=ComM_UserStruct_App, implementation-data-type=ComM_UserStruct_Impl
package /AUTOSAR_ComM/ImplementationDataTypes
  8 x impl type:
    ComM_UserStruct_Array_Impl: category=ARRAY  # Array for user structure
      element ComM_UserStruct_Sub_impl: array-size=2, array-size-semantics=FIXED-SIZE, implementation-data-type=ComM_UserStruct_Impl
    ComM_ChannelStruct_Array_Impl: category=ARRAY  # Array of channel structure
      element ComM_ChannelStruct_Sub_Impl: array-size=2, array-size-semantics=FIXED-SIZE, implementation-data-type=ComM_ChannelStruct_Impl
    ComM_bool_Impl: implementation-data-type=uint8  # implementation data type for application data type boolean
    ComM_ChannelStruct_Impl: category=STRUCTURE  # Structure containing all channel related parameters
      15 x element, all with category=TYPE_REFERENCE:
        ChannelState_e: implementation-data-type=ComM_uint32_Impl
        LightTimeoutCtr_u32: implementation-data-type=ComM_uint32_Impl
        MinFullComTimeoutCtr_u16: implementation-data-type=ComM_uint16_Impl
        ChannelMode_u8: implementation-data-type=ComM_uint8_Impl
        BusSmMode_u8: implementation-data-type=ComM_uint8_Impl
        UserRequestCtr_u8: implementation-data-type=ComM_uint8_Impl
        PassiveRequestState_u8: implementation-data-type=ComM_uint8_Impl
        PncRequestCtr_u8: implementation-data-type=ComM_uint8_Impl
        InhibitionReqStatus_u8: implementation-data-type=ComM_uint8_Impl
        NmNetworkRequestStatus_b: implementation-data-type=ComM_bool_Impl
        DiagnosticRequestState_b: implementation-data-type=ComM_bool_Impl
        CommunicationAllowed_b: implementation-data-type=ComM_bool_Impl
        NmBusSleepIndicationStatus_b: implementation-data-type=ComM_bool_Impl
        NmPrepareBusSleepIndicationStatus_b: implementation-data-type=ComM_bool_Impl
        NmNetworkModeStatus_b: implementation-data-type=ComM_bool_Impl
    ComM_uint8_Impl: implementation-data-type=uint8  # Implementation data type for uint8
    ComM_uint16_Impl: implementation-data-type=uint16  # Implementation datatype for uint16
    ComM_uint32_Impl: implementation-data-type=uint32  # Implementation data type for uint32
    ComM_UserStruct_Impl: category=STRUCTURE  # Structure containing all user related data
      7 x element, all with category=TYPE_REFERENCE:
        WakeUpInhibitionCtr_u16: implementation-data-type=ComM_uint16_Impl
        LimitToNoComCtr_u16: implementation-data-type=ComM_uint16_Impl
        RequestedUserMode_t: implementation-data-type=ComM_uint8_Impl
        IndicatedUserMode_t: implementation-data-type=ComM_uint8_Impl
        numChannelsInFullCom_u8: implementation-data-type=ComM_uint8_Impl
        numChannelsInSilentCom_u8: implementation-data-type=ComM_uint8_Impl
        numChannelsInNoCom_u8: implementation-data-type=ComM_uint8_Impl
package /AUTOSAR_ComM/Units
  unit NoUnit: display-name=noUnit, factor-si-to-unit=1.0, offset-si-to-unit=0.0, physical-dimension=NoUnit  # No Unit
package /AUTOSAR_ComM/PhysicalDimensions
  physical dimension NoUnit: length-exp=0
