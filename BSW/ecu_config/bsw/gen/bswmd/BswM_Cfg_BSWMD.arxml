AUTOSAR XML (schema 4-2-2)
package /AUTOSAR_BswM/BswModuleEntrys
  24 x bsw module entry, all with sw-service-impl-policy=STANDARD:
    BswM_Deinit: service-id=0x04, is-reentrant=false, is-synchronous=true, call-type=REGULAR, execution-context=TASK  # API to Deinitialize the BSW Mode Manager | Function call to deinitialize the BSW Mode Manager | After execution of this routine no mode processing shall be performed by BswM even if any mode requests are made or the BswM main function is called.
    BswM_Init: service-id=0x00, is-reentrant=false, is-synchronous=true, call-type=REGULAR, execution-context=TASK  # API to Initialize the BSW Mode Manager | Function call to Initialize the BSW Mode Manager | This API will initialise the BSW Mode Manager module by intializing the global variables with the data provided by the configuration pointer.
      sw service arg ConfigPtr: category=DATA_REFERENCE, direction=INOUT, sw-impl-policy=CONST, sw-pointer-target-props={target-category=VALUE, implementation-data-type=BswM_ConfigType}  # Pointer to post-build configuration data
    BswM_GetVersionInfo: service-id=0x01, is-reentrant=true, is-synchronous=true, call-type=REGULAR, execution-context=TASK  # API to Return the version information of BswM module | Returns the version information of BswM module | This API will return the version information of BswM module
      sw service arg VersionInfo: category=DATA_REFERENCE, direction=INOUT, sw-pointer-target-props={target-category=VALUE, implementation-data-type=Std_VersionInfoType}  # Pointer to where to store the version information of the module
    BswM_RequestMode: service-id=0x02, is-reentrant=true, is-synchronous=true, call-type=REGULAR, execution-context=TASK  # API to sevice Generic Request. | Generic function call to request modes. This function shall only be used by other BSW modules that does not have a specific mode request interface. | The corresponding configuration container for this API is BswMGenericRequest, i.e. this mode request originates from a requester that is not among the list of standardized mode requesters.
      sw service arg Requesting_user: direction=IN, implementation-data-type=BswM_UserType  # The user that requests the mode.
      sw service arg Requested_mode: direction=IN, implementation-data-type=BswM_ModeType  # The requested mode.
    BswM_MainFunction: is-synchronous=false, call-type=SCHEDULED, execution-context=TASK
    BswM_Cfg_ImdtBswNotification_BswM_MRP_DCM_DiagnosticSessionControl_DEFAULT_SESSION: is-reentrant=true, is-synchronous=true, call-type=SCHEDULED, execution-context=TASK
    BswM_Cfg_ImdtBswNotification_BswM_MRP_DCM_DiagnosticSessionControl_EXTENDED_DIAGNOSTIC_SESSION: is-reentrant=true, is-synchronous=true, call-type=SCHEDULED, execution-context=TASK
    BswM_Cfg_ImdtBswNotification_BswM_MRP_DCM_DiagnosticSessionControl_PROGRAMMING_SESSION: is-reentrant=true, is-synchronous=true, call-type=SCHEDULED, execution-context=TASK
    BswM_Cfg_ImdtBswNotification_BswM_MRP_DCM_DiagnosticSessionControl_JUMPTOBOOTLOADER: is-reentrant=true, is-synchronous=true, call-type=SCHEDULED, execution-context=TASK
    BswM_Cfg_DfrdBswNotification_BswM_MRP_BswM_MDG_ECUM_STATE_STARTUP_ONE: is-reentrant=true, is-synchronous=true, call-type=SCHEDULED, execution-context=TASK
    BswM_Cfg_DfrdBswNotification_BswM_MRP_BswM_MDG_ECUM_STATE_STARTUP_TWO: is-reentrant=true, is-synchronous=true, call-type=SCHEDULED, execution-context=TASK
    BswM_Cfg_DfrdBswNotification_BswM_MRP_BswM_MDG_ECUM_STATE_RUN: is-reentrant=true, is-synchronous=true, call-type=SCHEDULED, execution-context=TASK
    BswM_Cfg_DfrdBswNotification_BswM_MRP_BswM_MDG_ECUM_STATE_PREP_SHUTDOWN: is-reentrant=true, is-synchronous=true, call-type=SCHEDULED, execution-context=TASK
    BswM_Cfg_DfrdBswNotification_BswM_MRP_BswM_MDG_ECUM_STATE_SHUTDOWN: is-reentrant=true, is-synchronous=true, call-type=SCHEDULED, execution-context=TASK
    BswM_Cfg_DfrdBswNotification_BswM_MRP_BswM_MDG_ECUM_STATE_APP_RUN: is-reentrant=true, is-synchronous=true, call-type=SCHEDULED, execution-context=TASK
    BswM_Cfg_DfrdBswNotification_BswM_MRP_DCM_ModeNotification_EcuReset_EXECUTE: is-reentrant=true, is-synchronous=true, call-type=SCHEDULED, execution-context=TASK
    BswM_Cfg_DfrdBswNotification_BswM_MRP_DCM_ModeNotification_EcuReset_SOFT: is-reentrant=true, is-synchronous=true, call-type=SCHEDULED, execution-context=TASK
    BswM_Cfg_AC_SchMSwitch_0_BswMAction_SwitchAppMode_Dummy: is-reentrant=true, is-synchronous=true, call-type=REGULAR, execution-context=UNSPECIFIED
    BswM_Cfg_AC_SchMSwitch_1_BswM_AI_BswMSwitchAppRun: is-reentrant=true, is-synchronous=true, call-type=REGULAR, execution-context=UNSPECIFIED
    BswM_Cfg_AC_SchMSwitch_2_BswM_AI_BswMSwitchPostRun: is-reentrant=true, is-synchronous=true, call-type=REGULAR, execution-context=UNSPECIFIED
    BswM_Cfg_AC_SchMSwitch_3_BswM_AI_BswMSwitchPrepShutdown: is-reentrant=true, is-synchronous=true, call-type=REGULAR, execution-context=UNSPECIFIED
    BswM_Cfg_AC_SchMSwitch_4_BswM_AI_BswMSwitchRun: is-reentrant=true, is-synchronous=true, call-type=REGULAR, execution-context=UNSPECIFIED
    BswM_Cfg_AC_SchMSwitch_5_BswM_AI_BswMSwitchShutdown: is-reentrant=true, is-synchronous=true, call-type=REGULAR, execution-context=UNSPECIFIED
    BswM_Cfg_AC_SchMSwitch_6_BswM_AI_BswMSwitchStartupTwo: is-reentrant=true, is-synchronous=true, call-type=REGULAR, execution-context=UNSPECIFIED
package /AUTOSAR_BswM/ImplementationDataTypes
  impl type BswM_ConfigType: category=STRUCTURE, type-emitter=HEADER_FILE
    element dataVersionInfo_st: implementation-data-type=Std_VersionInfoType
  impl type BswM_ModeType: implementation-data-type=uint16
  impl type BswM_UserType: implementation-data-type=uint16
package /AUTOSAR_BswM/BswModuleDescriptions
  bsw module description BswM: category=BSW_MODULE, module-id=42
    provided-entrys:
      BswM_MainFunction
      BswM_Init
      BswM_Deinit
      BswM_GetVersionInfo
      BswM_RequestMode
      BswM_Cfg_ImdtBswNotification_BswM_MRP_DCM_DiagnosticSessionControl_DEFAULT_SESSION
      BswM_Cfg_ImdtBswNotification_BswM_MRP_DCM_DiagnosticSessionControl_EXTENDED_DIAGNOSTIC_SESSION
      BswM_Cfg_ImdtBswNotification_BswM_MRP_DCM_DiagnosticSessionControl_PROGRAMMING_SESSION
      BswM_Cfg_ImdtBswNotification_BswM_MRP_DCM_DiagnosticSessionControl_JUMPTOBOOTLOADER
      BswM_Cfg_DfrdBswNotification_BswM_MRP_BswM_MDG_ECUM_STATE_STARTUP_ONE
      BswM_Cfg_DfrdBswNotification_BswM_MRP_BswM_MDG_ECUM_STATE_STARTUP_TWO
      BswM_Cfg_DfrdBswNotification_BswM_MRP_BswM_MDG_ECUM_STATE_RUN
      BswM_Cfg_DfrdBswNotification_BswM_MRP_BswM_MDG_ECUM_STATE_PREP_SHUTDOWN
      BswM_Cfg_DfrdBswNotification_BswM_MRP_BswM_MDG_ECUM_STATE_SHUTDOWN
      BswM_Cfg_DfrdBswNotification_BswM_MRP_BswM_MDG_ECUM_STATE_APP_RUN
      BswM_Cfg_DfrdBswNotification_BswM_MRP_DCM_ModeNotification_EcuReset_EXECUTE
      BswM_Cfg_DfrdBswNotification_BswM_MRP_DCM_ModeNotification_EcuReset_SOFT
      BswM_Cfg_AC_SchMSwitch_0_BswMAction_SwitchAppMode_Dummy
      BswM_Cfg_AC_SchMSwitch_1_BswM_AI_BswMSwitchAppRun
      BswM_Cfg_AC_SchMSwitch_2_BswM_AI_BswMSwitchPostRun
      BswM_Cfg_AC_SchMSwitch_3_BswM_AI_BswMSwitchPrepShutdown
      BswM_Cfg_AC_SchMSwitch_4_BswM_AI_BswMSwitchRun
      BswM_Cfg_AC_SchMSwitch_5_BswM_AI_BswMSwitchShutdown
      BswM_Cfg_AC_SchMSwitch_6_BswM_AI_BswMSwitchStartupTwo
    provided-mode-groups:
      mode declaration group prototype MDGP_MDG_App_Mode_MDG_App_Mode: type=MDG_App_Mode
      mode declaration group prototype MDGP_AUTOSAR_BswM_ModeDeclarationGroups_MDG_ECUM_STATE: type=MDG_ECUM_STATE
    required-mode-groups:
      mode declaration group prototype MDGR_BswM_MRP_BswM_MDG: type=MDG_ECUM_STATE
      mode declaration group prototype MDGR_BswM_MRP_DCM_DiagnosticSessionControl: type=DcmDiagnosticSessionControl
      mode declaration group prototype MDGR_BswM_MRP_DCM_ModeNotification_EcuReset: type=DcmEcuReset
    bsw internal behavior IB_BswM: data-type-mapping=[ECUM_STATE_Mapping, AppMode_Mapping, ComMModeMapping, DTS_DcmEcuReset, DTS_DcmDiagnosticSessionControl]
      13 x bsw schedulable entity:
        SE_BswM_MainFunction: implemented-entry=BswM_MainFunction
        SE_BswM_Cfg_ImdtBswNotification_BswM_MRP_DCM_DiagnosticSessionControl_DEFAULT_SESSION: accessed-mode-groups=MDGR_BswM_MRP_DCM_DiagnosticSessionControl, implemented-entry=BswM_Cfg_ImdtBswNotification_BswM_MRP_DCM_DiagnosticSessionControl_DEFAULT_SESSION
        SE_BswM_Cfg_ImdtBswNotification_BswM_MRP_DCM_DiagnosticSessionControl_EXTENDED_DIAGNOSTIC_SESSION: accessed-mode-groups=MDGR_BswM_MRP_DCM_DiagnosticSessionControl, implemented-entry=BswM_Cfg_ImdtBswNotification_BswM_MRP_DCM_DiagnosticSessionControl_EXTENDED_DIAGNOSTIC_SESSION
        SE_BswM_Cfg_ImdtBswNotification_BswM_MRP_DCM_DiagnosticSessionControl_PROGRAMMING_SESSION: accessed-mode-groups=MDGR_BswM_MRP_DCM_DiagnosticSessionControl, implemented-entry=BswM_Cfg_ImdtBswNotification_BswM_MRP_DCM_DiagnosticSessionControl_PROGRAMMING_SESSION
        SE_BswM_Cfg_ImdtBswNotification_BswM_MRP_DCM_DiagnosticSessionControl_JUMPTOBOOTLOADER: accessed-mode-groups=MDGR_BswM_MRP_DCM_DiagnosticSessionControl, implemented-entry=BswM_Cfg_ImdtBswNotification_BswM_MRP_DCM_DiagnosticSessionControl_JUMPTOBOOTLOADER
        SE_BswM_Cfg_DfrdBswNotification_BswM_MRP_BswM_MDG_ECUM_STATE_STARTUP_ONE: accessed-mode-groups=MDGR_BswM_MRP_BswM_MDG, implemented-entry=BswM_Cfg_DfrdBswNotification_BswM_MRP_BswM_MDG_ECUM_STATE_STARTUP_ONE
        SE_BswM_Cfg_DfrdBswNotification_BswM_MRP_BswM_MDG_ECUM_STATE_STARTUP_TWO: accessed-mode-groups=MDGR_BswM_MRP_BswM_MDG, implemented-entry=BswM_Cfg_DfrdBswNotification_BswM_MRP_BswM_MDG_ECUM_STATE_STARTUP_TWO
        SE_BswM_Cfg_DfrdBswNotification_BswM_MRP_BswM_MDG_ECUM_STATE_RUN: accessed-mode-groups=MDGR_BswM_MRP_BswM_MDG, implemented-entry=BswM_Cfg_DfrdBswNotification_BswM_MRP_BswM_MDG_ECUM_STATE_RUN
        SE_BswM_Cfg_DfrdBswNotification_BswM_MRP_BswM_MDG_ECUM_STATE_PREP_SHUTDOWN: accessed-mode-groups=MDGR_BswM_MRP_BswM_MDG, implemented-entry=BswM_Cfg_DfrdBswNotification_BswM_MRP_BswM_MDG_ECUM_STATE_PREP_SHUTDOWN
        SE_BswM_Cfg_DfrdBswNotification_BswM_MRP_BswM_MDG_ECUM_STATE_SHUTDOWN: accessed-mode-groups=MDGR_BswM_MRP_BswM_MDG, implemented-entry=BswM_Cfg_DfrdBswNotification_BswM_MRP_BswM_MDG_ECUM_STATE_SHUTDOWN
        SE_BswM_Cfg_DfrdBswNotification_BswM_MRP_BswM_MDG_ECUM_STATE_APP_RUN: accessed-mode-groups=MDGR_BswM_MRP_BswM_MDG, implemented-entry=BswM_Cfg_DfrdBswNotification_BswM_MRP_BswM_MDG_ECUM_STATE_APP_RUN
        SE_BswM_Cfg_DfrdBswNotification_BswM_MRP_DCM_ModeNotification_EcuReset_EXECUTE: accessed-mode-groups=MDGR_BswM_MRP_DCM_ModeNotification_EcuReset, implemented-entry=BswM_Cfg_DfrdBswNotification_BswM_MRP_DCM_ModeNotification_EcuReset_EXECUTE
        SE_BswM_Cfg_DfrdBswNotification_BswM_MRP_DCM_ModeNotification_EcuReset_SOFT: accessed-mode-groups=MDGR_BswM_MRP_DCM_ModeNotification_EcuReset, implemented-entry=BswM_Cfg_DfrdBswNotification_BswM_MRP_DCM_ModeNotification_EcuReset_SOFT
      7 x bsw called entity:
        CE_BswM_Action_BswMAction_SwitchAppMode_Dummy: implemented-entry=BswM_Cfg_AC_SchMSwitch_0_BswMAction_SwitchAppMode_Dummy, managed-mode-groups=MDGP_MDG_App_Mode_MDG_App_Mode
        CE_BswM_Action_BswM_AI_BswMSwitchAppRun: implemented-entry=BswM_Cfg_AC_SchMSwitch_1_BswM_AI_BswMSwitchAppRun, managed-mode-groups=MDGP_AUTOSAR_BswM_ModeDeclarationGroups_MDG_ECUM_STATE
        CE_BswM_Action_BswM_AI_BswMSwitchPostRun: implemented-entry=BswM_Cfg_AC_SchMSwitch_2_BswM_AI_BswMSwitchPostRun, managed-mode-groups=MDGP_AUTOSAR_BswM_ModeDeclarationGroups_MDG_ECUM_STATE
        CE_BswM_Action_BswM_AI_BswMSwitchPrepShutdown: implemented-entry=BswM_Cfg_AC_SchMSwitch_3_BswM_AI_BswMSwitchPrepShutdown, managed-mode-groups=MDGP_AUTOSAR_BswM_ModeDeclarationGroups_MDG_ECUM_STATE
        CE_BswM_Action_BswM_AI_BswMSwitchRun: implemented-entry=BswM_Cfg_AC_SchMSwitch_4_BswM_AI_BswMSwitchRun, managed-mode-groups=MDGP_AUTOSAR_BswM_ModeDeclarationGroups_MDG_ECUM_STATE
        CE_BswM_Action_BswM_AI_BswMSwitchShutdown: implemented-entry=BswM_Cfg_AC_SchMSwitch_5_BswM_AI_BswMSwitchShutdown, managed-mode-groups=MDGP_AUTOSAR_BswM_ModeDeclarationGroups_MDG_ECUM_STATE
        CE_BswM_Action_BswM_AI_BswMSwitchStartupTwo: implemented-entry=BswM_Cfg_AC_SchMSwitch_6_BswM_AI_BswMSwitchStartupTwo, managed-mode-groups=MDGP_AUTOSAR_BswM_ModeDeclarationGroups_MDG_ECUM_STATE
      bsw timing event TE_BswM_MainFunction: starts-on-event=SE_BswM_MainFunction, period=0.01
      12 x bsw mode switch event, all with activation=ON-ENTRY:
        MSE_BswM_Cfg_ImdtBswNotification_BswM_MRP_DCM_DiagnosticSessionControl_DEFAULT_SESSION: starts-on-event=SE_BswM_Cfg_ImdtBswNotification_BswM_MRP_DCM_DiagnosticSessionControl_DEFAULT_SESSION, mode=MDGR_BswM_MRP_DCM_DiagnosticSessionControl.DEFAULT_SESSION
        MSE_BswM_Cfg_ImdtBswNotification_BswM_MRP_DCM_DiagnosticSessionControl_EXTENDED_DIAGNOSTIC_SESSION: starts-on-event=SE_BswM_Cfg_ImdtBswNotification_BswM_MRP_DCM_DiagnosticSessionControl_EXTENDED_DIAGNOSTIC_SESSION, mode=MDGR_BswM_MRP_DCM_DiagnosticSessionControl.EXTENDED_DIAGNOSTIC_SESSION
        MSE_BswM_Cfg_ImdtBswNotification_BswM_MRP_DCM_DiagnosticSessionControl_PROGRAMMING_SESSION: starts-on-event=SE_BswM_Cfg_ImdtBswNotification_BswM_MRP_DCM_DiagnosticSessionControl_PROGRAMMING_SESSION, mode=MDGR_BswM_MRP_DCM_DiagnosticSessionControl.PROGRAMMING_SESSION
        MSE_BswM_Cfg_ImdtBswNotification_BswM_MRP_DCM_DiagnosticSessionControl_JUMPTOBOOTLOADER: starts-on-event=SE_BswM_Cfg_ImdtBswNotification_BswM_MRP_DCM_DiagnosticSessionControl_JUMPTOBOOTLOADER, mode=MDGR_BswM_MRP_DCM_DiagnosticSessionControl.JUMPTOBOOTLOADER
        MSE_BswM_Cfg_DfrdBswNotification_BswM_MRP_BswM_MDG_ECUM_STATE_STARTUP_ONE: starts-on-event=SE_BswM_Cfg_DfrdBswNotification_BswM_MRP_BswM_MDG_ECUM_STATE_STARTUP_ONE, mode=MDGR_BswM_MRP_BswM_MDG.ECUM_STATE_STARTUP_ONE
        MSE_BswM_Cfg_DfrdBswNotification_BswM_MRP_BswM_MDG_ECUM_STATE_STARTUP_TWO: starts-on-event=SE_BswM_Cfg_DfrdBswNotification_BswM_MRP_BswM_MDG_ECUM_STATE_STARTUP_TWO, mode=MDGR_BswM_MRP_BswM_MDG.ECUM_STATE_STARTUP_TWO
        MSE_BswM_Cfg_DfrdBswNotification_BswM_MRP_BswM_MDG_ECUM_STATE_RUN: starts-on-event=SE_BswM_Cfg_DfrdBswNotification_BswM_MRP_BswM_MDG_ECUM_STATE_RUN, mode=MDGR_BswM_MRP_BswM_MDG.ECUM_STATE_RUN
        MSE_BswM_Cfg_DfrdBswNotification_BswM_MRP_BswM_MDG_ECUM_STATE_PREP_SHUTDOWN: starts-on-event=SE_BswM_Cfg_DfrdBswNotification_BswM_MRP_BswM_MDG_ECUM_STATE_PREP_SHUTDOWN, mode=MDGR_BswM_MRP_BswM_MDG.ECUM_STATE_PREP_SHUTDOWN
        MSE_BswM_Cfg_DfrdBswNotification_BswM_MRP_BswM_MDG_ECUM_STATE_SHUTDOWN: starts-on-event=SE_BswM_Cfg_DfrdBswNotification_BswM_MRP_BswM_MDG_ECUM_STATE_SHUTDOWN, mode=MDGR_BswM_MRP_BswM_MDG.ECUM_STATE_SHUTDOWN
        MSE_BswM_Cfg_DfrdBswNotification_BswM_MRP_BswM_MDG_ECUM_STATE_APP_RUN: starts-on-event=SE_BswM_Cfg_DfrdBswNotification_BswM_MRP_BswM_MDG_ECUM_STATE_APP_RUN, mode=MDGR_BswM_MRP_BswM_MDG.ECUM_STATE_APP_RUN
        MSE_BswM_Cfg_DfrdBswNotification_BswM_MRP_DCM_ModeNotification_EcuReset_EXECUTE: starts-on-event=SE_BswM_Cfg_DfrdBswNotification_BswM_MRP_DCM_ModeNotification_EcuReset_EXECUTE, mode=MDGR_BswM_MRP_DCM_ModeNotification_EcuReset.EXECUTE
        MSE_BswM_Cfg_DfrdBswNotification_BswM_MRP_DCM_ModeNotification_EcuReset_SOFT: starts-on-event=SE_BswM_Cfg_DfrdBswNotification_BswM_MRP_DCM_ModeNotification_EcuReset_SOFT, mode=MDGR_BswM_MRP_DCM_ModeNotification_EcuReset.SOFT
      mode-sender-policys:
        provided-mode-group=MDGP_MDG_App_Mode_MDG_App_Mode, queue-length=1
        provided-mode-group=MDGP_AUTOSAR_BswM_ModeDeclarationGroups_MDG_ECUM_STATE, queue-length=1
      mode-receiver-policys:
        required-mode-group=MDGR_BswM_MRP_BswM_MDG, supports-asynchronous-mode-switch=true
        required-mode-group=MDGR_BswM_MRP_DCM_DiagnosticSessionControl, supports-asynchronous-mode-switch=true
        required-mode-group=MDGR_BswM_MRP_DCM_ModeNotification_EcuReset, supports-asynchronous-mode-switch=true
package /AUTOSAR_BswM/BswImplementations
  bsw implementation BSWIMPL_BswM: programming-language=C, sw-version=4.0.0, ar-release-version=4.2.2, behavior=IB_BswM
    code-descriptors:
      code CodeDescriptor: artifact-descriptors=autosar-engineering-object={short-label=ArEngObj, category=SWSRC}
