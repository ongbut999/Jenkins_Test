AUTOSAR XML (schema 4-2-2)
package /AUTOSAR_Com/ApplicationDataTypes
  5 x application array data type, all with category=ARRAY, sw-calibration-access=READ-WRITE:
    Com_SigBuf_au8  # Application data type for Signals of type - uint8,sint8,boolean,uint8_n
      element Com_Subapp_u8: category=VALUE, type=Com_uint8, max-number-of-elements=11
    Com_SigBuf_au16  # Application data type for Signals of type - uint16,sint16
      element Com_Subapp_u16: category=VALUE, type=Com_uint16, max-number-of-elements=2
    Com_applDataType_au8_Size1  # Application data type for Ipdu buffer of Size1
      element Com_Subapp1: category=VALUE, type=Com_uint8, max-number-of-elements=1
    Com_applDataType_au8_Size7  # Application data type for Ipdu buffer of Size7
      element Com_Subapp7: category=VALUE, type=Com_uint8, max-number-of-elements=7
    Com_applDataType_au8_Size8  # Application data type for Ipdu buffer of Size8
      element Com_Subapp8: category=VALUE, type=Com_uint8, max-number-of-elements=8
  5 x app type, all with category=VALUE, sw-calibration-access=READ-WRITE, display-format=%5.0f:
    Com_IPduStatus_type: compu {0=INACTIVE, 1=ACTIVE} "Computation Method for ComIPdu Calibration Status", range phys 0..1  # unsigned char
    Com_uint8: compu-method=Identical, range phys 0..255  # unsigned char
    Com_uint16: compu-method=Identical, range phys 0..65535  # unsigned short
    Com_uint32: compu-method=Identical, range phys 0..4294967295  # unsigned int
    Com_uint64: compu-method=Identical, range phys 0..9.223372036854776E18  # unsigned long long
package /AUTOSAR_Com/BswImplementations
  bsw implementation Com: programming-language=C, sw-version=8.0.0, ar-release-version=4.2.2, behavior=BswInternalBehavior, vendor-specific-module-def=Com
    code-descriptors:
      code CodeDescriptor: artifact-descriptors=autosar-engineering-object={short-label=ArEngObj, category=SWSRC}
package /AUTOSAR_Com/BswModuleDescriptions
  bsw module description Com
    bsw internal behavior BswInternalBehavior: data-type-mapping=DataTypeMappingSet
      static-memorys:
        11 x data, all with category=ARRAY, sw-addr-method=INTERNAL_VAR_CLEARED, sw-calibration-access=READ-ONLY, display-format=%5.0f:
          Com_SigType_u8: type=Com_SigBuf_au8  # Measurement variable for Signals of type - uint8,sint8,boolean,uint8_n. To refer Individual element in the Buffer array, Fetch Buffer Index from Com_PBcfg.c for each signal.
          Com_SigType_u16: type=Com_SigBuf_au16  # Measurement variable for Signals of type - uint16,sint16. To refer Individual element in the Buffer array, Fetch Buffer Index from Com_PBcfg.c for each signal.
          Com_IpduBuf_MCU_01_Can_Network_CANNODE_0: type=Com_applDataType_au8_Size8  # Tx Ipdu buffer of IPdu -MCU_01_Can_Network_CANNODE_0- as a Measurement parameter
          Com_IpduBuf_MCU_02_Can_Network_CANNODE_0: type=Com_applDataType_au8_Size8  # Tx Ipdu buffer of IPdu -MCU_02_Can_Network_CANNODE_0- as a Measurement parameter
          Com_IpduBuf_MCU_03_Can_Network_CANNODE_0: type=Com_applDataType_au8_Size7  # Tx Ipdu buffer of IPdu -MCU_03_Can_Network_CANNODE_0- as a Measurement parameter
          Com_IpduBuf_MCU_04_Can_Network_CANNODE_0: type=Com_applDataType_au8_Size8  # Tx Ipdu buffer of IPdu -MCU_04_Can_Network_CANNODE_0- as a Measurement parameter
          Com_LocalBuf_HCU_01_Can_Network_CANNODE_0: type=Com_applDataType_au8_Size8  # Rx Local Ipdu buffer of IPdu -HCU_01_Can_Network_CANNODE_0- as a Measurement parameter
          Com_LocalBuf_HCU_{02..05}_Can_Network_CANNODE_0: type=Com_applDataType_au8_Size1  # Rx Local Ipdu buffer of IPdu -HCU_{02..05}_Can_Network_CANNODE_0- as a Measurement parameter
      bsw schedulable entity BSWSE_MainFunctionRx: implemented-entry=Com_MainFunctionRx
      bsw schedulable entity BSWSE_MainFunctionTx: implemented-entry=Com_MainFunctionTx
      bsw timing event EV_BSWSE_MainFunctionRx: starts-on-event=BSWSE_MainFunctionRx, period=0.01
      bsw timing event EV_BSWSE_MainFunctionTx: starts-on-event=BSWSE_MainFunctionTx, period=0.01
package /AUTOSAR_Com/DataTypeMappingSets
  data type mapping set DataTypeMappingSet
    data-type-maps:
      application-data-type=Com_SigBuf_au8, implementation-data-type=Com_SigBuf_au8_impl
      application-data-type=Com_SigBuf_au16, implementation-data-type=Com_SigBuf_au16_impl
      application-data-type=Com_applDataType_au8_Size1, implementation-data-type=Com_implDataType_au8_Size1
      application-data-type=Com_applDataType_au8_Size7, implementation-data-type=Com_implDataType_au8_Size7
      application-data-type=Com_applDataType_au8_Size8, implementation-data-type=Com_implDataType_au8_Size8
      application-data-type=Com_IPduStatus_type, implementation-data-type=Com_impl_b
      application-data-type=Com_uint8, implementation-data-type=Com_impl_u8
      application-data-type=Com_uint16, implementation-data-type=Com_impl_u16
      application-data-type=Com_uint32, implementation-data-type=Com_impl_u32
      application-data-type=Com_uint64, implementation-data-type=Com_impl_u64
package /AUTOSAR_Com/ImplementationDataTypes
  10 x impl type:
    Com_SigBuf_au8_impl: category=ARRAY  # Implementation data type for Signals of type - uint8,sint8,boolean,uint8_n
      element Com_Subimpl_u8: array-size=11, array-size-semantics=FIXED-SIZE, implementation-data-type=Com_impl_u8
    Com_SigBuf_au16_impl: category=ARRAY  # Implementation data type for Signals of type - uint16,sint16
      element Com_Subimpl_u16: array-size=2, array-size-semantics=FIXED-SIZE, implementation-data-type=Com_impl_u16
    Com_implDataType_au8_Size1: category=ARRAY  # Implementation data type for Ipdu buffer of Size1
      element Com_Subimpl1: array-size=1, array-size-semantics=FIXED-SIZE, implementation-data-type=Com_impl_u8
    Com_implDataType_au8_Size7: category=ARRAY  # Implementation data type for Ipdu buffer of Size7
      element Com_Subimpl7: array-size=7, array-size-semantics=FIXED-SIZE, implementation-data-type=Com_impl_u8
    Com_implDataType_au8_Size8: category=ARRAY  # Implementation data type for Ipdu buffer of Size8
      element Com_Subimpl8: array-size=8, array-size-semantics=FIXED-SIZE, implementation-data-type=Com_impl_u8
    Com_impl_b: implementation-data-type=boolean  # unsigned char
    Com_impl_u8: implementation-data-type=uint8  # unsigned char
    Com_impl_u16: implementation-data-type=uint16  # unsigned short
    Com_impl_u32: implementation-data-type=uint32  # unsigned long
    Com_impl_u64: implementation-data-type=uint64  # unsigned long long
package /AUTOSAR_Com/Units
  unit NoUnit: display-name=noUnit, factor-si-to-unit=1.0, offset-si-to-unit=0.0, physical-dimension=NoUnit  # No Unit
package /AUTOSAR_Com/PhysicalDimensions
  physical dimension NoUnit: length-exp=0
