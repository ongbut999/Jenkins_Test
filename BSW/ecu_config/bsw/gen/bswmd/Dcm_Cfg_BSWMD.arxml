AUTOSAR XML (schema 4-2-2)
package /AUTOSAR_Dcm/ModeDeclarationGroups
  4 x mode declaration group, all with category=ALPHABETIC_ORDER:
    DcmDiagnosticSessionControl: initial-mode=DEFAULT_SESSION
      mode DEFAULT_SESSION
      mode PROGRAMMING_SESSION
      mode EXTENDED_DIAGNOSTIC_SESSION
    DcmEcuReset: initial-mode=NONE
      6 x mode:
        NONE
        HARD
        SOFT
        JUMPTOBOOTLOADER
        JUMPTOSYSSUPPLIERBOOTLOADER
        EXECUTE
    DcmControlDTCSetting: initial-mode=ENABLEDTCSETTING
      mode ENABLEDTCSETTING
      mode DISABLEDTCSETTING
    DcmCommunicationControl_ComMChannel_Can_Network_Channel: initial-mode=DCM_ENABLE_RX_TX_NORM_NM
      12 x mode:
        DCM_ENABLE_RX_TX_NORM
        DCM_ENABLE_RX_DISABLE_TX_NORM
        DCM_DISABLE_RX_ENABLE_TX_NORM
        DCM_DISABLE_RX_TX_NORM
        DCM_ENABLE_RX_TX_NM
        DCM_ENABLE_RX_DISABLE_TX_NM
        DCM_DISABLE_RX_ENABLE_TX_NM
        DCM_DISABLE_RX_TX_NM
        DCM_ENABLE_RX_TX_NORM_NM
        DCM_ENABLE_RX_DISABLE_TX_NORM_NM
        DCM_DISABLE_RX_ENABLE_TX_NORM_NM
        DCM_DISABLE_RX_TX_NORM_NM
package /AUTOSAR_Dcm/BswModuleEntrys
  bsw module entry Dcm_MainFunction: service-id=37, is-reentrant=false, is-synchronous=true, call-type=SCHEDULED, execution-context=TASK, sw-service-impl-policy=STANDARD
  bsw module entry Dcm_GetSecurityLevel: service-id=13, is-reentrant=true, is-synchronous=true, call-type=REGULAR, execution-context=TASK, sw-service-impl-policy=STANDARD
package /AUTOSAR_Dcm/BswModuleDescriptions
  bsw module description Dcm: category=BSW_MODULE, module-id=53, provided-entrys=Dcm_MainFunction
    provided-mode-groups:
      4 x mode declaration group prototype:
        DcmDiagnosticSessionControl: type=DcmDiagnosticSessionControl
        DcmEcuReset: type=DcmEcuReset
        DcmControlDTCSetting: type=DcmControlDTCSetting
        DcmCommunicationControl_ComMChannel_Can_Network_Channel: type=DcmCommunicationControl_ComMChannel_Can_Network_Channel
    required-mode-groups:
      mode declaration group prototype R_DcmCommunicationControl_ComMChannel_Can_Network_Channel: type=DcmCommunicationControl_ComMChannel_Can_Network_Channel
    bsw internal behavior BswInternalBehavior: data-type-mapping=[DTS_DcmDiagnosticSessionControl, DTS_DcmEcuReset, DTS_DcmControlDTCSetting, DTS_DcmCommunicationControl_ComMChannel_Can_Network_Channel]
      bsw schedulable entity BSWSE_DcmMainFunction: accessed-mode-groups=R_DcmCommunicationControl_ComMChannel_Can_Network_Channel, implemented-entry=Dcm_MainFunction
        managed-mode-groups:
          DcmDiagnosticSessionControl
          DcmEcuReset
          DcmControlDTCSetting
          DcmCommunicationControl_ComMChannel_Can_Network_Channel
      bsw timing event EV_Dcm_MainFunction: starts-on-event=BSWSE_DcmMainFunction, period=0.001
      mode-sender-policys:
        provided-mode-group=DcmDiagnosticSessionControl, queue-length=1
        provided-mode-group=DcmEcuReset, queue-length=1
        provided-mode-group=DcmControlDTCSetting, queue-length=1
        provided-mode-group=DcmCommunicationControl_ComMChannel_Can_Network_Channel, queue-length=1
package /AUTOSAR_Dcm/BswImplementations
  bsw implementation Dcm: programming-language=C, swc-bsw-mapping=SwcBswMappings, ar-release-version=4.2.2, behavior=BswInternalBehavior
    code-descriptors:
      code CodeDescriptor: artifact-descriptors=autosar-engineering-object={short-label=ArEngObject, category=SWSRC}
