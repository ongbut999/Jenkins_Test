AUTOSAR XML (schema 4-2-2)
package /AUTOSAR_Dem/BswImplementations
  bsw implementation Dem: programming-language=C, sw-version=4.0.0, swc-bsw-mapping=SwcBswMappings, vendor-id=6, ar-release-version=4.2.2, behavior=IB_Dem
    code-descriptors:
      code CodeDescriptor: artifact-descriptors=autosar-engineering-object={short-label=ArEngObject, category=SWSRC}
package /AUTOSAR_Dem/BswModuleDescriptions
  bsw module description Dem: category=BSW_MODULE, module-id=54
    bsw internal behavior IB_Dem
      bsw schedulable entity BSWSE_DemMainFunction: implemented-entry=Dem_MainFunction
      bsw timing event EV_MainFunction: starts-on-event=BSWSE_DemMainFunction, period=0.001
package /AUTOSAR_Dem/BswModuleEntrys
  bsw module entry Dem_MainFunction: is-reentrant=false, is-synchronous=true, call-type=SCHEDULED, execution-context=TASK, sw-service-impl-policy=STANDARD
