AUTOSAR XML (schema 4-0-3)
package /AUTOSAR_Xcp/BswModuleEntrys
  4 x bsw module entry, all with is-reentrant=false, is-synchronous=true, call-type=SCHEDULED, execution-context=TASK, sw-service-impl-policy=STANDARD:
    Xcp_MainFunction
    Xcp_EventChannel_10ms
    Xcp_EventChannel_100ms
    Xcp_EventChannel_50ms
