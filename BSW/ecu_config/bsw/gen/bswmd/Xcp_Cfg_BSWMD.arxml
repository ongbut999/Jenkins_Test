AUTOSAR XML (schema 4-2-2)
package /AUTOSAR_Xcp/BswImplementations
  bsw implementation Xcp: programming-language=C, sw-version=6.0.0, ar-release-version=4.2.2, behavior=BswInternalBehavior, vendor-specific-module-def=Xcp
    code-descriptors:
      code CodeDescriptor: artifact-descriptors=autosar-engineering-object={short-label=ArEngObj, category=SWSRC}
package /AUTOSAR_Xcp/BswModuleDescriptions
  bsw module description Xcp: category=BSW_MODULE, module-id=212
    bsw internal behavior BswInternalBehavior
      4 x bsw schedulable entity:
        BSWSE_MainFunction: implemented-entry=Xcp_MainFunction
        BSWSE_EventChannel_10ms: implemented-entry=Xcp_EventChannel_10ms
        BSWSE_EventChannel_100ms: implemented-entry=Xcp_EventChannel_100ms
        BSWSE_EventChannel_50ms: implemented-entry=Xcp_EventChannel_50ms
      4 x bsw timing event:
        EV_BSWSE_MainFunction: starts-on-event=BSWSE_MainFunction, period=0.01
        EV_BSWSE_EventChannel_10ms: starts-on-event=BSWSE_EventChannel_10ms, period=0.01
        EV_BSWSE_EventChannel_100ms: starts-on-event=BSWSE_EventChannel_100ms, period=0.1
        EV_BSWSE_EventChannel_50ms: starts-on-event=BSWSE_EventChannel_50ms, period=0.05
package /AUTOSAR_Xcp/Units
  unit NoUnit: display-name=noUnit, factor-si-to-unit=1.0, offset-si-to-unit=0.0, physical-dimension=NoUnit  # No Unit
package /AUTOSAR_Xcp/PhysicalDimensions
  physical dimension NoUnit: length-exp=0
