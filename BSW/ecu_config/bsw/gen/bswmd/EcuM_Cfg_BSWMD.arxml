AUTOSAR XML (schema 4-2-2)
package /AUTOSAR_EcuM/BswModuleEntrys
  bsw module entry EcuM_MainFunction: is-reentrant=true, is-synchronous=false, call-type=SCHEDULED, execution-context=TASK, sw-service-impl-policy=STANDARD
package /AUTOSAR_EcuM/BswModuleDescriptions
  bsw module description EcuM: category=BSW_MODULE, module-id=10  # ECU State Manager
    bsw internal behavior BswInternalBehavior
      bsw schedulable entity SE_MainFunction: implemented-entry=EcuM_MainFunction
      bsw timing event TE_EcuM_MainFunction_Core{0..2}: starts-on-event=SE_MainFunction, period=0.01
package /AUTOSAR_EcuM/BswImplementations
  bsw implementation EcuM: programming-language=C, sw-version=5.0.0, ar-release-version=4.2.2, behavior=BswInternalBehavior
    code-descriptors:
      code CodeDescriptor: artifact-descriptors=autosar-engineering-object={short-label=ArEngObj, category=SWSRC}
