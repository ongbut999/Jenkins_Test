AUTOSAR XML (schema 4-2-2)
standard types defined: boolean, uint8, uint16, uint32, uint64, sint8, sint16, sint32, sint64, float32, float64, uint8_least, uint16_least, uint32_least, sint8_least, sint16_least, sint32_least, void
package /AUTOSAR_PlatformTypes/SwBaseTypes  # AUTOSAR Base Types for AUTOSAR Platform types for a specific controller and compiler
