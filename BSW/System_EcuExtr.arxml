AUTOSAR XML (schema 4-2-2)
package /System_EcuExtract
  system EXTR_MCU: category=ECU_EXTRACT, ecu-extract-version=1.0.0, system-version=1.0.0
    system mapping SYSMPG_MCU
      data-mappings:
        data-element=CPT_MCU_FlatView.PPort_MCU01_EmergShutDown.MCU01_EmergShutDown, system-signal=MCU01_EmergShutDown
        data-element=CPT_MCU_FlatView.PPort_MCU02_MaxTor.MCU02_MaxTor, system-signal=MCU02_MaxTor
        data-element=CPT_MCU_FlatView.PPort_MCU03_NRF_IdcSamp.MCU03_NRF_IdcSamp, system-signal=MCU03_NRF_IdcSamp
        data-element=CPT_MCU_FlatView.RPort_HCU01_Shift.HCU01_Shift, system-signal=HCU01_Shift
        data-element=CPT_MCU_FlatView.RPort_HCU01_TqCmd.HCU01_Tq_Cmd, system-signal=HCU01_TqCmd
        data-element=CPT_MCU_FlatView.RPort_HCU02_Poweroff.HCU02_Poweroff, system-signal=HCU02_Poweroff
        data-element=CPT_MCU_FlatView.RPort_HCU03_Poweroff.HCU03_Poweroff, system-signal=HCU03_Poweroff
        data-element=CPT_MCU_FlatView.PPort_MCU04_Test.MCU04_Test, system-signal=MCU04_Test
        data-element=CPT_MCU_FlatView.RPort_HCU04_Poweroff.HCU04_Poweroff, system-signal=HCU04_Poweroff
        data-element=CPT_MCU_FlatView.RPort_HCU05_Poweroff.HCU05_Poweroff, system-signal=HCU05_Poweroff
      sw-mappings:
        swc to ecu mapping SwcToEcuMapping_0: ecu-instance=MCU
          component:
            CPT_MCU_FlatView.CPT_ASW_BASE
            CPT_MCU_FlatView.CPT_ASW_COM
            CPT_MCU_FlatView.CPT_ASW_CORE1
            CPT_MCU_FlatView.CPT_ASW_CORE2
            CPT_MCU_FlatView.CPT_ASW_NM
            CPT_MCU_FlatView.CPT_ASW_NVM
            CPT_MCU_FlatView.CPT_ASW_WDG
            CPT_MCU_FlatView.CPT_BswM
            CPT_MCU_FlatView.CPT_ComM
            CPT_MCU_FlatView.CPT_Dcm
            CPT_MCU_FlatView.CPT_Dem
            CPT_MCU_FlatView.CPT_Dem_SWC
            CPT_MCU_FlatView.CPT_Det
            CPT_MCU_FlatView.CPT_Diag
            CPT_MCU_FlatView.CPT_EcuM
            CPT_MCU_FlatView.CPT_NvM
            CPT_MCU_FlatView.CPT_Wdg
            CPT_MCU_FlatView.CPT_XCP
    root-software-compositions:
      root sw composition prototype CPT_MCU_FlatView: flat-map=MCU_FlatMap, software-composition=MCU_FlatView
