AUTOSAR XML (schema 4-2-2)
package /ETAS_Project/EcucModuleConfigurationValuess
  module config CanIf
    CanIfInitCfg
      10 x CanIfTxPduCfg:
        MCU_02_Can_Network_CANNODE_0: CanIfTxPduId=2
        MCU_01_Can_Network_CANNODE_0: CanIfTxPduId=1
        MCU_03_Can_Network_CANNODE_0: CanIfTxPduId=3
        Diag_Physical_response_Can_Network_CANNODE_0: CanIfTxPduId=0
        NM_VCU_Can_Network_CANNODE_0: CanIfTxPduId=5
        XCP_TX_RES_Can_Network_CANNODE_1: CanIfTxPduId=9
        XCP_TX_DAQ2_Can_Network_CANNODE_1: CanIfTxPduId=8
        XCP_TX_DAQ1_Can_Network_CANNODE_1: CanIfTxPduId=7
        XCP_TX_DAQ0_Can_Network_CANNODE_1: CanIfTxPduId=6
        MCU_04_Can_Network_CANNODE_0: CanIfTxPduId=4
      10 x CanIfRxPduCfg:
        HCU_01_Can_Network_CANNODE_0: CanIfRxPduId=0
        HCU_02_Can_Network_CANNODE_0: CanIfRxPduId=1
        Diag_Functional_request_Can_Network_CANNODE_0: CanIfRxPduId=2
        Diag_Physical_request_Can_Network_CANNODE_0: CanIfRxPduId=3
        NM_VCU_Rx_ETAS_Can_Network_CANNODE_0: CanIfRxPduId=4
        XCP_RX_CMD_Can_Network_CANNODE_1: CanIfRxPduId=5
        XCP_RX_Broadcast_Can_Network_CANNODE_1: CanIfRxPduId=6
        HCU_03_Can_Network_CANNODE_0: CanIfRxPduId=7
        HCU_04_Can_Network_CANNODE_0: CanIfRxPduId=8
        HCU_05_Can_Network_CANNODE_0: CanIfRxPduId=9
    CanIfCtrlDrvCfg
      Can_Network_CANNODE_0 (CanIfCtrlCfg): CanIfCtrlId=0
      Can_Network_CANNODE_1 (CanIfCtrlCfg): CanIfCtrlId=1
  module config ComM
    ComMConfigSet
      ComMUser_Can_Network_Channel (ComMUser): ComMUserIdentifier=0
      ComMUser_Can_Network_XCP_Channel (ComMUser): ComMUserIdentifier=1
      ComMChannel_Can_Network_Channel (ComMChannel): ComMChannelId=0
      ComMChannel_Can_Network_XCP_Channel (ComMChannel): ComMChannelId=1
  module config NvM
    ECUM_CFG_NVM_BLOCK (NvMBlockDescriptor):
      NvMBlockCrcType = NVM_CRC16
      NvMBlockJobPriority = 1
      NvMBlockManagementType = NVM_BLOCK_NATIVE
      NvMBlockUseCrc = true
      NvMBlockUseSyncMechanism = false
      NvMBlockWriteProt = false
      NvMCalcRamBlockCrc = false
      NvMMaxNumOfReadRetries = 0
      NvMMaxNumOfWriteRetries = 0
      NvMNvBlockLength = 4
      NvMNvBlockNum = 1
      NvMNvramDeviceId = 0
      NvMRamBlockDataAddress = EcuM_Rb_dataShutdownInfo_st
      NvMRbGenRteServicePort = false
      NvMResistantToChangedSw = false
      NvMRomBlockDataAddress = NULL_PTR
      NvMRomBlockNum = 0
      NvMSelectBlockForReadAll = true
      NvMSelectBlockForWriteAll = true
      NvMSingleBlockCallback = EcuM_Rb_NvMSingleBlockCallbackFunction
      NvMStaticBlockIDCheck = false
      NvMWriteBlockOnce = false
      NvMWriteVerification = false
      NvMWriteVerificationDataSize = 0
  module config EcuM
    EcuMConfiguration_0 (EcuMConfiguration)
      EcuMCommonConfiguration
        5 x EcuMWakeupSource, all with EcuMValidationTimeout=0.0:
          ECUM_WKSOURCE_POWER: EcuMWakeupSourceId=0
          ECUM_WKSOURCE_RESET: EcuMWakeupSourceId=1
          ECUM_WKSOURCE_INTERNAL_RESET: EcuMWakeupSourceId=2
          ECUM_WKSOURCE_INTERNAL_WDG: EcuMWakeupSourceId=3
          ECUM_WKSOURCE_EXTERNAL_WDG: EcuMWakeupSourceId=4
      EcuMFlexConfiguration
        3 x EcuMResetMode:
          ECUM_RESET_MCU: EcuMResetModeId=0
          ECUM_RESET_WDGM: EcuMResetModeId=1
          ECUM_RESET_IO: EcuMResetModeId=2
        4 x EcuMShutdownCause:
          ECUM_CAUSE_UNKNOWN: EcuMShutdownCauseId=0
          ECUM_CAUSE_ECU_STATE: EcuMShutdownCauseId=1
          ECUM_CAUSE_WDGM: EcuMShutdownCauseId=2
          ECUM_CAUSE_DCM: EcuMShutdownCauseId=3
  module config CanSM
    CanSMConfiguration
      CanSMManagerNetwork_Can_Network (CanSMManagerNetwork): CanSMNetworkIndex=0
      CanSMManagerNetwork_Can_Network_XCP (CanSMManagerNetwork): CanSMNetworkIndex=1
  module config MemIf
    MemIfGeneral: MemIfMainFunctionCycleTime=0.01, MemIfNumberOfDevices=1, MemIfRbFeeUsed=true, MemIfRbNumberOfEADevices=0
  module config Fee
    FeeGeneral: FeePollingMode=true
    12 x FeeBlockConfiguration, all with FeeImmediateData=false, FeeNumberOfWriteCycles=1, FeeRbCallbackEnd=NULL_PTR, FeeRbCallbackError=NULL_PTR, FeeRbDeviceIndex=0, FeeRbFirstReadDataMigration=false, FeeRbNoFallback=false, FeeRbOrigin=NVM, FeeRbSecLevel=1, FeeRbSurvival=false, FeeRbVarBlockLength=false:
      ECUM_CFG_NVM_BLOCK: FeeBlockSize=4, FeeRbBlockPersistentId=62199
      NvMBlockDescriptor_DID_SystemFaultRank: FeeBlockSize=4, FeeRbBlockPersistentId=16680
      NvMBlockDescriptor_DID_VehicleSpeed: FeeBlockSize=17, FeeRbBlockPersistentId=45679
      NvMBlockDescriptor_Dem_AllEventsStatusByte: FeeBlockSize=6, FeeRbBlockPersistentId=16142
      NvMBlockDescriptor_Dem_EvMemEventMemory0: FeeBlockSize=20, FeeRbBlockPersistentId=33384
      NvMBlockDescriptor_Dem_EvMemEventMemory1: FeeBlockSize=20, FeeRbBlockPersistentId=33640
      NvMBlockDescriptor_Dem_EvMemEventMemory2: FeeBlockSize=20, FeeRbBlockPersistentId=32872
      NvMBlockDescriptor_Dem_EvMemEventMemory3: FeeBlockSize=20, FeeRbBlockPersistentId=33128
      NvMBlockDescriptor_Dem_EvMemEventMemory4: FeeBlockSize=20, FeeRbBlockPersistentId=34408
      NvMBlockDescriptor_Dem_GenericNvData: FeeBlockSize=16, FeeRbBlockPersistentId=42447
      NvM_NativeBlock_1024_1: FeeBlockSize=1024, FeeRbBlockPersistentId=59972
      NvM_NativeBlock_1024_2: FeeBlockSize=1024, FeeRbBlockPersistentId=63695
  module config Dem
    DemConfigSet
      5 x DemEventParameter:
        DemEventParameter_C110117: DemEventId=1
        DemEventParameter_C110216: DemEventId=2
        DemEventParameter_C153364: DemEventId=3
        DemEventParameter_CanBusoff: DemEventId=4
        DemEventParameter_CanController1_Busoff: DemEventId=5
    DemGeneral
      DemStorageCondition_0 (DemStorageCondition): DemStorageConditionId=0
      DemOperationCycle_0 (DemOperationCycle): DemOperationCycleId=0
      DemClient: DemClientId=1, DemEventMemorySetRef=DemEventMemorySet
      DemDataElementClass_Aging_Counter (DemDataElementClass)
        DemInternalDataElementClass_AgingCounter (DemInternalDataElementClass): DemDataElementDataSize=1
      DemEventMemorySet: DemDtcStatusAvailabilityMask=255, DemMaxNumberEventEntryPermanent=6, DemTypeOfDTCSupported=DEM_DTC_TRANSLATION_ISO14229_1
        DemPrimaryMemory: DemMaxNumberEventEntryPrimary=5
  module config Com
    ComConfig_0 (ComConfig)
      9 x ComIPdu:
        HCU_01_Can_Network_CANNODE_0: ComIPduHandleId=0
        HCU_02_Can_Network_CANNODE_0: ComIPduHandleId=1
        HCU_03_Can_Network_CANNODE_0: ComIPduHandleId=2
        HCU_04_Can_Network_CANNODE_0: ComIPduHandleId=3
        HCU_05_Can_Network_CANNODE_0: ComIPduHandleId=4
        MCU_01_Can_Network_CANNODE_0: ComIPduHandleId=0
        MCU_02_Can_Network_CANNODE_0: ComIPduHandleId=1
        MCU_03_Can_Network_CANNODE_0: ComIPduHandleId=2
        MCU_04_Can_Network_CANNODE_0: ComIPduHandleId=3
      64 x ComSignal:
        HCU01_EmergShutDown: ComHandleId=0
        HCU01_CheckSum: ComHandleId=1
        HCU01_Counter: ComHandleId=2
        HCU01_ActiveDischarge: ComHandleId=3
        HCU01_McuModeCmd: ComHandleId=4
        HCU01_EnaMCU: ComHandleId=5
        HCU01_SpeedCmd: ComHandleId=6
        HCU01_Shift: ComHandleId=7
        HCU01_TqCmd: ComHandleId=8
        HCU02_Poweroff: ComHandleId=9
        HCU03_Poweroff: ComHandleId=10
        HCU04_Poweroff: ComHandleId=11
        HCU05_Poweroff: ComHandleId=12
        MCU01_ShutDownAllowed: ComHandleId=0
        MCU01_Ready: ComHandleId=1
        MCU01_HighVolAllowed: ComHandleId=2
        MCU01_Status: ComHandleId=3
        MCU01_ActDischStatus: ComHandleId=4
        MCU01_SelfCheck: ComHandleId=5
        MCU01_CheckSum: ComHandleId=6
        MCU01_Counter: ComHandleId=7
        MCU01_CurCntTor: ComHandleId=8
        MCU01_Motorspd: ComHandleId=9
        MCU01_EmergShutDown: ComHandleId=10
        MCU02_IGBTTmp: ComHandleId=11
        MCU02_MotorTmp: ComHandleId=12
        MCU02_Vdc: ComHandleId=13
        MCU02_Idc: ComHandleId=14
        MCU02_MinTor: ComHandleId=15
        MCU02_MaxTor: ComHandleId=16
        MCU03_LI_OverSpeed: ComHandleId=17
        MCU03_LI_OverTempEM: ComHandleId=18
        MCU03_LI_OverTempINV: ComHandleId=19
        MCU03_LI_UdcUnder: ComHandleId=20
        MCU03_LI_UdcOver: ComHandleId=21
        MCU03_RF_PhaseImp: ComHandleId=22
        MCU03_12VSupply: ComHandleId=23
        MCU03_RF_PhCOver: ComHandleId=24
        MCU03_RF_PhBOver: ComHandleId=25
        MCU03_RF_PhAOver: ComHandleId=26
        MCU03_RF_OverSpeed: ComHandleId=27
        MCU03_RF_MsgTO: ComHandleId=28
        MCU03_RF_OverTempEM: ComHandleId=29
        MCU03_RF_OverTempINV: ComHandleId=30
        MCU03_RF_IntError: ComHandleId=31
        MCU03_RF_HWOverCur: ComHandleId=32
        MCU03_RF_UDCUnder: ComHandleId=33
        MCU03_RF_UdcOver: ComHandleId=34
        MCU03_RF_IdcOver: ComHandleId=35
        MCU03_RF_ToqError: ComHandleId=36
        MCU03_RF_BusOff: ComHandleId=37
        MCU03_NRF_SysFailure: ComHandleId=38
        MCU03_NRF_Resolver: ComHandleId=39
        MCU03_NRF_PhCSamp: ComHandleId=40
        MCU03_NRF_PhBSamp: ComHandleId=41
        MCU03_NRF_InvTempSamp: ComHandleId=42
        MCU03_NRF_PhASamp: ComHandleId=43
        MCU03_NRF_DESAT: ComHandleId=44
        MCU03_NRF_UdcSamp: ComHandleId=45
        MCU03_NRF_COMError: ComHandleId=46
        MCU03_NRF_5VSupply: ComHandleId=47
        MCU03_NRF_EMTempSamp: ComHandleId=48
        MCU03_NRF_IdcSamp: ComHandleId=49
        MCU04_Test: ComHandleId=50
      ComIPduGroup_Rx (ComIPduGroup): ComIPduGroupHandleId=0
      ComIPduGroup_Tx (ComIPduGroup): ComIPduGroupHandleId=1
    ComGeneral: ComSupportedIPduGroups=2
  module config Dcm
    DcmConfigSet
      DcmDsl
        DcmDslProtocol
          DcmDslProtocolRow_UDS (DcmDslProtocolRow)
            DcmDslConnection_CAN (DcmDslConnection)
              DcmDslMainConnection
                Diag_Physical_request_Can_Network_CANNODE_0_Phys_PduR2Dcm (DcmDslProtocolRx): DcmDslProtocolRxPduId=0
                Diag_Functional_request_Can_Network_CANNODE_0_Phys_PduR2Dcm (DcmDslProtocolRx): DcmDslProtocolRxPduId=1
                Diag_Physical_response_Can_Network_CANNODE_0_Phys_Dcm2PduR (DcmDslProtocolTx): DcmDslTxConfirmationPduId=0
      DcmDsd
        DcmDsdServiceTable_UDS (DcmDsdServiceTable): DcmDsdSidTabId=0
      DcmDsp
        DcmDspSession
          3 x DcmDspSessionRow:
            DefaultSession
            ProgrammingSession
            ExtendedDiagnosticSession
        3 x DcmDspData, all with DcmDspDataEndianness=BIG_ENDIAN:
          DcmDspData_VacuumPumpPressure_1100
          DcmDspData_VehicleSpeed
          DcmDspData_SystemFaultRank
  module config PduR
    PduRRoutingTables
      PduRRoutingTable
        12 x PduRRoutingPath:
          HCU_01_Can_Network_CANNODE_0_CanIf2Com
            HCU_01_Can_Network_CANNODE_0_CanIf2PduR (PduRSrcPdu): PduRSourcePduHandleId=0
            HCU_01_Can_Network_CANNODE_0_PduR2Com (PduRDestPdu): PduRDestPduHandleId=0
          HCU_02_Can_Network_CANNODE_0_CanIf2Com
            HCU_02_Can_Network_CANNODE_0_CanIf2PduR (PduRSrcPdu): PduRSourcePduHandleId=1
            HCU_02_Can_Network_CANNODE_0_PduR2Com (PduRDestPdu): PduRDestPduHandleId=1
          HCU_03_Can_Network_CANNODE_0_CanIf2Com
            HCU_03_Can_Network_CANNODE_0_CanIf2PduR (PduRSrcPdu): PduRSourcePduHandleId=2
            HCU_03_Can_Network_CANNODE_0_PduR2Com (PduRDestPdu): PduRDestPduHandleId=2
          HCU_04_Can_Network_CANNODE_0_CanIf2Com
            HCU_04_Can_Network_CANNODE_0_CanIf2PduR (PduRSrcPdu): PduRSourcePduHandleId=3
            HCU_04_Can_Network_CANNODE_0_PduR2Com (PduRDestPdu): PduRDestPduHandleId=3
          HCU_05_Can_Network_CANNODE_0_CanIf2Com
            HCU_05_Can_Network_CANNODE_0_CanIf2PduR (PduRSrcPdu): PduRSourcePduHandleId=4
            HCU_05_Can_Network_CANNODE_0_PduR2Com (PduRDestPdu): PduRDestPduHandleId=4
          MCU_01_Can_Network_CANNODE_0_Com2CanIf
            MCU_01_Can_Network_CANNODE_0_PduR2CanIf (PduRDestPdu): PduRDestPduHandleId=0
            MCU_01_Can_Network_CANNODE_0_Com2PduR (PduRSrcPdu): PduRSourcePduHandleId=0
          MCU_02_Can_Network_CANNODE_0_Com2CanIf
            MCU_02_Can_Network_CANNODE_0_PduR2CanIf (PduRDestPdu): PduRDestPduHandleId=1
            MCU_02_Can_Network_CANNODE_0_Com2PduR (PduRSrcPdu): PduRSourcePduHandleId=1
          MCU_03_Can_Network_CANNODE_0_Com2CanIf
            MCU_03_Can_Network_CANNODE_0_PduR2CanIf (PduRDestPdu): PduRDestPduHandleId=2
            MCU_03_Can_Network_CANNODE_0_Com2PduR (PduRSrcPdu): PduRSourcePduHandleId=2
          MCU_04_Can_Network_CANNODE_0_Com2CanIf
            MCU_04_Can_Network_CANNODE_0_PduR2CanIf (PduRDestPdu): PduRDestPduHandleId=3
            MCU_04_Can_Network_CANNODE_0_Com2PduR (PduRSrcPdu): PduRSourcePduHandleId=3
          Diag_Functional_request_Can_Network_CANNODE_0_CanTp2Dcm
            Diag_Functional_request_Can_Network_CANNODE_0_CanTp2PduR (PduRSrcPdu): PduRSourcePduHandleId=0
            Diag_Functional_request_Can_Network_CANNODE_0_PduR2Dcm (PduRDestPdu): PduRDestPduHandleId=0
          Diag_Physical_request_Can_Network_CANNODE_0_CanTp2Dcm
            Diag_Physical_request_Can_Network_CANNODE_0_CanTp2PduR (PduRSrcPdu): PduRSourcePduHandleId=1
            Diag_Physical_request_Can_Network_CANNODE_0_PduR2Dcm (PduRDestPdu): PduRDestPduHandleId=1
          Diag_Physical_response_Can_Network_CANNODE_0_Dcm2CanTp
            Diag_Physical_response_Can_Network_CANNODE_0_Phys_PduR2CanTp (PduRDestPdu): PduRDestPduHandleId=0
            Diag_Physical_response_Can_Network_CANNODE_0_Phys_Dcm2PduR (PduRSrcPdu): PduRSourcePduHandleId=0
package /CanTp_EcucValues
  module config CanTp
    CanTpConfig
      CanTpChannel_UDS (CanTpChannel)
        Diag_Functional_request_Can_Network_CANNODE_0_Phys_CanTp2PduR (CanTpRxNSdu): CanTpRxNSduId=0
          Diag_Functional_request_Can_Network_CANNODE_0_Phys_CanIf2CanTp (CanTpRxNPdu): CanTpRxNPduId=0
        Diag_Physical_request_Can_Network_CANNODE_0_Func_CanTp2PduR (CanTpRxNSdu): CanTpRxNSduId=1
          Diag_Physical_request_Can_Network_CANNODE_0_Phys_CanIf2CanTp (CanTpRxNPdu): CanTpRxNPduId=1
          Diag_Physical_response_Can_Network_CANNODE_0_Phys_CanTp2CanIf (CanTpTxFcNPdu): CanTpTxFcNPduConfirmationPduId=0
        Diag_Physical_response_Can_Network_CANNODE_0_Phys_PduR2CanTp (CanTpTxNSdu): CanTpTxNSduId=0
          Diag_Physical_request_Can_Network_CANNODE_0_Phys_CanIf2CanTp (CanTpRxFcNPdu): CanTpRxFcNPduId=1
          Diag_Physical_response_Can_Network_CANNODE_0_Phys_CanTp2CanIf (CanTpTxNPdu): CanTpTxNPduConfirmationPduId=0
    CanTpGeneral: CanTpRbValidationDone=true
package /RB/UBK/Project/EcucModuleConfigurationValuess
  module config Nm_EcuValues: definition=Nm
    NmChannelConfig_0 (NmChannelConfig): NmNodeDetectionEnabled=true, NmNodeIdEnabled=true, NmRepeatMsgIndEnabled=true
  module config WdgIf
    WdgIfDevice: WdgIfDeviceIndex=0
  module config Xcp
    XcpConfig_0 (XcpConfig)
      3 x XcpEventChannel:
        Event_10ms_Raster: XcpEventChannelNumber=0
        Event_100ms_Raster: XcpEventChannelNumber=1
        Event_50ms_Raster: XcpEventChannelNumber=2
      XcpTransportLayer_0 (XcpTransportLayer): XcpTransportLayerId=0
        XcpRxPdu_RX_CMD (XcpRxPdu): XcpRxPduId=0
        XcpRxPdu_RX_Bradcast (XcpRxPdu): XcpRxPduId=1
        4 x XcpTxPdu:
          XcpTxPdu_RES: XcpTxPduId=0
          XcpTxPdu_DAQ0: XcpTxPduId=1
          XcpTxPdu_DAQ1: XcpTxPduId=2
          XcpTxPdu_DAQ2: XcpTxPduId=3
  module config CanNm
    CanNmGlobalConfig_0 (CanNmGlobalConfig)
      CanNmChannelConfig_0 (CanNmChannelConfig): CanNmNodeDetectionEnabled=true, CanNmNodeIdEnabled=true, CanNmRepeatMsgIndEnabled=true
        CanNmRxPdu_0 (CanNmRxPdu): CanNmRxPduId=0
        CanNmTxPdu: CanNmTxConfirmationPduId=0
  module config rba_ArxmlGen
    7 x rba_ArxmlGen_Comp:
      NvM: rba_ArxmlGen_CompCategory=BswModule, rba_ArxmlGen_CompId=20, rba_ArxmlGen_CompIsConfigurable=true, rba_ArxmlGen_CompIsStandalone=false, rba_ArxmlGen_CompIsStandardized=true, rba_ArxmlGen_CompLongName=NVRAM Manager, rba_ArxmlGen_CompVersionAr=4.2.2, rba_ArxmlGen_CompVersionSw=13.0.0, rba_ArxmlGen_CompSwcBswMappingRef=NvM
        4 x rba_ArxmlGen_CompuMethod, all with rba_ArxmlGen_CompuMethodCategory=TextTable:
          NvM_Rb_StatusType: rba_ArxmlGen_CompuMethodLongName=Computation method for the type of the current overall status of the NVRAM manager.
            3 x rba_ArxmlGen_CompuMethodTextEntry, all with rba_ArxmlGen_CompuMethodTENumVals=1:
              NVM_RB_STATUS_UNINIT: rba_ArxmlGen_CompuMethodTEIntVal=0, rba_ArxmlGen_CompuMethodTEText=NVM_RB_STATUS_UNINIT
              NVM_RB_STATUS_IDLE: rba_ArxmlGen_CompuMethodTEIntVal=1, rba_ArxmlGen_CompuMethodTEText=NVM_RB_STATUS_IDLE
              NVM_RB_STATUS_BUSY: rba_ArxmlGen_CompuMethodTEIntVal=2, rba_ArxmlGen_CompuMethodTEText=NVM_RB_STATUS_BUSY
          NvM_RequestResultType: rba_ArxmlGen_CompuMethodLongName=Computation method for the type of the block request result.
            9 x rba_ArxmlGen_CompuMethodTextEntry, all with rba_ArxmlGen_CompuMethodTENumVals=1:
              NVM_REQ_OK: rba_ArxmlGen_CompuMethodTEIntVal=0, rba_ArxmlGen_CompuMethodTEText=NVM_REQ_OK
              NVM_REQ_NOT_OK: rba_ArxmlGen_CompuMethodTEIntVal=1, rba_ArxmlGen_CompuMethodTEText=NVM_REQ_NOT_OK
              NVM_REQ_PENDING: rba_ArxmlGen_CompuMethodTEIntVal=2, rba_ArxmlGen_CompuMethodTEText=NVM_REQ_PENDING
              NVM_REQ_INTEGRITY_FAILED: rba_ArxmlGen_CompuMethodTEIntVal=3, rba_ArxmlGen_CompuMethodTEText=NVM_REQ_INTEGRITY_FAILED
              NVM_REQ_BLOCK_SKIPPED: rba_ArxmlGen_CompuMethodTEIntVal=4, rba_ArxmlGen_CompuMethodTEText=NVM_REQ_BLOCK_SKIPPED
              NVM_REQ_NV_INVALIDATED: rba_ArxmlGen_CompuMethodTEIntVal=5, rba_ArxmlGen_CompuMethodTEText=NVM_REQ_NV_INVALIDATED
              NVM_REQ_CANCELED: rba_ArxmlGen_CompuMethodTEIntVal=6, rba_ArxmlGen_CompuMethodTEText=NVM_REQ_CANCELED
              NVM_REQ_REDUNDANCY_FAILED: rba_ArxmlGen_CompuMethodTEIntVal=7, rba_ArxmlGen_CompuMethodTEText=NVM_REQ_REDUNDANCY_FAILED
              NVM_REQ_RESTORED_FROM_ROM: rba_ArxmlGen_CompuMethodTEIntVal=8, rba_ArxmlGen_CompuMethodTEText=NVM_REQ_RESTORED_FROM_ROM
          NvM_Rb_MigrationResult_ten: rba_ArxmlGen_CompuMethodLongName=Computation method for the type of the the migration result.
            6 x rba_ArxmlGen_CompuMethodTextEntry, all with rba_ArxmlGen_CompuMethodTENumVals=1:
              NVM_RB_MIGRATION_RESULT_INIT_E: rba_ArxmlGen_CompuMethodTEIntVal=0, rba_ArxmlGen_CompuMethodTEText=NVM_RB_MIGRATION_RESULT_INIT_E
              NVM_RB_MIGRATION_RESULT_NOT_NECESSARY_E: rba_ArxmlGen_CompuMethodTEIntVal=1, rba_ArxmlGen_CompuMethodTEText=NVM_RB_MIGRATION_RESULT_NOT_NECESSARY_E
              NVM_RB_MIGRATION_RESULT_TO_SMALLER_SIZE_E: rba_ArxmlGen_CompuMethodTEIntVal=2, rba_ArxmlGen_CompuMethodTEText=NVM_RB_MIGRATION_RESULT_TO_SMALLER_SIZE_E
              NVM_RB_MIGRATION_RESULT_TO_BIGGER_SIZE_E: rba_ArxmlGen_CompuMethodTEIntVal=3, rba_ArxmlGen_CompuMethodTEText=NVM_RB_MIGRATION_RESULT_TO_BIGGER_SIZE_E
              NVM_RB_MIGRATION_RESULT_NOT_DONE_E: rba_ArxmlGen_CompuMethodTEIntVal=4, rba_ArxmlGen_CompuMethodTEText=NVM_RB_MIGRATION_RESULT_NOT_DONE_E
              NVM_RB_MIGRATION_RESULT_DEACTIVATED_E: rba_ArxmlGen_CompuMethodTEIntVal=5, rba_ArxmlGen_CompuMethodTEText=NVM_RB_MIGRATION_RESULT_DEACTIVATED_E
          NvM_Rb_RequestType_ten: rba_ArxmlGen_CompuMethodLongName=Computation method for the type of the currently active user block request.
            3 x rba_ArxmlGen_CompuMethodTextEntry, all with rba_ArxmlGen_CompuMethodTENumVals=1:
              NvM_Rb_RequestType_NA_e: rba_ArxmlGen_CompuMethodTEIntVal=0, rba_ArxmlGen_CompuMethodTEText=NvM_Rb_RequestType_NA_e
              NvM_Rb_RequestType_Multi_e: rba_ArxmlGen_CompuMethodTEIntVal=1, rba_ArxmlGen_CompuMethodTEText=NvM_Rb_RequestType_Multi_e
              NvM_Rb_RequestType_Single_e: rba_ArxmlGen_CompuMethodTEIntVal=2, rba_ArxmlGen_CompuMethodTEText=NvM_Rb_RequestType_Single_e
        3 x rba_ArxmlGen_DataConstraint, all with rba_ArxmlGen_DataConstraintCategory=Physical, rba_ArxmlGen_DataConstraintLower=0, rba_ArxmlGen_DataConstraintUnitRef=NoUnit:
          NvM_Constr_NoUnit_u32: rba_ArxmlGen_DataConstraintUpper=4294967295
          NvM_Constr_NoUnit_u16: rba_ArxmlGen_DataConstraintUpper=65535
          NvM_Constr_NoUnit_u8: rba_ArxmlGen_DataConstraintUpper=255
        26 x rba_ArxmlGen_ExecEntity:
          CE_CancelWriteAll: rba_ArxmlGen_ExecEntityCategory=Called, rba_ArxmlGen_ExecEntityImplEntryRef=NvM_CancelWriteAll
          CE_EraseNvBlock: rba_ArxmlGen_ExecEntityCategory=Called, rba_ArxmlGen_ExecEntityImplEntryRef=NvM_EraseNvBlock
          CE_GetDataIndex: rba_ArxmlGen_ExecEntityCategory=Called, rba_ArxmlGen_ExecEntityImplEntryRef=NvM_GetDataIndex
          CE_GetErrorStatus: rba_ArxmlGen_ExecEntityCategory=Called, rba_ArxmlGen_ExecEntityImplEntryRef=NvM_GetErrorStatus
          CE_Init: rba_ArxmlGen_ExecEntityCategory=Called, rba_ArxmlGen_ExecEntityImplEntryRef=NvM_Init
          CE_InvalidateNvBlock: rba_ArxmlGen_ExecEntityCategory=Called, rba_ArxmlGen_ExecEntityImplEntryRef=NvM_InvalidateNvBlock
          SE_MainFunction: rba_ArxmlGen_ExecEntityCategory=Schedulable, rba_ArxmlGen_ExecEntityPeriod=0.01, rba_ArxmlGen_ExecEntityImplEntryRef=NvM_MainFunction
          CE_Rb_ClrWriteMonCntrs: rba_ArxmlGen_ExecEntityCategory=Called, rba_ArxmlGen_ExecEntityImplEntryRef=NvM_Rb_ClrWriteMonCntrs
          CE_Rb_FirstInitAll: rba_ArxmlGen_ExecEntityCategory=Called, rba_ArxmlGen_ExecEntityImplEntryRef=NvM_Rb_FirstInitAll
          CE_Rb_GetActiveService: rba_ArxmlGen_ExecEntityCategory=Called, rba_ArxmlGen_ExecEntityImplEntryRef=NvM_Rb_GetActiveService
          CE_Rb_GetBlockId: rba_ArxmlGen_ExecEntityCategory=Called, rba_ArxmlGen_ExecEntityImplEntryRef=NvM_Rb_GetBlockId
          CE_Rb_GetMigrationResult: rba_ArxmlGen_ExecEntityCategory=Called, rba_ArxmlGen_ExecEntityImplEntryRef=NvM_Rb_GetMigrationResult
          CE_Rb_GetNvBlockLength: rba_ArxmlGen_ExecEntityCategory=Called, rba_ArxmlGen_ExecEntityImplEntryRef=NvM_Rb_GetNvBlockLength
          CE_Rb_GetRequestType: rba_ArxmlGen_ExecEntityCategory=Called, rba_ArxmlGen_ExecEntityImplEntryRef=NvM_Rb_GetRequestType
          CE_Rb_GetStatus: rba_ArxmlGen_ExecEntityCategory=Called, rba_ArxmlGen_ExecEntityImplEntryRef=NvM_Rb_GetStatus
          CE_ReadAll: rba_ArxmlGen_ExecEntityCategory=Called, rba_ArxmlGen_ExecEntityImplEntryRef=NvM_ReadAll
          CE_ReadBlock: rba_ArxmlGen_ExecEntityCategory=Called, rba_ArxmlGen_ExecEntityImplEntryRef=NvM_ReadBlock
          CE_RestoreBlockDefaults: rba_ArxmlGen_ExecEntityCategory=Called, rba_ArxmlGen_ExecEntityImplEntryRef=NvM_RestoreBlockDefaults
          CE_SetBlockLockStatus: rba_ArxmlGen_ExecEntityCategory=Called, rba_ArxmlGen_ExecEntityImplEntryRef=NvM_SetBlockLockStatus
          CE_SetBlockProtection: rba_ArxmlGen_ExecEntityCategory=Called, rba_ArxmlGen_ExecEntityImplEntryRef=NvM_SetBlockProtection
          CE_SetDataIndex: rba_ArxmlGen_ExecEntityCategory=Called, rba_ArxmlGen_ExecEntityImplEntryRef=NvM_SetDataIndex
          CE_SetRamBlockStatus: rba_ArxmlGen_ExecEntityCategory=Called, rba_ArxmlGen_ExecEntityImplEntryRef=NvM_SetRamBlockStatus
          CE_SetWriteAllTrigger: rba_ArxmlGen_ExecEntityCategory=Called, rba_ArxmlGen_ExecEntityImplEntryRef=NvM_Rb_SetWriteAllTrigger
          CE_ValidateAll: rba_ArxmlGen_ExecEntityCategory=Called, rba_ArxmlGen_ExecEntityImplEntryRef=NvM_ValidateAll
          CE_WriteAll: rba_ArxmlGen_ExecEntityCategory=Called, rba_ArxmlGen_ExecEntityImplEntryRef=NvM_WriteAll
          CE_WriteBlock: rba_ArxmlGen_ExecEntityCategory=Called, rba_ArxmlGen_ExecEntityImplEntryRef=NvM_WriteBlock
      CanNm
        BSWSE_MainFunction (rba_ArxmlGen_ExecEntity): rba_ArxmlGen_ExecEntityPeriod=0.01
      CanSM
        CanSM_Au8_app (rba_ArxmlGen_ApplDataType): rba_ArxmlGen_ApplDataTypeNumElements=2
        CanSM_Au8_impl (rba_ArxmlGen_ImplDataType): rba_ArxmlGen_ImplDataTypeNumElements=2
        CanSM_Aboolean_app (rba_ArxmlGen_ApplDataType): rba_ArxmlGen_ApplDataTypeNumElements=2
        CanSM_Aboolean_impl (rba_ArxmlGen_ImplDataType): rba_ArxmlGen_ImplDataTypeNumElements=2
        CanSM_currBOR_State_a_Aenum_app (rba_ArxmlGen_ApplDataType): rba_ArxmlGen_ApplDataTypeNumElements=2
        CanSM_currBOR_State_a_Aenum_impl (rba_ArxmlGen_ImplDataType): rba_ArxmlGen_ImplDataTypeNumElements=2
        CanSM_currComM_Mode_a_Aenum_app (rba_ArxmlGen_ApplDataType): rba_ArxmlGen_ApplDataTypeNumElements=2
        CanSM_currComM_Mode_a_Aenum_impl (rba_ArxmlGen_ImplDataType): rba_ArxmlGen_ImplDataTypeNumElements=2
        CanSM_TimerConfig_ast_Astruct_app (rba_ArxmlGen_ApplDataType): rba_ArxmlGen_ApplDataTypeNumElements=2
        CanSM_TimerConfig_ast_Astruct_impl (rba_ArxmlGen_ImplDataType): rba_ArxmlGen_ImplDataTypeNumElements=2
        BSWSE_MainFunction (rba_ArxmlGen_ExecEntity): rba_ArxmlGen_ExecEntityPeriod=0.001
      ComM
        ComM_UserStruct_Array_App (rba_ArxmlGen_ApplDataType): rba_ArxmlGen_ApplDataTypeNumElements=2
        ComM_UserStruct_Array_Impl (rba_ArxmlGen_ImplDataType): rba_ArxmlGen_ImplDataTypeNumElements=2
        ComM_ChannelStruct_Array_App (rba_ArxmlGen_ApplDataType): rba_ArxmlGen_ApplDataTypeNumElements=2
        ComM_ChannelStruct_Array_Impl (rba_ArxmlGen_ImplDataType): rba_ArxmlGen_ImplDataTypeNumElements=2
        BSWSE_MainFunction_ComMChannel_Can_Network_Channel (rba_ArxmlGen_ExecEntity):
          rba_ArxmlGen_ExecEntityCategory = Schedulable
          rba_ArxmlGen_ExecEntityPeriod = 0.01
          rba_ArxmlGen_ExecEntityImplEntryRef = ComM_MainFunction_ComMChannel_Can_Network_Channel
        BSWSE_MainFunction_ComMChannel_Can_Network_XCP_Channel (rba_ArxmlGen_ExecEntity):
          rba_ArxmlGen_ExecEntityCategory = Schedulable
          rba_ArxmlGen_ExecEntityPeriod = 0.01
          rba_ArxmlGen_ExecEntityImplEntryRef = ComM_MainFunction_ComMChannel_Can_Network_XCP_Channel
      Xcp: rba_ArxmlGen_CompVersionSw=6.0.0
        4 x rba_ArxmlGen_ExecEntity, all with rba_ArxmlGen_ExecEntityCategory=Schedulable:
          BSWSE_MainFunction: rba_ArxmlGen_ExecEntityPeriod=0.01, rba_ArxmlGen_ExecEntityImplEntryRef=Xcp_MainFunction
          BSWSE_EventChannel_10ms: rba_ArxmlGen_ExecEntityPeriod=0.01, rba_ArxmlGen_ExecEntityImplEntryRef=Xcp_EventChannel_10ms
          BSWSE_EventChannel_100ms: rba_ArxmlGen_ExecEntityPeriod=0.1, rba_ArxmlGen_ExecEntityImplEntryRef=Xcp_EventChannel_100ms
          BSWSE_EventChannel_50ms: rba_ArxmlGen_ExecEntityPeriod=0.05, rba_ArxmlGen_ExecEntityImplEntryRef=Xcp_EventChannel_50ms
      CanIf
        CanIf_ControllerState_Astruct_impl (rba_ArxmlGen_ImplDataType):
          rba_ArxmlGen_ImplDataTypeCategory = Array
          rba_ArxmlGen_ImplDataTypeLongName = Implementation datatype for array of struct
          rba_ArxmlGen_ImplDataTypeNumElements = 2
          CanIf_struct_impl (rba_ArxmlGen_ImplDataTypeSub): rba_ArxmlGen_ImplDataTypeSubOwnRef=CanIf_ControllerStateType_struct_impl
        CanIf_ControllerState_Astruct_app (rba_ArxmlGen_ApplDataType):
          rba_ArxmlGen_ApplDataTypeCategory = Array
          rba_ArxmlGen_ApplDataTypeLongName = Structure datatype in CanIf
          rba_ArxmlGen_ApplDataTypeNumElements = 2
          rba_ArxmlGen_ApplDataTypeImplOwnRef = CanIf_ControllerState_Astruct_impl
          CanIf_ControllerStateType (rba_ArxmlGen_ApplDataTypeSub): rba_ArxmlGen_ApplDataTypeSubOwnRef=CanIf_ControllerStateType_struct_app
        CanIf_Prv_ControllerState_ast (rba_ArxmlGen_Measurement):
          rba_ArxmlGen_MeasCategory = Array
          rba_ArxmlGen_MeasDispFormat = %5.0f
          rba_ArxmlGen_MeasLongName = Can Interface controller State
          rba_ArxmlGen_MeasAddrMethodRef = INTERNAL_VAR_CLEARED
          rba_ArxmlGen_MeasApplDataTypeOwnRef = CanIf_ControllerState_Astruct_app
        CanIf_NotifStatusType_Aenum_impl (rba_ArxmlGen_ImplDataType):
          rba_ArxmlGen_ImplDataTypeCategory = Array
          rba_ArxmlGen_ImplDataTypeLongName = implementation data type for array of enum
          rba_ArxmlGen_ImplDataTypeNumElements = 10
          CanIf_Enum_impl (rba_ArxmlGen_ImplDataTypeSub): rba_ArxmlGen_ImplDataTypeSubOwnRef=CanIf_NotifStatusType_Enum_impl
        CanIf_NotifStatusType_Aenum_app (rba_ArxmlGen_ApplDataType):
          rba_ArxmlGen_ApplDataTypeCategory = Array
          rba_ArxmlGen_ApplDataTypeLongName = application data type for array of enum
          rba_ArxmlGen_ApplDataTypeNumElements = 10
          rba_ArxmlGen_ApplDataTypeImplOwnRef = CanIf_NotifStatusType_Aenum_impl
          CanIf_NotifStatusType (rba_ArxmlGen_ApplDataTypeSub): rba_ArxmlGen_ApplDataTypeSubOwnRef=CanIf_NotifStatusType_Enum_app
        CanIf_Prv_TxNotification_aen (rba_ArxmlGen_Measurement):
          rba_ArxmlGen_MeasCategory = Array
          rba_ArxmlGen_MeasDispFormat = %5.0f
          rba_ArxmlGen_MeasLongName = Can Interface Transmit Notification
          rba_ArxmlGen_MeasAddrMethodRef = INTERNAL_VAR_CLEARED
          rba_ArxmlGen_MeasApplDataTypeOwnRef = CanIf_NotifStatusType_Aenum_app
      Com
        Com_SigBuf_au8_impl (rba_ArxmlGen_ImplDataType):
          rba_ArxmlGen_ImplDataTypeCategory = Array
          rba_ArxmlGen_ImplDataTypeNumElements = 11
          rba_ArxmlGen_ImplDataTypeLongName = Implementation data type for Signals of type - uint8,sint8,boolean,uint8_n
          Com_Subimpl_u8 (rba_ArxmlGen_ImplDataTypeSub): rba_ArxmlGen_ImplDataTypeSubOwnRef=Com_impl_u8
        Com_SigBuf_au8 (rba_ArxmlGen_ApplDataType):
          rba_ArxmlGen_ApplDataTypeCategory = Array
          rba_ArxmlGen_ApplDataTypeNumElements = 11
          rba_ArxmlGen_ApplDataTypeLongName = Application data type for Signals of type - uint8,sint8,boolean,uint8_n
          rba_ArxmlGen_ApplDataTypeImplOwnRef = Com_SigBuf_au8_impl
          Com_Subapp_u8 (rba_ArxmlGen_ApplDataTypeSub): rba_ArxmlGen_ApplDataTypeSubOwnRef=Com_uint8
        Com_SigBuf_au16_impl (rba_ArxmlGen_ImplDataType):
          rba_ArxmlGen_ImplDataTypeCategory = Array
          rba_ArxmlGen_ImplDataTypeNumElements = 2
          rba_ArxmlGen_ImplDataTypeLongName = Implementation data type for Signals of type - uint16,sint16
          Com_Subimpl_u16 (rba_ArxmlGen_ImplDataTypeSub): rba_ArxmlGen_ImplDataTypeSubOwnRef=Com_impl_u16
        Com_SigBuf_au16 (rba_ArxmlGen_ApplDataType):
          rba_ArxmlGen_ApplDataTypeCategory = Array
          rba_ArxmlGen_ApplDataTypeNumElements = 2
          rba_ArxmlGen_ApplDataTypeLongName = Application data type for Signals of type - uint16,sint16
          rba_ArxmlGen_ApplDataTypeImplOwnRef = Com_SigBuf_au16_impl
          Com_Subapp_u16 (rba_ArxmlGen_ApplDataTypeSub): rba_ArxmlGen_ApplDataTypeSubOwnRef=Com_uint16
        Com_SigType_u8 (rba_ArxmlGen_Measurement):
          rba_ArxmlGen_MeasCategory = Array
          rba_ArxmlGen_MeasDispFormat = %5.0f
          rba_ArxmlGen_MeasLongName = Measurement variable for Signals of type - uint8,sint8,boolean,uint8_n. To refer Individual element in the Buffer array, Fetch Buffer Index from Com_PBcfg.c for each signal.
          rba_ArxmlGen_MeasAddrMethodRef = INTERNAL_VAR_CLEARED
          rba_ArxmlGen_MeasApplDataTypeOwnRef = Com_SigBuf_au8
        Com_SigType_u16 (rba_ArxmlGen_Measurement):
          rba_ArxmlGen_MeasCategory = Array
          rba_ArxmlGen_MeasDispFormat = %5.0f
          rba_ArxmlGen_MeasLongName = Measurement variable for Signals of type - uint16,sint16. To refer Individual element in the Buffer array, Fetch Buffer Index from Com_PBcfg.c for each signal.
          rba_ArxmlGen_MeasAddrMethodRef = INTERNAL_VAR_CLEARED
          rba_ArxmlGen_MeasApplDataTypeOwnRef = Com_SigBuf_au16
        3 x rba_ArxmlGen_ImplDataType, all with rba_ArxmlGen_ImplDataTypeCategory=Array:
          Com_implDataType_au8_Size1: rba_ArxmlGen_ImplDataTypeLongName=Implementation data type for Ipdu buffer of Size1, rba_ArxmlGen_ImplDataTypeNumElements=1
            Com_Subimpl1 (rba_ArxmlGen_ImplDataTypeSub): rba_ArxmlGen_ImplDataTypeSubOwnRef=Com_impl_u8
          Com_implDataType_au8_Size7: rba_ArxmlGen_ImplDataTypeLongName=Implementation data type for Ipdu buffer of Size7, rba_ArxmlGen_ImplDataTypeNumElements=7
            Com_Subimpl7 (rba_ArxmlGen_ImplDataTypeSub): rba_ArxmlGen_ImplDataTypeSubOwnRef=Com_impl_u8
          Com_implDataType_au8_Size8: rba_ArxmlGen_ImplDataTypeLongName=Implementation data type for Ipdu buffer of Size8, rba_ArxmlGen_ImplDataTypeNumElements=8
            Com_Subimpl8 (rba_ArxmlGen_ImplDataTypeSub): rba_ArxmlGen_ImplDataTypeSubOwnRef=Com_impl_u8
        3 x rba_ArxmlGen_ApplDataType, all with rba_ArxmlGen_ApplDataTypeCategory=Array:
          Com_applDataType_au8_Size1: rba_ArxmlGen_ApplDataTypeLongName=Application data type for Ipdu buffer of Size1, rba_ArxmlGen_ApplDataTypeNumElements=1, rba_ArxmlGen_ApplDataTypeImplOwnRef=Com_implDataType_au8_Size1
            Com_Subapp1 (rba_ArxmlGen_ApplDataTypeSub): rba_ArxmlGen_ApplDataTypeSubOwnRef=Com_uint8
          Com_applDataType_au8_Size7: rba_ArxmlGen_ApplDataTypeLongName=Application data type for Ipdu buffer of Size7, rba_ArxmlGen_ApplDataTypeNumElements=7, rba_ArxmlGen_ApplDataTypeImplOwnRef=Com_implDataType_au8_Size7
            Com_Subapp7 (rba_ArxmlGen_ApplDataTypeSub): rba_ArxmlGen_ApplDataTypeSubOwnRef=Com_uint8
          Com_applDataType_au8_Size8: rba_ArxmlGen_ApplDataTypeLongName=Application data type for Ipdu buffer of Size8, rba_ArxmlGen_ApplDataTypeNumElements=8, rba_ArxmlGen_ApplDataTypeImplOwnRef=Com_implDataType_au8_Size8
            Com_Subapp8 (rba_ArxmlGen_ApplDataTypeSub): rba_ArxmlGen_ApplDataTypeSubOwnRef=Com_uint8
        9 x rba_ArxmlGen_Measurement, all with rba_ArxmlGen_MeasCategory=Array, rba_ArxmlGen_MeasDispFormat=%5.0f, rba_ArxmlGen_MeasAddrMethodRef=INTERNAL_VAR_CLEARED:
          Com_IpduBuf_MCU_01_Can_Network_CANNODE_0: rba_ArxmlGen_MeasLongName=Tx Ipdu buffer of IPdu -MCU_01_Can_Network_CANNODE_0- as a Measurement parameter, rba_ArxmlGen_MeasApplDataTypeOwnRef=Com_applDataType_au8_Size8
          Com_IpduBuf_MCU_02_Can_Network_CANNODE_0: rba_ArxmlGen_MeasLongName=Tx Ipdu buffer of IPdu -MCU_02_Can_Network_CANNODE_0- as a Measurement parameter, rba_ArxmlGen_MeasApplDataTypeOwnRef=Com_applDataType_au8_Size8
          Com_IpduBuf_MCU_03_Can_Network_CANNODE_0: rba_ArxmlGen_MeasLongName=Tx Ipdu buffer of IPdu -MCU_03_Can_Network_CANNODE_0- as a Measurement parameter, rba_ArxmlGen_MeasApplDataTypeOwnRef=Com_applDataType_au8_Size7
          Com_IpduBuf_MCU_04_Can_Network_CANNODE_0: rba_ArxmlGen_MeasLongName=Tx Ipdu buffer of IPdu -MCU_04_Can_Network_CANNODE_0- as a Measurement parameter, rba_ArxmlGen_MeasApplDataTypeOwnRef=Com_applDataType_au8_Size8
          Com_LocalBuf_HCU_01_Can_Network_CANNODE_0: rba_ArxmlGen_MeasLongName=Rx Local Ipdu buffer of IPdu -HCU_01_Can_Network_CANNODE_0- as a Measurement parameter, rba_ArxmlGen_MeasApplDataTypeOwnRef=Com_applDataType_au8_Size8
          Com_LocalBuf_HCU_{02..05}_Can_Network_CANNODE_0: rba_ArxmlGen_MeasLongName=Rx Local Ipdu buffer of IPdu -HCU_{02..05}_Can_Network_CANNODE_0- as a Measurement parameter, rba_ArxmlGen_MeasApplDataTypeOwnRef=Com_applDataType_au8_Size1
        BSWSE_MainFunctionRx (rba_ArxmlGen_ExecEntity): rba_ArxmlGen_ExecEntityPeriod=0.01
        BSWSE_MainFunctionTx (rba_ArxmlGen_ExecEntity): rba_ArxmlGen_ExecEntityPeriod=0.01
  module config WdgM
    WdgMGeneral
      WdgMSupervisedEntity_Alive_Supervision_Entity1 (WdgMSupervisedEntity): WdgMSupervisedEntityId=0
        WdgMCheckpoint_Alive_Supervision_Entity1 (WdgMCheckpoint): WdgMCheckpointId=0
      WdgMWatchdog: WdgMWatchdogName=WdgIfConf_WdgIfDevice_WdgIfDevice
    WdgMConfigSet
      WdgMMode_FastMode (WdgMMode): WdgMModeId=0
      WdgMMode_SlowMode (WdgMMode): WdgMModeId=1
  module config rba_DiagLib
    3 x rba_DiagLib_DataStructure, all with rba_DiagLib_RangeCheckMacro=DEM_ASSERT_RANGECHECK:
      Dem_Cfg_Dtc: rba_DiagLib_IndexType=Dem_DtcIdType, rba_DiagLib_InvalidIndex=true
        7 x rba_DiagLib_Attribute, all with rba_DiagLib_RequiresAtomicAccess=false:
          Kind: rba_DiagLib_BitSize=2, rba_DiagLib_Type=Dem_DTCKindType
          Severity: rba_DiagLib_BitSize=8, rba_DiagLib_Type=Dem_DTCSeverityType
          Nv_Storage: rba_DiagLib_BitSize=1, rba_DiagLib_Type=boolean
          Func_Unit: rba_DiagLib_BitSize=1, rba_DiagLib_Type=uint8
          DtcCode_Is_Index: rba_DiagLib_BitSize=1, rba_DiagLib_Type=boolean
          Obd_DtcCode: rba_DiagLib_BitSize=16, rba_DiagLib_Type=Dem_DtcCodeType, rba_DiagLib_ReturnValueIfDisabled=DEM_INVALID_DTC
          DtcCode: rba_DiagLib_BitSize=24, rba_DiagLib_Type=Dem_DtcCodeType
        4 x rba_DiagLib_DataItem:
          DemDTC_C110117
            7 x rba_DiagLib_AttributeValue:
              DemDTC_C110117__Kind: rba_DiagLib_Value=DEM_DTC_KIND_ALL_DTCS, rba_DiagLib_AttributeRef=Kind
              DemDTC_C110117__Severity: rba_DiagLib_Value=DEM_SEVERITY_CHECK_IMMEDIATELY, rba_DiagLib_AttributeRef=Severity
              DemDTC_C110117__Nv_Storage: rba_DiagLib_Value=TRUE, rba_DiagLib_AttributeRef=Nv_Storage
              DemDTC_C110117__Func_Unit: rba_DiagLib_Value=0x00, rba_DiagLib_AttributeRef=Func_Unit
              DemDTC_C110117__DtcCode_Is_Index: rba_DiagLib_Value=FALSE, rba_DiagLib_AttributeRef=DtcCode_Is_Index
              DemDTC_C110117__Obd_DtcCode: rba_DiagLib_Value=0x00, rba_DiagLib_AttributeRef=Obd_DtcCode
              DemDTC_C110117__DtcCode: rba_DiagLib_Value=0xD0100, rba_DiagLib_AttributeRef=DtcCode
          DemDTC_C110216
            7 x rba_DiagLib_AttributeValue:
              DemDTC_C110216__Kind: rba_DiagLib_Value=DEM_DTC_KIND_ALL_DTCS, rba_DiagLib_AttributeRef=Kind
              DemDTC_C110216__Severity: rba_DiagLib_Value=DEM_SEVERITY_CHECK_IMMEDIATELY, rba_DiagLib_AttributeRef=Severity
              DemDTC_C110216__Nv_Storage: rba_DiagLib_Value=TRUE, rba_DiagLib_AttributeRef=Nv_Storage
              DemDTC_C110216__Func_Unit: rba_DiagLib_Value=0x00, rba_DiagLib_AttributeRef=Func_Unit
              DemDTC_C110216__DtcCode_Is_Index: rba_DiagLib_Value=FALSE, rba_DiagLib_AttributeRef=DtcCode_Is_Index
              DemDTC_C110216__Obd_DtcCode: rba_DiagLib_Value=0x00, rba_DiagLib_AttributeRef=Obd_DtcCode
              DemDTC_C110216__DtcCode: rba_DiagLib_Value=0xD0200, rba_DiagLib_AttributeRef=DtcCode
          DemDTC_C153364
            7 x rba_DiagLib_AttributeValue:
              DemDTC_C153364__Kind: rba_DiagLib_Value=DEM_DTC_KIND_ALL_DTCS, rba_DiagLib_AttributeRef=Kind
              DemDTC_C153364__Severity: rba_DiagLib_Value=DEM_SEVERITY_CHECK_IMMEDIATELY, rba_DiagLib_AttributeRef=Severity
              DemDTC_C153364__Nv_Storage: rba_DiagLib_Value=TRUE, rba_DiagLib_AttributeRef=Nv_Storage
              DemDTC_C153364__Func_Unit: rba_DiagLib_Value=0x00, rba_DiagLib_AttributeRef=Func_Unit
              DemDTC_C153364__DtcCode_Is_Index: rba_DiagLib_Value=FALSE, rba_DiagLib_AttributeRef=DtcCode_Is_Index
              DemDTC_C153364__Obd_DtcCode: rba_DiagLib_Value=0x00, rba_DiagLib_AttributeRef=Obd_DtcCode
              DemDTC_C153364__DtcCode: rba_DiagLib_Value=0xD0300, rba_DiagLib_AttributeRef=DtcCode
          DemDTC_CANBusOff
            7 x rba_DiagLib_AttributeValue:
              DemDTC_CANBusOff__Kind: rba_DiagLib_Value=DEM_DTC_KIND_ALL_DTCS, rba_DiagLib_AttributeRef=Kind
              DemDTC_CANBusOff__Severity: rba_DiagLib_Value=DEM_SEVERITY_CHECK_IMMEDIATELY, rba_DiagLib_AttributeRef=Severity
              DemDTC_CANBusOff__Nv_Storage: rba_DiagLib_Value=TRUE, rba_DiagLib_AttributeRef=Nv_Storage
              DemDTC_CANBusOff__Func_Unit: rba_DiagLib_Value=0x00, rba_DiagLib_AttributeRef=Func_Unit
              DemDTC_CANBusOff__DtcCode_Is_Index: rba_DiagLib_Value=FALSE, rba_DiagLib_AttributeRef=DtcCode_Is_Index
              DemDTC_CANBusOff__Obd_DtcCode: rba_DiagLib_Value=0x00, rba_DiagLib_AttributeRef=Obd_DtcCode
              DemDTC_CANBusOff__DtcCode: rba_DiagLib_Value=0xD0400, rba_DiagLib_AttributeRef=DtcCode
      Dem_Cfg_OperationCycle: rba_DiagLib_IndexType=Dem_OperationCycleIdType
        DependentCycleMask (rba_DiagLib_Attribute): rba_DiagLib_BitSize=1, rba_DiagLib_Type=Dem_OperationCycleList, rba_DiagLib_RequiresAtomicAccess=false
        IsAllowedToBeStartedDirectly (rba_DiagLib_Attribute): rba_DiagLib_BitSize=1, rba_DiagLib_Type=boolean, rba_DiagLib_RequiresAtomicAccess=false
        DemOperationCycle_0 (rba_DiagLib_DataItem)
          DemOperationCycle_0__DependentCycleMask (rba_DiagLib_AttributeValue): rba_DiagLib_Value=0x0, rba_DiagLib_AttributeRef=DependentCycleMask
          DemOperationCycle_0__IsAllowedToBeStartedDirectly (rba_DiagLib_AttributeValue): rba_DiagLib_Value=TRUE, rba_DiagLib_AttributeRef=IsAllowedToBeStartedDirectly
      Dem_EvtParam: rba_DiagLib_IndexType=Dem_EventIdType, rba_DiagLib_AssertIsLockedMacro=DEM_ASSERT_ISLOCKED, rba_DiagLib_InvalidIndex=true, rba_DiagLib_InvalidIndex=true
        29 x rba_DiagLib_Attribute, all with rba_DiagLib_RequiresAtomicAccess=false:
          DebounceBehavior: rba_DiagLib_BitSize=1, rba_DiagLib_Type=uint8, rba_DiagLib_IdenticalValueOfAllDataItems=DEM_DEBOUNCE_FREEZE
          IsRecoverable: rba_DiagLib_BitSize=1, rba_DiagLib_Type=boolean, rba_DiagLib_IdenticalValueOfAllDataItems=DEM_RECOV
          StoreTestFailedToNextOC: rba_DiagLib_BitSize=1, rba_DiagLib_Type=boolean, rba_DiagLib_IdenticalValueOfAllDataItems=TRUE
          RequestsWarningIndicator: rba_DiagLib_BitSize=1, rba_DiagLib_Type=boolean, rba_DiagLib_ReturnValueIfDisabled=FALSE, rba_DiagLib_IdenticalValueOfAllDataItems=0uL
          Category: rba_DiagLib_BitSize=1, rba_DiagLib_Type=Dem_EventCategoryType, rba_DiagLib_ReturnValueIfDisabled=0, rba_DiagLib_IdenticalValueOfAllDataItems=DemConf_DemEventCategory_INVALIDCATEGORY
          EventIsStoredInPrimary: rba_DiagLib_BitSize=1, rba_DiagLib_Type=boolean, rba_DiagLib_DataContainerRef=DataContainer_2
          EventIsStoredInSecondary: rba_DiagLib_BitSize=1, rba_DiagLib_Type=boolean, rba_DiagLib_IdenticalValueOfAllDataItems=FALSE
          EventIsStoredInMirror: rba_DiagLib_BitSize=1, rba_DiagLib_Type=boolean, rba_DiagLib_IdenticalValueOfAllDataItems=FALSE
          AgingAllowed: rba_DiagLib_BitSize=1, rba_DiagLib_Type=boolean, rba_DiagLib_DataContainerRef=DataContainer_2
          IsGlobalFDCCallbackConfigured: rba_DiagLib_BitSize=1, rba_DiagLib_Type=boolean, rba_DiagLib_ReturnValueIfDisabled=FALSE, rba_DiagLib_ReturnValueIfDisabled=FALSE, rba_DiagLib_IdenticalValueOfAllDataItems=FALSE
          TriggersDataChangedCallback: rba_DiagLib_BitSize=1, rba_DiagLib_Type=boolean, rba_DiagLib_ReturnValueIfDisabled=FALSE, rba_DiagLib_ReturnValueIfDisabled=FALSE, rba_DiagLib_IdenticalValueOfAllDataItems=FALSE
          Significance: rba_DiagLib_BitSize=1, rba_DiagLib_Type=uint8, rba_DiagLib_DataContainerRef=DataContainer_2
          OperationCycleID: rba_DiagLib_BitSize=1, rba_DiagLib_Type=uint8, rba_DiagLib_IdenticalValueOfAllDataItems=DemConf_DemOperationCycle_DemOperationCycle_0
          AgingCycleID: rba_DiagLib_BitSize=1, rba_DiagLib_Type=uint8, rba_DiagLib_IdenticalValueOfAllDataItems=DemConf_DemOperationCycle_DemOperationCycle_0
          FailureCycleID: rba_DiagLib_BitSize=1, rba_DiagLib_Type=uint8, rba_DiagLib_IdenticalValueOfAllDataItems=DemConf_DemOperationCycle_DemOperationCycle_0
          InitialSuppressionStatus: rba_DiagLib_BitSize=1, rba_DiagLib_Type=boolean, rba_DiagLib_DataContainerRef=DataContainer_2
          DebounceMethodIndex: rba_DiagLib_BitSize=1, rba_DiagLib_Type=uint8, rba_DiagLib_IdenticalValueOfAllDataItems=DEM_DEBMETH_IDX_ARCTRBASECLASS
          DebounceParamSettingIndex: rba_DiagLib_BitSize=3, rba_DiagLib_Type=uint16, rba_DiagLib_DataContainerRef=DataContainer_2
          BufferTimeSFB: rba_DiagLib_BitSize=1, rba_DiagLib_Type=uint8, rba_DiagLib_ReturnValueIfDisabled=0, rba_DiagLib_IdenticalValueOfAllDataItems=0u
          AgingThreshold: rba_DiagLib_BitSize=8, rba_DiagLib_Type=uint8, rba_DiagLib_DataContainerRef=DataContainer_1
          AgingThresholdForTFSLC: rba_DiagLib_BitSize=1, rba_DiagLib_Type=uint8, rba_DiagLib_IdenticalValueOfAllDataItems=0u
          FailureConfirmationThreshold: rba_DiagLib_BitSize=1, rba_DiagLib_Type=uint8, rba_DiagLib_IdenticalValueOfAllDataItems=1u
          EventPriority: rba_DiagLib_BitSize=3, rba_DiagLib_Type=uint8, rba_DiagLib_DataContainerRef=DataContainer_2
          MaxNumberFreezeFrameRecords: rba_DiagLib_BitSize=2, rba_DiagLib_Type=uint8, rba_DiagLib_DataContainerRef=DataContainer_2
          StorageConditions: rba_DiagLib_BitSize=1, rba_DiagLib_Type=Dem_StoCoList, rba_DiagLib_ReturnValueIfDisabled=0
          EnableConditions: rba_DiagLib_BitSize=1, rba_DiagLib_Type=Dem_EnCoList, rba_DiagLib_ReturnValueIfDisabled=0
          CallbackEventStatusChangedIndex: rba_DiagLib_BitSize=1, rba_DiagLib_Type=uint8, rba_DiagLib_ReturnValueIfDisabled=FALSE, rba_DiagLib_IdenticalValueOfAllDataItems=0u
          CallbackClearAllowed: rba_DiagLib_BitSize=32, rba_DiagLib_Type=Dem_EvtClearAllowedFncType, rba_DiagLib_ReturnValueIfDisabled=NULL_PTR, rba_DiagLib_IdenticalValueOfAllDataItems=NULL_PTR
          ClearAllowedBehavior: rba_DiagLib_BitSize=1, rba_DiagLib_Type=uint8, rba_DiagLib_ReturnValueIfDisabled=DEM_NO_STATUS_BYTE_CHANGE, rba_DiagLib_IdenticalValueOfAllDataItems=DEM_NO_STATUS_BYTE_CHANGE
        5 x rba_DiagLib_DataItem:
          DemEventParameter_C110117
            29 x rba_DiagLib_AttributeValue:
              DemEventParameter_C110117__DebounceBehavior: rba_DiagLib_Value=DEM_DEBOUNCE_FREEZE, rba_DiagLib_AttributeRef=DebounceBehavior
              DemEventParameter_C110117__IsRecoverable: rba_DiagLib_Value=DEM_RECOV, rba_DiagLib_AttributeRef=IsRecoverable
              DemEventParameter_C110117__StoreTestFailedToNextOC: rba_DiagLib_Value=TRUE, rba_DiagLib_AttributeRef=StoreTestFailedToNextOC
              DemEventParameter_C110117__RequestsWarningIndicator: rba_DiagLib_Value=0uL, rba_DiagLib_AttributeRef=RequestsWarningIndicator
              DemEventParameter_C110117__Category: rba_DiagLib_Value=DemConf_DemEventCategory_INVALIDCATEGORY, rba_DiagLib_AttributeRef=Category
              DemEventParameter_C110117__EventIsStoredInPrimary: rba_DiagLib_Value=TRUE, rba_DiagLib_AttributeRef=EventIsStoredInPrimary
              DemEventParameter_C110117__EventIsStoredInSecondary: rba_DiagLib_Value=FALSE, rba_DiagLib_AttributeRef=EventIsStoredInSecondary
              DemEventParameter_C110117__EventIsStoredInMirror: rba_DiagLib_Value=FALSE, rba_DiagLib_AttributeRef=EventIsStoredInMirror
              DemEventParameter_C110117__AgingAllowed: rba_DiagLib_Value=1uL, rba_DiagLib_AttributeRef=AgingAllowed
              DemEventParameter_C110117__IsGlobalFDCCallbackConfigured: rba_DiagLib_Value=FALSE, rba_DiagLib_AttributeRef=IsGlobalFDCCallbackConfigured
              DemEventParameter_C110117__TriggersDataChangedCallback: rba_DiagLib_Value=FALSE, rba_DiagLib_AttributeRef=TriggersDataChangedCallback
              DemEventParameter_C110117__Significance: rba_DiagLib_Value=1uL, rba_DiagLib_AttributeRef=Significance
              DemEventParameter_C110117__OperationCycleID: rba_DiagLib_Value=DemConf_DemOperationCycle_DemOperationCycle_0, rba_DiagLib_AttributeRef=OperationCycleID
              DemEventParameter_C110117__AgingCycleID: rba_DiagLib_Value=DemConf_DemOperationCycle_DemOperationCycle_0, rba_DiagLib_AttributeRef=AgingCycleID
              DemEventParameter_C110117__FailureCycleID: rba_DiagLib_Value=DemConf_DemOperationCycle_DemOperationCycle_0, rba_DiagLib_AttributeRef=FailureCycleID
              DemEventParameter_C110117__InitialSuppressionStatus: rba_DiagLib_Value=0uL, rba_DiagLib_AttributeRef=InitialSuppressionStatus
              DemEventParameter_C110117__DebounceMethodIndex: rba_DiagLib_Value=DEM_DEBMETH_IDX_ARCTRBASECLASS, rba_DiagLib_AttributeRef=DebounceMethodIndex
              DemEventParameter_C110117__DebounceParamSettingIndex: rba_DiagLib_Value=DEM_DEBPARAM_IDX_DEMEVENTPARAMETER_C110117, rba_DiagLib_AttributeRef=DebounceParamSettingIndex
              DemEventParameter_C110117__BufferTimeSFB: rba_DiagLib_Value=0u, rba_DiagLib_AttributeRef=BufferTimeSFB
              DemEventParameter_C110117__AgingThreshold: rba_DiagLib_Value=40u, rba_DiagLib_AttributeRef=AgingThreshold
              DemEventParameter_C110117__AgingThresholdForTFSLC: rba_DiagLib_Value=0u, rba_DiagLib_AttributeRef=AgingThresholdForTFSLC
              DemEventParameter_C110117__FailureConfirmationThreshold: rba_DiagLib_Value=1u, rba_DiagLib_AttributeRef=FailureConfirmationThreshold
              DemEventParameter_C110117__EventPriority: rba_DiagLib_Value=1u, rba_DiagLib_AttributeRef=EventPriority
              DemEventParameter_C110117__MaxNumberFreezeFrameRecords: rba_DiagLib_Value=2u, rba_DiagLib_AttributeRef=MaxNumberFreezeFrameRecords
              DemEventParameter_C110117__StorageConditions: rba_DiagLib_Value=DEM_STOCO_DemEventParameter_C110117, rba_DiagLib_AttributeRef=StorageConditions
              DemEventParameter_C110117__EnableConditions: rba_DiagLib_Value=DEM_ENCO_DemEventParameter_C110117, rba_DiagLib_AttributeRef=EnableConditions
              DemEventParameter_C110117__CallbackEventStatusChangedIndex: rba_DiagLib_Value=0u, rba_DiagLib_AttributeRef=CallbackEventStatusChangedIndex
              DemEventParameter_C110117__CallbackClearAllowed: rba_DiagLib_Value=NULL_PTR, rba_DiagLib_AttributeRef=CallbackClearAllowed
              DemEventParameter_C110117__ClearAllowedBehavior: rba_DiagLib_Value=DEM_NO_STATUS_BYTE_CHANGE, rba_DiagLib_AttributeRef=ClearAllowedBehavior
          DemEventParameter_C110216
            29 x rba_DiagLib_AttributeValue:
              DemEventParameter_C110216__DebounceBehavior: rba_DiagLib_Value=DEM_DEBOUNCE_FREEZE, rba_DiagLib_AttributeRef=DebounceBehavior
              DemEventParameter_C110216__IsRecoverable: rba_DiagLib_Value=DEM_RECOV, rba_DiagLib_AttributeRef=IsRecoverable
              DemEventParameter_C110216__StoreTestFailedToNextOC: rba_DiagLib_Value=TRUE, rba_DiagLib_AttributeRef=StoreTestFailedToNextOC
              DemEventParameter_C110216__RequestsWarningIndicator: rba_DiagLib_Value=0uL, rba_DiagLib_AttributeRef=RequestsWarningIndicator
              DemEventParameter_C110216__Category: rba_DiagLib_Value=DemConf_DemEventCategory_INVALIDCATEGORY, rba_DiagLib_AttributeRef=Category
              DemEventParameter_C110216__EventIsStoredInPrimary: rba_DiagLib_Value=TRUE, rba_DiagLib_AttributeRef=EventIsStoredInPrimary
              DemEventParameter_C110216__EventIsStoredInSecondary: rba_DiagLib_Value=FALSE, rba_DiagLib_AttributeRef=EventIsStoredInSecondary
              DemEventParameter_C110216__EventIsStoredInMirror: rba_DiagLib_Value=FALSE, rba_DiagLib_AttributeRef=EventIsStoredInMirror
              DemEventParameter_C110216__AgingAllowed: rba_DiagLib_Value=1uL, rba_DiagLib_AttributeRef=AgingAllowed
              DemEventParameter_C110216__IsGlobalFDCCallbackConfigured: rba_DiagLib_Value=FALSE, rba_DiagLib_AttributeRef=IsGlobalFDCCallbackConfigured
              DemEventParameter_C110216__TriggersDataChangedCallback: rba_DiagLib_Value=FALSE, rba_DiagLib_AttributeRef=TriggersDataChangedCallback
              DemEventParameter_C110216__Significance: rba_DiagLib_Value=1uL, rba_DiagLib_AttributeRef=Significance
              DemEventParameter_C110216__OperationCycleID: rba_DiagLib_Value=DemConf_DemOperationCycle_DemOperationCycle_0, rba_DiagLib_AttributeRef=OperationCycleID
              DemEventParameter_C110216__AgingCycleID: rba_DiagLib_Value=DemConf_DemOperationCycle_DemOperationCycle_0, rba_DiagLib_AttributeRef=AgingCycleID
              DemEventParameter_C110216__FailureCycleID: rba_DiagLib_Value=DemConf_DemOperationCycle_DemOperationCycle_0, rba_DiagLib_AttributeRef=FailureCycleID
              DemEventParameter_C110216__InitialSuppressionStatus: rba_DiagLib_Value=0uL, rba_DiagLib_AttributeRef=InitialSuppressionStatus
              DemEventParameter_C110216__DebounceMethodIndex: rba_DiagLib_Value=DEM_DEBMETH_IDX_ARCTRBASECLASS, rba_DiagLib_AttributeRef=DebounceMethodIndex
              DemEventParameter_C110216__DebounceParamSettingIndex: rba_DiagLib_Value=DEM_DEBPARAM_IDX_DEMEVENTPARAMETER_C110216, rba_DiagLib_AttributeRef=DebounceParamSettingIndex
              DemEventParameter_C110216__BufferTimeSFB: rba_DiagLib_Value=0u, rba_DiagLib_AttributeRef=BufferTimeSFB
              DemEventParameter_C110216__AgingThreshold: rba_DiagLib_Value=40u, rba_DiagLib_AttributeRef=AgingThreshold
              DemEventParameter_C110216__AgingThresholdForTFSLC: rba_DiagLib_Value=0u, rba_DiagLib_AttributeRef=AgingThresholdForTFSLC
              DemEventParameter_C110216__FailureConfirmationThreshold: rba_DiagLib_Value=1u, rba_DiagLib_AttributeRef=FailureConfirmationThreshold
              DemEventParameter_C110216__EventPriority: rba_DiagLib_Value=2u, rba_DiagLib_AttributeRef=EventPriority
              DemEventParameter_C110216__MaxNumberFreezeFrameRecords: rba_DiagLib_Value=2u, rba_DiagLib_AttributeRef=MaxNumberFreezeFrameRecords
              DemEventParameter_C110216__StorageConditions: rba_DiagLib_Value=DEM_STOCO_DemEventParameter_C110216, rba_DiagLib_AttributeRef=StorageConditions
              DemEventParameter_C110216__EnableConditions: rba_DiagLib_Value=DEM_ENCO_DemEventParameter_C110216, rba_DiagLib_AttributeRef=EnableConditions
              DemEventParameter_C110216__CallbackEventStatusChangedIndex: rba_DiagLib_Value=0u, rba_DiagLib_AttributeRef=CallbackEventStatusChangedIndex
              DemEventParameter_C110216__CallbackClearAllowed: rba_DiagLib_Value=NULL_PTR, rba_DiagLib_AttributeRef=CallbackClearAllowed
              DemEventParameter_C110216__ClearAllowedBehavior: rba_DiagLib_Value=DEM_NO_STATUS_BYTE_CHANGE, rba_DiagLib_AttributeRef=ClearAllowedBehavior
          DemEventParameter_C153364
            29 x rba_DiagLib_AttributeValue:
              DemEventParameter_C153364__DebounceBehavior: rba_DiagLib_Value=DEM_DEBOUNCE_FREEZE, rba_DiagLib_AttributeRef=DebounceBehavior
              DemEventParameter_C153364__IsRecoverable: rba_DiagLib_Value=DEM_RECOV, rba_DiagLib_AttributeRef=IsRecoverable
              DemEventParameter_C153364__StoreTestFailedToNextOC: rba_DiagLib_Value=TRUE, rba_DiagLib_AttributeRef=StoreTestFailedToNextOC
              DemEventParameter_C153364__RequestsWarningIndicator: rba_DiagLib_Value=0uL, rba_DiagLib_AttributeRef=RequestsWarningIndicator
              DemEventParameter_C153364__Category: rba_DiagLib_Value=DemConf_DemEventCategory_INVALIDCATEGORY, rba_DiagLib_AttributeRef=Category
              DemEventParameter_C153364__EventIsStoredInPrimary: rba_DiagLib_Value=TRUE, rba_DiagLib_AttributeRef=EventIsStoredInPrimary
              DemEventParameter_C153364__EventIsStoredInSecondary: rba_DiagLib_Value=FALSE, rba_DiagLib_AttributeRef=EventIsStoredInSecondary
              DemEventParameter_C153364__EventIsStoredInMirror: rba_DiagLib_Value=FALSE, rba_DiagLib_AttributeRef=EventIsStoredInMirror
              DemEventParameter_C153364__AgingAllowed: rba_DiagLib_Value=1uL, rba_DiagLib_AttributeRef=AgingAllowed
              DemEventParameter_C153364__IsGlobalFDCCallbackConfigured: rba_DiagLib_Value=FALSE, rba_DiagLib_AttributeRef=IsGlobalFDCCallbackConfigured
              DemEventParameter_C153364__TriggersDataChangedCallback: rba_DiagLib_Value=FALSE, rba_DiagLib_AttributeRef=TriggersDataChangedCallback
              DemEventParameter_C153364__Significance: rba_DiagLib_Value=1uL, rba_DiagLib_AttributeRef=Significance
              DemEventParameter_C153364__OperationCycleID: rba_DiagLib_Value=DemConf_DemOperationCycle_DemOperationCycle_0, rba_DiagLib_AttributeRef=OperationCycleID
              DemEventParameter_C153364__AgingCycleID: rba_DiagLib_Value=DemConf_DemOperationCycle_DemOperationCycle_0, rba_DiagLib_AttributeRef=AgingCycleID
              DemEventParameter_C153364__FailureCycleID: rba_DiagLib_Value=DemConf_DemOperationCycle_DemOperationCycle_0, rba_DiagLib_AttributeRef=FailureCycleID
              DemEventParameter_C153364__InitialSuppressionStatus: rba_DiagLib_Value=0uL, rba_DiagLib_AttributeRef=InitialSuppressionStatus
              DemEventParameter_C153364__DebounceMethodIndex: rba_DiagLib_Value=DEM_DEBMETH_IDX_ARCTRBASECLASS, rba_DiagLib_AttributeRef=DebounceMethodIndex
              DemEventParameter_C153364__DebounceParamSettingIndex: rba_DiagLib_Value=DEM_DEBPARAM_IDX_DEMEVENTPARAMETER_C153364, rba_DiagLib_AttributeRef=DebounceParamSettingIndex
              DemEventParameter_C153364__BufferTimeSFB: rba_DiagLib_Value=0u, rba_DiagLib_AttributeRef=BufferTimeSFB
              DemEventParameter_C153364__AgingThreshold: rba_DiagLib_Value=40u, rba_DiagLib_AttributeRef=AgingThreshold
              DemEventParameter_C153364__AgingThresholdForTFSLC: rba_DiagLib_Value=0u, rba_DiagLib_AttributeRef=AgingThresholdForTFSLC
              DemEventParameter_C153364__FailureConfirmationThreshold: rba_DiagLib_Value=1u, rba_DiagLib_AttributeRef=FailureConfirmationThreshold
              DemEventParameter_C153364__EventPriority: rba_DiagLib_Value=3u, rba_DiagLib_AttributeRef=EventPriority
              DemEventParameter_C153364__MaxNumberFreezeFrameRecords: rba_DiagLib_Value=2u, rba_DiagLib_AttributeRef=MaxNumberFreezeFrameRecords
              DemEventParameter_C153364__StorageConditions: rba_DiagLib_Value=DEM_STOCO_DemEventParameter_C153364, rba_DiagLib_AttributeRef=StorageConditions
              DemEventParameter_C153364__EnableConditions: rba_DiagLib_Value=DEM_ENCO_DemEventParameter_C153364, rba_DiagLib_AttributeRef=EnableConditions
              DemEventParameter_C153364__CallbackEventStatusChangedIndex: rba_DiagLib_Value=0u, rba_DiagLib_AttributeRef=CallbackEventStatusChangedIndex
              DemEventParameter_C153364__CallbackClearAllowed: rba_DiagLib_Value=NULL_PTR, rba_DiagLib_AttributeRef=CallbackClearAllowed
              DemEventParameter_C153364__ClearAllowedBehavior: rba_DiagLib_Value=DEM_NO_STATUS_BYTE_CHANGE, rba_DiagLib_AttributeRef=ClearAllowedBehavior
          DemEventParameter_CanBusoff
            29 x rba_DiagLib_AttributeValue:
              DemEventParameter_CanBusoff__DebounceBehavior: rba_DiagLib_Value=DEM_DEBOUNCE_FREEZE, rba_DiagLib_AttributeRef=DebounceBehavior
              DemEventParameter_CanBusoff__IsRecoverable: rba_DiagLib_Value=DEM_RECOV, rba_DiagLib_AttributeRef=IsRecoverable
              DemEventParameter_CanBusoff__StoreTestFailedToNextOC: rba_DiagLib_Value=TRUE, rba_DiagLib_AttributeRef=StoreTestFailedToNextOC
              DemEventParameter_CanBusoff__RequestsWarningIndicator: rba_DiagLib_Value=0uL, rba_DiagLib_AttributeRef=RequestsWarningIndicator
              DemEventParameter_CanBusoff__Category: rba_DiagLib_Value=DemConf_DemEventCategory_INVALIDCATEGORY, rba_DiagLib_AttributeRef=Category
              DemEventParameter_CanBusoff__EventIsStoredInPrimary: rba_DiagLib_Value=TRUE, rba_DiagLib_AttributeRef=EventIsStoredInPrimary
              DemEventParameter_CanBusoff__EventIsStoredInSecondary: rba_DiagLib_Value=FALSE, rba_DiagLib_AttributeRef=EventIsStoredInSecondary
              DemEventParameter_CanBusoff__EventIsStoredInMirror: rba_DiagLib_Value=FALSE, rba_DiagLib_AttributeRef=EventIsStoredInMirror
              DemEventParameter_CanBusoff__AgingAllowed: rba_DiagLib_Value=1uL, rba_DiagLib_AttributeRef=AgingAllowed
              DemEventParameter_CanBusoff__IsGlobalFDCCallbackConfigured: rba_DiagLib_Value=FALSE, rba_DiagLib_AttributeRef=IsGlobalFDCCallbackConfigured
              DemEventParameter_CanBusoff__TriggersDataChangedCallback: rba_DiagLib_Value=FALSE, rba_DiagLib_AttributeRef=TriggersDataChangedCallback
              DemEventParameter_CanBusoff__Significance: rba_DiagLib_Value=1uL, rba_DiagLib_AttributeRef=Significance
              DemEventParameter_CanBusoff__OperationCycleID: rba_DiagLib_Value=DemConf_DemOperationCycle_DemOperationCycle_0, rba_DiagLib_AttributeRef=OperationCycleID
              DemEventParameter_CanBusoff__AgingCycleID: rba_DiagLib_Value=DemConf_DemOperationCycle_DemOperationCycle_0, rba_DiagLib_AttributeRef=AgingCycleID
              DemEventParameter_CanBusoff__FailureCycleID: rba_DiagLib_Value=DemConf_DemOperationCycle_DemOperationCycle_0, rba_DiagLib_AttributeRef=FailureCycleID
              DemEventParameter_CanBusoff__InitialSuppressionStatus: rba_DiagLib_Value=0uL, rba_DiagLib_AttributeRef=InitialSuppressionStatus
              DemEventParameter_CanBusoff__DebounceMethodIndex: rba_DiagLib_Value=DEM_DEBMETH_IDX_ARCTRBASECLASS, rba_DiagLib_AttributeRef=DebounceMethodIndex
              DemEventParameter_CanBusoff__DebounceParamSettingIndex: rba_DiagLib_Value=DEM_DEBPARAM_IDX_DEMEVENTPARAMETER_CANBUSOFF, rba_DiagLib_AttributeRef=DebounceParamSettingIndex
              DemEventParameter_CanBusoff__BufferTimeSFB: rba_DiagLib_Value=0u, rba_DiagLib_AttributeRef=BufferTimeSFB
              DemEventParameter_CanBusoff__AgingThreshold: rba_DiagLib_Value=40u, rba_DiagLib_AttributeRef=AgingThreshold
              DemEventParameter_CanBusoff__AgingThresholdForTFSLC: rba_DiagLib_Value=0u, rba_DiagLib_AttributeRef=AgingThresholdForTFSLC
              DemEventParameter_CanBusoff__FailureConfirmationThreshold: rba_DiagLib_Value=1u, rba_DiagLib_AttributeRef=FailureConfirmationThreshold
              DemEventParameter_CanBusoff__EventPriority: rba_DiagLib_Value=4u, rba_DiagLib_AttributeRef=EventPriority
              DemEventParameter_CanBusoff__MaxNumberFreezeFrameRecords: rba_DiagLib_Value=2u, rba_DiagLib_AttributeRef=MaxNumberFreezeFrameRecords
              DemEventParameter_CanBusoff__StorageConditions: rba_DiagLib_Value=DEM_STOCO_DemEventParameter_CanBusoff, rba_DiagLib_AttributeRef=StorageConditions
              DemEventParameter_CanBusoff__EnableConditions: rba_DiagLib_Value=DEM_ENCO_DemEventParameter_CanBusoff, rba_DiagLib_AttributeRef=EnableConditions
              DemEventParameter_CanBusoff__CallbackEventStatusChangedIndex: rba_DiagLib_Value=0u, rba_DiagLib_AttributeRef=CallbackEventStatusChangedIndex
              DemEventParameter_CanBusoff__CallbackClearAllowed: rba_DiagLib_Value=NULL_PTR, rba_DiagLib_AttributeRef=CallbackClearAllowed
              DemEventParameter_CanBusoff__ClearAllowedBehavior: rba_DiagLib_Value=DEM_NO_STATUS_BYTE_CHANGE, rba_DiagLib_AttributeRef=ClearAllowedBehavior
          DemEventParameter_CanController1_Busoff
            29 x rba_DiagLib_AttributeValue:
              DemEventParameter_CanController1_Busoff__DebounceBehavior: rba_DiagLib_Value=DEM_DEBOUNCE_FREEZE, rba_DiagLib_AttributeRef=DebounceBehavior
              DemEventParameter_CanController1_Busoff__IsRecoverable: rba_DiagLib_Value=DEM_RECOV, rba_DiagLib_AttributeRef=IsRecoverable
              DemEventParameter_CanController1_Busoff__StoreTestFailedToNextOC: rba_DiagLib_Value=TRUE, rba_DiagLib_AttributeRef=StoreTestFailedToNextOC
              DemEventParameter_CanController1_Busoff__RequestsWarningIndicator: rba_DiagLib_Value=0uL, rba_DiagLib_AttributeRef=RequestsWarningIndicator
              DemEventParameter_CanController1_Busoff__Category: rba_DiagLib_Value=DemConf_DemEventCategory_INVALIDCATEGORY, rba_DiagLib_AttributeRef=Category
              DemEventParameter_CanController1_Busoff__EventIsStoredInPrimary: rba_DiagLib_Value=FALSE, rba_DiagLib_AttributeRef=EventIsStoredInPrimary
              DemEventParameter_CanController1_Busoff__EventIsStoredInSecondary: rba_DiagLib_Value=FALSE, rba_DiagLib_AttributeRef=EventIsStoredInSecondary
              DemEventParameter_CanController1_Busoff__EventIsStoredInMirror: rba_DiagLib_Value=FALSE, rba_DiagLib_AttributeRef=EventIsStoredInMirror
              DemEventParameter_CanController1_Busoff__AgingAllowed: rba_DiagLib_Value=0uL, rba_DiagLib_AttributeRef=AgingAllowed
              DemEventParameter_CanController1_Busoff__IsGlobalFDCCallbackConfigured: rba_DiagLib_Value=FALSE, rba_DiagLib_AttributeRef=IsGlobalFDCCallbackConfigured
              DemEventParameter_CanController1_Busoff__TriggersDataChangedCallback: rba_DiagLib_Value=FALSE, rba_DiagLib_AttributeRef=TriggersDataChangedCallback
              DemEventParameter_CanController1_Busoff__Significance: rba_DiagLib_Value=0uL, rba_DiagLib_AttributeRef=Significance
              DemEventParameter_CanController1_Busoff__OperationCycleID: rba_DiagLib_Value=DemConf_DemOperationCycle_DemOperationCycle_0, rba_DiagLib_AttributeRef=OperationCycleID
              DemEventParameter_CanController1_Busoff__AgingCycleID: rba_DiagLib_Value=DemConf_DemOperationCycle_DemOperationCycle_0, rba_DiagLib_AttributeRef=AgingCycleID
              DemEventParameter_CanController1_Busoff__FailureCycleID: rba_DiagLib_Value=DemConf_DemOperationCycle_DemOperationCycle_0, rba_DiagLib_AttributeRef=FailureCycleID
              DemEventParameter_CanController1_Busoff__InitialSuppressionStatus: rba_DiagLib_Value=1uL, rba_DiagLib_AttributeRef=InitialSuppressionStatus
              DemEventParameter_CanController1_Busoff__DebounceMethodIndex: rba_DiagLib_Value=DEM_DEBMETH_IDX_ARCTRBASECLASS, rba_DiagLib_AttributeRef=DebounceMethodIndex
              DemEventParameter_CanController1_Busoff__DebounceParamSettingIndex: rba_DiagLib_Value=DEM_DEBPARAM_IDX_DEMEVENTPARAMETER_CANCONTROLLER1_BUSOFF, rba_DiagLib_AttributeRef=DebounceParamSettingIndex
              DemEventParameter_CanController1_Busoff__BufferTimeSFB: rba_DiagLib_Value=0u, rba_DiagLib_AttributeRef=BufferTimeSFB
              DemEventParameter_CanController1_Busoff__AgingThreshold: rba_DiagLib_Value=1u, rba_DiagLib_AttributeRef=AgingThreshold
              DemEventParameter_CanController1_Busoff__AgingThresholdForTFSLC: rba_DiagLib_Value=0u, rba_DiagLib_AttributeRef=AgingThresholdForTFSLC
              DemEventParameter_CanController1_Busoff__FailureConfirmationThreshold: rba_DiagLib_Value=1u, rba_DiagLib_AttributeRef=FailureConfirmationThreshold
              DemEventParameter_CanController1_Busoff__EventPriority: rba_DiagLib_Value=255u, rba_DiagLib_AttributeRef=EventPriority
              DemEventParameter_CanController1_Busoff__MaxNumberFreezeFrameRecords: rba_DiagLib_Value=0u, rba_DiagLib_AttributeRef=MaxNumberFreezeFrameRecords
              DemEventParameter_CanController1_Busoff__StorageConditions: rba_DiagLib_Value=DEM_STOCO_DemEventParameter_CanController1_Busoff, rba_DiagLib_AttributeRef=StorageConditions
              DemEventParameter_CanController1_Busoff__EnableConditions: rba_DiagLib_Value=DEM_ENCO_DemEventParameter_CanController1_Busoff, rba_DiagLib_AttributeRef=EnableConditions
              DemEventParameter_CanController1_Busoff__CallbackEventStatusChangedIndex: rba_DiagLib_Value=0u, rba_DiagLib_AttributeRef=CallbackEventStatusChangedIndex
              DemEventParameter_CanController1_Busoff__CallbackClearAllowed: rba_DiagLib_Value=NULL_PTR, rba_DiagLib_AttributeRef=CallbackClearAllowed
              DemEventParameter_CanController1_Busoff__ClearAllowedBehavior: rba_DiagLib_Value=DEM_NO_STATUS_BYTE_CHANGE, rba_DiagLib_AttributeRef=ClearAllowedBehavior
        DataContainer_1 (rba_DiagLib_DataContainer): rba_DiagLib_TotalBitSize=8, rba_DiagLib_OccupiedBitSize=0, rba_DiagLib_OccupiedBitSize=8
        DataContainer_2 (rba_DiagLib_DataContainer):
          rba_DiagLib_TotalBitSize = 32
          rba_DiagLib_OccupiedBitSize = 0
          rba_DiagLib_OccupiedBitSize = 3
          rba_DiagLib_OccupiedBitSize = 6
          rba_DiagLib_OccupiedBitSize = {8..12}
