VERSION ""

NS_ :

BS_:

BU_: MCU

BO_ 818 XCP_RX_Broadcast: 8 Vector__XXX
 SG_ XCP_SIG2 : 7|64@0+ (1,0) [0|0] ""  MCU

BO_ 1914 XCP_TX_DAQ2: 8 MCU

BO_ 1913 XCP_TX_DAQ1: 8 MCU

BO_ 1912 XCP_TX_DAQ0: 8 MCU

BO_ 819 XCP_RX_CMD: 8 Vector__XXX
 SG_ XCP_SIG1 : 7|64@0+ (1,0) [0|0] ""  MCU

BO_ 1911 XCP_TX_RES: 8 MCU

BA_DEF_  "BusType" STRING ;
BA_DEF_DEF_  "BusType" "CAN";
