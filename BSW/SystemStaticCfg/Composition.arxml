AUTOSAR XML (schema 4-2-2)
package /Composition
  composition sw component type Composition
    18 x component:
      CPT_BswM: type=BswM
      CPT_EcuM: type=EcuM
      CPT_ComM: type=ComM
      CPT_Det: type=Det
      CPT_ASW_NVM: type=ASW_NVM
      CPT_NvM: type=NvM
      CPT_Dcm: type=Dcm
      CPT_Diag: type=ASW_Diag
      CPT_Dem: type=Dem
      CPT_Dem_SWC: type=ASW_Dem
      CPT_Wdg: type=WdgM
      CPT_ASW_WDG: type=ASW_WDG
      CPT_XCP: type=ASW_XCP
      CPT_ASW_COM: type=ASW_COM
      CPT_ASW_NM: type=ASW_NM
      CPT_ASW_BASE: type=ASW_BASE
      CPT_ASW_CORE1: type=ASW_CORE1
      CPT_ASW_CORE2: type=ASW_CORE2
    connect CPT_Diag.PPort_IOControl_VacuumPumpPressure -> CPT_Dcm.DataServices_DcmDspData_VacuumPumpPressure_1100
    connect CPT_Dcm.DCMServices -> CPT_Diag.RPort_DCMServices
    connect CPT_Diag.PPort_Routine_DriveVacuumPump -> CPT_Dcm.RoutineServices_DcmDspRoutine_DriveVacuumPump
    connect CPT_Dem.Event_DemEventParameter_C110117 -> CPT_Dem_SWC.Event_DemEventParameter_C110117
    connect CPT_Dem.Event_DemEventParameter_C110216 -> CPT_Dem_SWC.Event_DemEventParameter_C110216
    connect CPT_Dem_SWC.PPort_CBStatusComp_DemComponent_C110117 -> CPT_Dem.CBStatusComp_DemComponent_C110117
    connect CPT_Dem_SWC.PPort_CBStatusComp_DemComponent_C110216 -> CPT_Dem.CBStatusComp_DemComponent_C110216
    connect CPT_Dem_SWC.PPort_CBStatusComp_DemComponent_C153364 -> CPT_Dem.CBStatusComp_DemComponent_C153364
    connect CPT_Diag.P_DataServices_DcmDspData_SystemFaultRank_Read -> CPT_Dcm.R_DataServices_DcmDspData_SystemFaultRank
    connect CPT_Diag.P_DataServices_DcmDspData_VehicleSpeed_Read -> CPT_Dcm.R_DataServices_DcmDspData_VehicleSpeed
    connect CPT_Dcm.P_DataServices_DcmDspData_SystemFaultRank -> CPT_Diag.RPort_DataServices_DcmDspData_SystemFaultRank_Write
    connect CPT_Dcm.P_DataServices_DcmDspData_VehicleSpeed -> CPT_Diag.RPort_DataServices_DcmDspData_VehicleSpeed_Write
    connect CPT_Dem.OpCycle_DemOperationCycle_0 -> CPT_Dem_SWC.RPort_OpCycle_DemOperationCycle_0
    connect CPT_Dem_SWC.PPort_CBStatusComp_DemComponent_Busoff -> CPT_Dem.CBStatusComp_DemComponent_Busoff
    connect CPT_ASW_BASE.PPort_SwcModeRequest -> CPT_BswM.RP_BswMArbitration_BswMSwcModeRequest
    connect CPT_ComM.UM_ComMUser_Can_Network_Channel -> CPT_ASW_BASE.RPort_CurrentMode_CAN0
    connect CPT_EcuM.bootTarget -> CPT_ASW_BASE.RPort_BootTarget
    connect CPT_EcuM.shutdownTarget -> CPT_ASW_BASE.RPort_SelectShutdownTarget
    connect CPT_ComM.UR_ComMUser_Can_Network_Channel -> CPT_ASW_NM.RP_ComM_UserRequest_CAN0
    connect CPT_ComM.modeLimitation -> CPT_ASW_NM.RPort_EcuModeLimitation
    connect CPT_Wdg.alive_WdgMSupervisedEntity_Alive_Supervision_Entity1 -> CPT_ASW_WDG.RPort_Alive_Supervision_Entity1
    connect CPT_Wdg.globalMode -> CPT_ASW_WDG.RPort_WdgM_GlobalMode
    connect CPT_Wdg.mode_WdgMSupervisedEntity_Alive_Supervision_Entity1 -> CPT_ASW_WDG.RPort_WdgM_InvidualMode_Alive_Supervision_Entity1
    connect CPT_ASW_NM.PP_BswMArbitration_BswM_MRP_Network -> CPT_BswM.RP_BswMArbitration_BswM_MRP_SWC_Network
    connect CPT_ASW_NM.PP_BswMArbitration_BswM_MRP_NmState -> CPT_BswM.RP_BswMArbitration_BswM_MRP_SWC_Network
    connect CPT_Dem_SWC.PPort_CBReadData_Dem_External_VehicleSpeed -> CPT_Dem.DataServices_DemDataElementClass_VehicleSpeed
    connect CPT_Dem_SWC.PPort_CBReadData_DemDataElementClass_SystemFaultRank -> CPT_Dem.DataServices_DemDataElementClass_SystemFaultRank
    connect CPT_NvM.NvM_NativeBlock_1024_1 -> CPT_ASW_NVM.RPort_ASW_NVM_BlockNative_1024_1
    connect CPT_NvM.NvM_NativeBlock_1024_2 -> CPT_ASW_NVM.RPort_ASW_NVM_BlockNative_1024_2
package /Composition/PortInterfaceMappingSets
  port interface mapping set PIMSet_Composition
